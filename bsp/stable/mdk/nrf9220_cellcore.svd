# nrf9220_cellcore register map
Vendor: Nordic Semiconductor; Series: nRF92; File version: 1
nRF9220 reference description for system-on-chip with many ARM 32-bit Cortex-M33 microcontrollers
CPU: CM33 r0p4, little endian, MPU, FPU, 3 interrupt priority bits, 480 interrupts, 8 SAU regions
Registers are 32-bit, read-write, reset 0x0 unless marked. A register's access mark holds for its fields unless they carry their own. Offsets are from the block's base; lines under a group give offsets from that group; [hi:lo] are bit positions; {n}, {i} and the like mark numbered series; 'fields as' and 'values as' point back to an identical list; <NAME> marks a mode.

## Memory map
0x04F00000 ICACHEDATA_S size 0x1000 — CACHEDATA
0x04F10000 ICACHEINFO_S size 0x1000 — CACHEINFO
0x0E3FF800 UICR_NS size 0x800 — User information configuration registers
0x0FFF6000 GLOBAL_MICR_NS size 0x1000 — MICR
0x0FFFE000 GLOBAL_FICR_NS size 0xC00 — Factory Information Configuration Registers
{0x42058000+0x1000*n} SWI{n}_NS size 0x1000 (n=0..7) — Software interrupt {n}
0x44001000 HSFLL_NS size 0x1000 — HSFLL 0
0x44002000 LRCCONF0_NS size 0x1000 — LRCCONF 0
0x44005000 MVDMA_NS size 0x1000 — MVDMA performs direct-memory-accesses between memories. Data is transferred according to job descriptor lists. Each transfer has corresponding source and sink descriptor lists with matching data amounts. The lists are in memory and they contain data buffer information, address pointers, buffer sizes and data type attributes. 0
0x44006000 RAMC00_NS size 0x1000 — RAM Controller 0
0x44007000 SYSTEMTIMER_NS size 0x1000 — Modem Timer/Counter 0
0x44008000 AESLTE_NS size 0x1000 — AES-128 HW accelerator for LTE L2 security and MAC 0
0x44009000 SNOW_NS size 0x1000 — Snow 3G Security IP 0
0x4400A000 ZUC_NS size 0x1000 — ZUC LTE L2 security IP 0
0x4400B000 TRACEDELAYREG_NS size 0x1000 — Trace delay register 0
0x4400C000 PCGCS0_NS size 0x1000 — PCGCSlave 0
0x4400D000 PCGCM0_NS size 0x1000 — PCGC Master 0
0x4400F000 SACR_NS size 0x1000 — Sample accumulator router 0
0x44011000 LRCCONF1_NS size 0x1000 — LRCCONF 2
0x44012000 CPUCONF_NS size 0x1000 — CPU Configuration 0
0x44013000 MEMCONF_NS size 0x1000 — Memory configuration 0
0x44014000 IPCT_NS size 0x1000 — IPCT APB registers 0
0x44015000 WDT0_NS size 0x1000 — Watchdog Timer 0
0x44016000 WDT1_NS size 0x1000 — Watchdog Timer 2
0x44017000 RTC_NS size 0x1000 — Real-time counter 0
0x44018000 PCGCS1_NS size 0x1000 — PCGCSlave 2
0x44019000 PCGCM1_NS size 0x1000 — PCGC Master 2
0x4401A000 PPIB0_NS size 0x1000 — PPIB APB registers 0
0x44020000 SPU2_NS size 0x1000 — System protection unit 2
0x44021000 DPPIC0_NS size 0x1000 — Distributed programmable peripheral interconnect controller 0
0x44022000 LTETIMER_NS size 0x1000 — Modem Timer/Counter 2
0x44023000 LFCLKCALIBMEAS_NS size 0x1000 — LFCLK calibration measurement 0
0x44024000 TIMEREVENTSYNCH_NS size 0x1000 — Timer event synchronizer 0
0x44025000 TIMEMARKMUX0_NS size 0x1000 — Timemark multiplexer 0
0x44026000 PPIB1_NS size 0x1000 — PPIB APB registers 2
0x44027000 PCGCS2_NS size 0x1000 — PCGCSlave 4
0x44030000 SPU3_NS size 0x1000 — System protection unit 3
0x44031000 LRCCONF3_NS size 0x1000 — LRCCONF 4
0x44032000 DPPIC1_NS size 0x1000 — Distributed programmable peripheral interconnect controller 2
0x44033000 GNSSTIMER_NS size 0x1000 — Modem Timer/Counter 0
0x44034000 TIMEMARKMUX1_NS size 0x1000 — Timemark multiplexer 2
0x44035000 MCPLL_NS size 0x1000 — Modem Clock PLL 0
0x44036000 PCGCS3_NS size 0x1000 — PCGCSlave 6
0x44037000 PCGCM3_NS size 0x1000 — PCGC Master 4
0x44038000 TIMEMARKMUX2_NS size 0x1000 — Timemark multiplexer 4
0x44039000 PPIB2_NS size 0x1000 — PPIB APB registers 4
0x4F092000 GLOBAL_MRAMC110_NS size 0x1000 — MRAM controller 0
0x4F093000 GLOBAL_MRAMC111_NS size 0x1000 — MRAM controller 2
0x4F09C000 BELLBOARD_NS size 0x1000 — BELLBOARD APB registers 0
0x4F8C8000 GLOBAL_VPR120_NS size 0x1000 — VPR peripheral registers 0
0x4F8D1000 GLOBAL_IPCT120_NS size 0x1000 — IPCT APB registers 0
0x4F8D2000 GLOBAL_MUTEX120_NS size 0x1000 — MUTEX 0
0x4F8D2000 GLOBAL_PROTOTYPE_NS size 0x1000 — Prototype HW information registers.
0x4F8D4000 GLOBAL_VPR121_NS size 0x1000 — VPR peripheral registers 2
0x4F8E1000 GLOBAL_DPPIC120_NS size 0x1000 — Distributed programmable peripheral interconnect controller 0
0x4F8E2000 GLOBAL_TIMER120_NS size 0x1000 — Timer/Counter 0
0x4F8E6000 GLOBAL_SPIM120_NS size 0x1000 — Serial Peripheral Interface Master with EasyDMA 0
0x4F8E6000 GLOBAL_SPIS120_NS size 0x1000 — SPI Slave 0
0x4F8E6000 GLOBAL_UARTE120_NS size 0x1000 — UART with EasyDMA 0
0x4F908000 GLOBAL_VPR130_NS size 0x1000 — VPR peripheral registers 4
0x4F90A000 GLOBAL_AHBBUFFER_APP_NS size 0x1000 — AHB Buffer 0
0x4F90C000 GLOBAL_AHBBUFFER_CELL_NS size 0x1000 — AHB Buffer 2
0x4F921000 GLOBAL_IPCT130_NS size 0x1000 — IPCT APB registers 2
0x4F922000 GLOBAL_DPPIC130_NS size 0x1000 — Distributed programmable peripheral interconnect controller 2
0x4F927000 GLOBAL_MUTEX130_NS size 0x1000 — MUTEX 1
0x4F928000 GLOBAL_RTC130_NS size 0x1000 — Real-time counter 0
0x4F92B000 GLOBAL_WDT131_NS size 0x1000 — Watchdog Timer 0
0x4F92C000 GLOBAL_WDT132_NS size 0x1000 — Watchdog Timer 2
0x4F92D000 GLOBAL_EGU130_NS size 0x1000 — Event generator unit 0
0x4F934000 GLOBAL_GPIOTE130_NS size 0x1000 — GPIO Tasks and Events 0
0x4F938000 GLOBAL_P0_NS size 0x200 — GPIO Port 0
0x4F938200 GLOBAL_P1_NS size 0x200 — GPIO Port 1
0x4F938400 GLOBAL_P2_NS size 0x200 — GPIO Port 2
0x4F938A00 GLOBAL_P5_NS size 0x200 — GPIO Port 3
0x4F939400 GLOBAL_P10_NS size 0x200 — GPIO Port 8
0x4F939800 GLOBAL_P12_NS size 0x200 — GPIO Port 9
0x4F939E00 GLOBAL_GPIOINTERNAL_NS size 0x2000 — GPIO Internal 0
0x4F957000 GLOBAL_AUDIOPLL_NS size 0x1000 — AUXPLL 0
0x4F968000 GLOBAL_AUDIOPLLPM_NS size 0x1000 — AUXPM 0
0x4F981000 GLOBAL_DPPIC131_NS size 0x1000 — Distributed programmable peripheral interconnect controller 4
0x4F982000 GLOBAL_SAADC_NS size 0x1000 — Analog to Digital Converter 0
0x4F984000 GLOBAL_TEMP_NS size 0x1000 — Temperature Sensor 0
0x4F985000 GLOBAL_NFCT_NS size 0x1000 — NFC-A compatible radio NFC-A compatible radio 0
0x4F991000 GLOBAL_DPPIC132_NS size 0x1000 — Distributed programmable peripheral interconnect controller 6
0x4F993000 GLOBAL_PDM_NS size 0x1000 — Pulse Density Modulation (Digital Microphone) Interface 0
0x4F996000 GLOBAL_SIMIF130_NS size 0x1000 — SIM card interface 0
0x4F99B000 GLOBAL_MIPIRFFE_NS size 0x1000 — MipiRffe Master 0
0x4F99C000 GLOBAL_GRTC_NS size 0x1000 — Global Real-time counter 0
0x4F9A1000 GLOBAL_DPPIC133_NS size 0x1000 — Distributed programmable peripheral interconnect controller 8
0x4F9A2000 GLOBAL_TIMER130_NS size 0x1000 — Timer/Counter 2
0x4F9A3000 GLOBAL_TIMER131_NS size 0x1000 — Timer/Counter 4
0x4F9A4000 GLOBAL_PWM130_NS size 0x1000 — Pulse width modulation unit 0
0x4F9A5000 GLOBAL_SPIM130_NS size 0x1000 — Serial Peripheral Interface Master with EasyDMA 2
0x4F9A5000 GLOBAL_SPIS130_NS size 0x1000 — SPI Slave 2
0x4F9A5000 GLOBAL_TWIM130_NS size 0x1000 — I2C compatible Two-Wire Master Interface with EasyDMA 0
0x4F9A5000 GLOBAL_TWIS130_NS size 0x1000 — I2C compatible Two-Wire Slave Interface with EasyDMA 0
0x4F9A5000 GLOBAL_UARTE130_NS size 0x1000 — UART with EasyDMA 2
0x4F9A6000 GLOBAL_SPIM131_NS size 0x1000 — Serial Peripheral Interface Master with EasyDMA 4
0x4F9A6000 GLOBAL_SPIS131_NS size 0x1000 — SPI Slave 4
0x4F9A6000 GLOBAL_TWIM131_NS size 0x1000 — I2C compatible Two-Wire Master Interface with EasyDMA 2
0x4F9A6000 GLOBAL_TWIS131_NS size 0x1000 — I2C compatible Two-Wire Slave Interface with EasyDMA 2
0x4F9A6000 GLOBAL_UARTE131_NS size 0x1000 — UART with EasyDMA 4
0x4F9B1000 GLOBAL_DPPIC134_NS size 0x1000 — Distributed programmable peripheral interconnect controller 10
0x4F9B2000 GLOBAL_TIMER132_NS size 0x1000 — Timer/Counter 6
0x4F9B3000 GLOBAL_TIMER133_NS size 0x1000 — Timer/Counter 8
0x4F9B4000 GLOBAL_PWM131_NS size 0x1000 — Pulse width modulation unit 2
0x4F9B5000 GLOBAL_SPIM132_NS size 0x1000 — Serial Peripheral Interface Master with EasyDMA 6
0x4F9B5000 GLOBAL_SPIS132_NS size 0x1000 — SPI Slave 6
0x4F9B5000 GLOBAL_TWIM132_NS size 0x1000 — I2C compatible Two-Wire Master Interface with EasyDMA 4
0x4F9B5000 GLOBAL_TWIS132_NS size 0x1000 — I2C compatible Two-Wire Slave Interface with EasyDMA 4
0x4F9B5000 GLOBAL_UARTE132_NS size 0x1000 — UART with EasyDMA 6
0x4F9B6000 GLOBAL_SPIM133_NS size 0x1000 — Serial Peripheral Interface Master with EasyDMA 8
0x4F9B6000 GLOBAL_SPIS133_NS size 0x1000 — SPI Slave 8
0x4F9B6000 GLOBAL_TWIM133_NS size 0x1000 — I2C compatible Two-Wire Master Interface with EasyDMA 6
0x4F9B6000 GLOBAL_TWIS133_NS size 0x1000 — I2C compatible Two-Wire Slave Interface with EasyDMA 6
0x4F9B6000 GLOBAL_UARTE133_NS size 0x1000 — UART with EasyDMA 8
0x54000000 SPU0_S size 0x1000 — System protection unit 0
0x54001000 HSFLL_S size 0x1000 — HSFLL 1
0x54002000 LRCCONF0_S size 0x1000 — LRCCONF 1
0x54003000 MPC_S size 0x1000 — Memory Privilege Controller
0x54005000 MVDMA_S size 0x1000 — MVDMA performs direct-memory-accesses between memories. Data is transferred according to job descriptor lists. Each transfer has corresponding source and sink descriptor lists with matching data amounts. The lists are in memory and they contain data buffer information, address pointers, buffer sizes and data type attributes. 1
0x54006000 RAMC00_S size 0x1000 — RAM Controller 1
0x54007000 SYSTEMTIMER_S size 0x1000 — Modem Timer/Counter 1
0x54008000 AESLTE_S size 0x1000 — AES-128 HW accelerator for LTE L2 security and MAC 1
0x54009000 SNOW_S size 0x1000 — Snow 3G Security IP 1
0x5400A000 ZUC_S size 0x1000 — ZUC LTE L2 security IP 1
0x5400B000 TRACEDELAYREG_S size 0x1000 — Trace delay register 1
0x5400C000 PCGCS0_S size 0x1000 — PCGCSlave 1
0x5400C500 CELLCOREHSPDCTRL_NS size 0x4 — Cellular core HSPD FSM control
0x5400D000 PCGCM0_S size 0x1000 — PCGC Master 1
0x5400F000 SACR_S size 0x1000 — Sample accumulator router 1
0x54010000 SPU1_S size 0x1000 — System protection unit 1
0x54011000 LRCCONF1_S size 0x1000 — LRCCONF 3
0x54011000 RESETINFO_S size 0x1000 — RESETINFO
0x54012000 CPUCONF_S size 0x1000 — CPU Configuration 1
0x54013000 MEMCONF_S size 0x1000 — Memory configuration 1
0x54014000 IPCT_S size 0x1000 — IPCT APB registers 1
0x54015000 WDT0_S size 0x1000 — Watchdog Timer 1
0x54016000 WDT1_S size 0x1000 — Watchdog Timer 3
0x54017000 RTC_S size 0x1000 — Real-time counter 1
0x54018000 PCGCS1_S size 0x1000 — PCGCSlave 3
0x54018500 CELLCORELSPDCTRL_NS size 0x4 — Cellular core LSPD FSM control
0x54019000 PCGCM1_S size 0x1000 — PCGC Master 3
0x5401A000 PPIB0_S size 0x1000 — PPIB APB registers 1
0x54021000 DPPIC0_S size 0x1000 — Distributed programmable peripheral interconnect controller 1
0x54022000 LTETIMER_S size 0x1000 — Modem Timer/Counter 3
0x54023000 LFCLKCALIBMEAS_S size 0x1000 — LFCLK calibration measurement 1
0x54024000 TIMEREVENTSYNCH_S size 0x1000 — Timer event synchronizer 1
0x54025000 TIMEMARKMUX0_S size 0x1000 — Timemark multiplexer 1
0x54026000 PPIB1_S size 0x1000 — PPIB APB registers 3
0x54027000 PCGCS2_S size 0x1000 — PCGCSlave 5
0x54031000 LRCCONF3_S size 0x1000 — LRCCONF 5
0x54032000 DPPIC1_S size 0x1000 — Distributed programmable peripheral interconnect controller 3
0x54033000 GNSSTIMER_S size 0x1000 — Modem Timer/Counter 1
0x54034000 TIMEMARKMUX1_S size 0x1000 — Timemark multiplexer 3
0x54035000 MCPLL_S size 0x1000 — Modem Clock PLL 1
0x54036000 PCGCS3_S size 0x1000 — PCGCSlave 7
0x54036500 CELLCORETIMERPDCTRL_NS size 0x4 — Cellular core TIMERPD FSM control
0x54037000 PCGCM3_S size 0x1000 — PCGC Master 5
0x54038000 TIMEMARKMUX2_S size 0x1000 — Timemark multiplexer 5
0x54039000 PPIB2_S size 0x1000 — PPIB APB registers 5
0x5F092000 GLOBAL_MRAMC110_S size 0x1000 — MRAM controller 1
0x5F093000 GLOBAL_MRAMC111_S size 0x1000 — MRAM controller 3
0x5F09C000 BELLBOARD_S size 0x1000 — BELLBOARD APB registers 1
0x5F8C5000 GLOBAL_OTPC_S size 0x1000 — OTP controller
0x5F8C8000 GLOBAL_VPR120_S size 0x1000 — VPR peripheral registers 1
0x5F8D1000 GLOBAL_IPCT120_S size 0x1000 — IPCT APB registers 1
0x5F8D4000 GLOBAL_VPR121_S size 0x1000 — VPR peripheral registers 3
0x5F8E1000 GLOBAL_DPPIC120_S size 0x1000 — Distributed programmable peripheral interconnect controller 1
0x5F8E2000 GLOBAL_TIMER120_S size 0x1000 — Timer/Counter 1
0x5F8E6000 GLOBAL_SPIM120_S size 0x1000 — Serial Peripheral Interface Master with EasyDMA 1
0x5F8E6000 GLOBAL_SPIS120_S size 0x1000 — SPI Slave 1
0x5F8E6000 GLOBAL_UARTE120_S size 0x1000 — UART with EasyDMA 1
0x5F908000 GLOBAL_VPR130_S size 0x1000 — VPR peripheral registers 5
0x5F90A000 GLOBAL_AHBBUFFER_APP_S size 0x1000 — AHB Buffer 1
0x5F90C000 GLOBAL_AHBBUFFER_CELL_S size 0x1000 — AHB Buffer 3
0x5F921000 GLOBAL_IPCT130_S size 0x1000 — IPCT APB registers 3
0x5F922000 GLOBAL_DPPIC130_S size 0x1000 — Distributed programmable peripheral interconnect controller 3
0x5F928000 GLOBAL_RTC130_S size 0x1000 — Real-time counter 1
0x5F92B000 GLOBAL_WDT131_S size 0x1000 — Watchdog Timer 1
0x5F92C000 GLOBAL_WDT132_S size 0x1000 — Watchdog Timer 3
0x5F92D000 GLOBAL_EGU130_S size 0x1000 — Event generator unit 1
0x5F934000 GLOBAL_GPIOTE130_S size 0x1000 — GPIO Tasks and Events 1
0x5F938000 GLOBAL_P0_S size 0x200 — GPIO Port 4
0x5F938200 GLOBAL_P1_S size 0x200 — GPIO Port 5
0x5F938400 GLOBAL_P2_S size 0x200 — GPIO Port 6
0x5F938A00 GLOBAL_P5_S size 0x200 — GPIO Port 7
0x5F939400 GLOBAL_P10_S size 0x200 — GPIO Port 10
0x5F939800 GLOBAL_P12_S size 0x200 — GPIO Port 11
0x5F939E00 GLOBAL_GPIOINTERNAL_S size 0x2000 — GPIO Internal 1
0x5F949000 GLOBAL_RESETHUB_S size 0x1000 — Reset hub
0x5F957000 GLOBAL_AUDIOPLL_S size 0x1000 — AUXPLL 1
0x5F968000 GLOBAL_AUDIOPLLPM_S size 0x1000 — AUXPM 1
0x5F981000 GLOBAL_DPPIC131_S size 0x1000 — Distributed programmable peripheral interconnect controller 5
0x5F982000 GLOBAL_SAADC_S size 0x1000 — Analog to Digital Converter 1
0x5F984000 GLOBAL_TEMP_S size 0x1000 — Temperature Sensor 1
0x5F985000 GLOBAL_NFCT_S size 0x1000 — NFC-A compatible radio NFC-A compatible radio 1
0x5F991000 GLOBAL_DPPIC132_S size 0x1000 — Distributed programmable peripheral interconnect controller 7
0x5F993000 GLOBAL_PDM_S size 0x1000 — Pulse Density Modulation (Digital Microphone) Interface 1
0x5F996000 GLOBAL_SIMIF130_S size 0x1000 — SIM card interface 1
0x5F99B000 GLOBAL_MIPIRFFE_S size 0x1000 — MipiRffe Master 1
0x5F99C000 GLOBAL_GRTC_S size 0x1000 — Global Real-time counter 1
0x5F9A1000 GLOBAL_DPPIC133_S size 0x1000 — Distributed programmable peripheral interconnect controller 9
0x5F9A2000 GLOBAL_TIMER130_S size 0x1000 — Timer/Counter 3
0x5F9A3000 GLOBAL_TIMER131_S size 0x1000 — Timer/Counter 5
0x5F9A4000 GLOBAL_PWM130_S size 0x1000 — Pulse width modulation unit 1
0x5F9A5000 GLOBAL_SPIM130_S size 0x1000 — Serial Peripheral Interface Master with EasyDMA 3
0x5F9A5000 GLOBAL_SPIS130_S size 0x1000 — SPI Slave 3
0x5F9A5000 GLOBAL_TWIM130_S size 0x1000 — I2C compatible Two-Wire Master Interface with EasyDMA 1
0x5F9A5000 GLOBAL_TWIS130_S size 0x1000 — I2C compatible Two-Wire Slave Interface with EasyDMA 1
0x5F9A5000 GLOBAL_UARTE130_S size 0x1000 — UART with EasyDMA 3
0x5F9A6000 GLOBAL_SPIM131_S size 0x1000 — Serial Peripheral Interface Master with EasyDMA 5
0x5F9A6000 GLOBAL_SPIS131_S size 0x1000 — SPI Slave 5
0x5F9A6000 GLOBAL_TWIM131_S size 0x1000 — I2C compatible Two-Wire Master Interface with EasyDMA 3
0x5F9A6000 GLOBAL_TWIS131_S size 0x1000 — I2C compatible Two-Wire Slave Interface with EasyDMA 3
0x5F9A6000 GLOBAL_UARTE131_S size 0x1000 — UART with EasyDMA 5
0x5F9B1000 GLOBAL_DPPIC134_S size 0x1000 — Distributed programmable peripheral interconnect controller 11
0x5F9B2000 GLOBAL_TIMER132_S size 0x1000 — Timer/Counter 7
0x5F9B3000 GLOBAL_TIMER133_S size 0x1000 — Timer/Counter 9
0x5F9B4000 GLOBAL_PWM131_S size 0x1000 — Pulse width modulation unit 3
0x5F9B5000 GLOBAL_SPIM132_S size 0x1000 — Serial Peripheral Interface Master with EasyDMA 7
0x5F9B5000 GLOBAL_SPIS132_S size 0x1000 — SPI Slave 7
0x5F9B5000 GLOBAL_TWIM132_S size 0x1000 — I2C compatible Two-Wire Master Interface with EasyDMA 5
0x5F9B5000 GLOBAL_TWIS132_S size 0x1000 — I2C compatible Two-Wire Slave Interface with EasyDMA 5
0x5F9B5000 GLOBAL_UARTE132_S size 0x1000 — UART with EasyDMA 7
0x5F9B6000 GLOBAL_SPIM133_S size 0x1000 — Serial Peripheral Interface Master with EasyDMA 9
0x5F9B6000 GLOBAL_SPIS133_S size 0x1000 — SPI Slave 9
0x5F9B6000 GLOBAL_TWIM133_S size 0x1000 — I2C compatible Two-Wire Master Interface with EasyDMA 7
0x5F9B6000 GLOBAL_TWIS133_S size 0x1000 — I2C compatible Two-Wire Slave Interface with EasyDMA 7
0x5F9B6000 GLOBAL_UARTE133_S size 0x1000 — UART with EasyDMA 9
0xA0000000 GLOBAL_STMDATA_NS size 0x10000000 — System Trace Macrocell data buffer 0
0xA0000000 GLOBAL_STMDATA_S size 0x10000000 — System Trace Macrocell data buffer 1
0xBF001000 GLOBAL_TDDCONF_NS size 0x1000 — TDDCONF 0
0xBF001000 GLOBAL_TDDCONF_S size 0x1000 — TDDCONF 1
0xBF041000 GLOBAL_TSGEN_NS size 0x1000 — Timestamp generator
0xBF042000 GLOBAL_STM_NS size 0x1000 — System Trace Macrocell
0xBF043000 GLOBAL_TPIU_NS size 0x1000 — Trace Port Interface Unit
0xBF044000 GLOBAL_ETB_NS size 0x1000 — Embedded Trace Buffer
0xBF045000 GLOBAL_ETR_NS size 0x1000 — Embedded Trace Router
0xBF046000 GLOBAL_CTI210_NS size 0x1000 — Cross-Trigger Interface control. NOTE: this is not a separate peripheral, but describes CM33 functionality. 0
0xBF047000 GLOBAL_CTI211_NS size 0x1000 — Cross-Trigger Interface control. NOTE: this is not a separate peripheral, but describes CM33 functionality. 1
0xBF048000 GLOBAL_ATBREPLICATOR210_NS size 0x1000 — ATB Replicator module 0
0xBF049000 GLOBAL_ATBREPLICATOR211_NS size 0x1000 — ATB Replicator module 1
0xBF04A000 GLOBAL_ATBREPLICATOR212_NS size 0x1000 — ATB Replicator module 2
0xBF04B000 GLOBAL_ATBREPLICATOR213_NS size 0x1000 — ATB Replicator module 3
0xBF04C000 GLOBAL_ATBFUNNEL210_NS size 0x1000 — ATB funnel module 0
0xBF04D000 GLOBAL_ATBFUNNEL211_NS size 0x1000 — ATB funnel module 1
0xBF04E000 GLOBAL_ATBFUNNEL212_NS size 0x1000 — ATB funnel module 2
0xBF04F000 GLOBAL_ATBFUNNEL213_NS size 0x1000 — ATB funnel module 3
0xBF050000 GLOBAL_GPR_NS size 0x1000 — Granular Power Requester
0xE0041000 ETM_NS size 0x1000 — Embedded Trace Macrocell
0xE0042000 CTI_S size 0x1000 — Cross-Trigger Interface control. NOTE: this is not a separate peripheral, but describes CM33 functionality.
0xE0080000 CPUC_S size 0x1000 — CPU control
0xE0082000 ICACHE_S size 0x1000 — Cache

## Interrupts
0 SPU0 (SPU0_S)
3 MPC (MPC_S)
4 CPUC (CPUC_S)
5 MVDMA (MVDMA_NS, MVDMA_S)
8 AESLTE (AESLTE_NS, AESLTE_S)
9 SNOW (SNOW_NS, SNOW_S)
10 ZUC (ZUC_NS, ZUC_S)
15 SACR (SACR_NS, SACR_S)
16 SPU1 (SPU1_S)
21 WDT0 (WDT0_NS, WDT0_S)
22 WDT1 (WDT1_NS, WDT1_S)
23 RTC (RTC_NS, RTC_S)
32 SPU2 (SPU2_NS)
35 LFCLKCALIBMEAS (LFCLKCALIBMEAS_NS, LFCLKCALIBMEAS_S)
48 SPU3 (SPU3_NS)
53 MCPLL (MCPLL_NS, MCPLL_S)
69 SYSTEMTIMER_0 (SYSTEMTIMER_NS, SYSTEMTIMER_S)
70 SYSTEMTIMER_1 (SYSTEMTIMER_NS, SYSTEMTIMER_S)
71 LTETIMER_0 (LTETIMER_NS, LTETIMER_S)
72 LTETIMER_1 (LTETIMER_NS, LTETIMER_S)
73 GNSSTIMER_0 (GNSSTIMER_NS, GNSSTIMER_S)
74 GNSSTIMER_1 (GNSSTIMER_NS, GNSSTIMER_S)
75 IPCT_0 (IPCT_NS, IPCT_S)
76 IPCT_1 (IPCT_NS, IPCT_S)
77 IPCT_2 (IPCT_NS, IPCT_S)
78 IPCT_3 (IPCT_NS, IPCT_S)
79 IPCT_4 (IPCT_NS, IPCT_S)
80 IPCT_5 (IPCT_NS, IPCT_S)
{n+88} SWI{n} (SWI{n}_NS) (n=0..7)
96 BELLBOARD_0 (BELLBOARD_NS, BELLBOARD_S)
97 BELLBOARD_1 (BELLBOARD_NS, BELLBOARD_S)
98 BELLBOARD_2 (BELLBOARD_NS, BELLBOARD_S)
99 BELLBOARD_3 (BELLBOARD_NS, BELLBOARD_S)
104 GPIOTE130_0 (GLOBAL_GPIOTE130_NS, GLOBAL_GPIOTE130_S)
105 GPIOTE130_1 (GLOBAL_GPIOTE130_NS, GLOBAL_GPIOTE130_S)
108 GRTC_0 (GLOBAL_GRTC_NS, GLOBAL_GRTC_S)
109 GRTC_1 (GLOBAL_GRTC_NS, GLOBAL_GRTC_S)
146 MRAMC110 (GLOBAL_MRAMC110_NS, GLOBAL_MRAMC110_S)
147 MRAMC111 (GLOBAL_MRAMC111_NS, GLOBAL_MRAMC111_S)
197 OTPC (GLOBAL_OTPC_S)
200 VPR120 (GLOBAL_VPR120_NS, GLOBAL_VPR120_S)
209 IPCT120_0 (GLOBAL_IPCT120_NS, GLOBAL_IPCT120_S)
212 VPR121 (GLOBAL_VPR121_NS, GLOBAL_VPR121_S)
226 TIMER120 (GLOBAL_TIMER120_NS, GLOBAL_TIMER120_S)
230 SPIM120_SPIS120_UARTE120 (GLOBAL_SPIM120_NS, GLOBAL_SPIS120_NS, GLOBAL_UARTE120_NS, GLOBAL_SPIM120_S, GLOBAL_SPIS120_S, GLOBAL_UARTE120_S)
264 VPR130 (GLOBAL_VPR130_NS, GLOBAL_VPR130_S)
266 AHBBUFFER_APP (GLOBAL_AHBBUFFER_APP_NS, GLOBAL_AHBBUFFER_APP_S)
268 AHBBUFFER_CELL (GLOBAL_AHBBUFFER_CELL_NS, GLOBAL_AHBBUFFER_CELL_S)
289 IPCT130_0 (GLOBAL_IPCT130_NS, GLOBAL_IPCT130_S)
296 RTC130 (GLOBAL_RTC130_NS, GLOBAL_RTC130_S)
299 WDT131 (GLOBAL_WDT131_NS, GLOBAL_WDT131_S)
300 WDT132 (GLOBAL_WDT132_NS, GLOBAL_WDT132_S)
301 EGU130 (GLOBAL_EGU130_NS, GLOBAL_EGU130_S)
329 RESETHUB (GLOBAL_RESETHUB_S)
343 AUDIOPLL (GLOBAL_AUDIOPLL_NS, GLOBAL_AUDIOPLL_S)
360 AUDIOPLLPM (GLOBAL_AUDIOPLLPM_NS, GLOBAL_AUDIOPLLPM_S)
386 SAADC (GLOBAL_SAADC_NS, GLOBAL_SAADC_S)
388 TEMP (GLOBAL_TEMP_NS, GLOBAL_TEMP_S)
389 NFCT (GLOBAL_NFCT_NS, GLOBAL_NFCT_S)
403 PDM (GLOBAL_PDM_NS, GLOBAL_PDM_S)
406 SIMIF130 (GLOBAL_SIMIF130_NS, GLOBAL_SIMIF130_S)
411 MIPIRFFE (GLOBAL_MIPIRFFE_NS, GLOBAL_MIPIRFFE_S)
418 TIMER130 (GLOBAL_TIMER130_NS, GLOBAL_TIMER130_S)
419 TIMER131 (GLOBAL_TIMER131_NS, GLOBAL_TIMER131_S)
420 PWM130 (GLOBAL_PWM130_NS, GLOBAL_PWM130_S)
421 SERIAL0 (GLOBAL_SPIM130_NS, GLOBAL_SPIS130_NS, GLOBAL_TWIM130_NS, GLOBAL_TWIS130_NS, GLOBAL_UARTE130_NS, GLOBAL_SPIM130_S, GLOBAL_SPIS130_S, GLOBAL_TWIM130_S, GLOBAL_TWIS130_S, GLOBAL_UARTE130_S)
422 SERIAL1 (GLOBAL_SPIM131_NS, GLOBAL_SPIS131_NS, GLOBAL_TWIM131_NS, GLOBAL_TWIS131_NS, GLOBAL_UARTE131_NS, GLOBAL_SPIM131_S, GLOBAL_SPIS131_S, GLOBAL_TWIM131_S, GLOBAL_TWIS131_S, GLOBAL_UARTE131_S)
434 TIMER132 (GLOBAL_TIMER132_NS, GLOBAL_TIMER132_S)
435 TIMER133 (GLOBAL_TIMER133_NS, GLOBAL_TIMER133_S)
436 PWM131 (GLOBAL_PWM131_NS, GLOBAL_PWM131_S)
437 SERIAL2 (GLOBAL_SPIM132_NS, GLOBAL_SPIS132_NS, GLOBAL_TWIM132_NS, GLOBAL_TWIS132_NS, GLOBAL_UARTE132_NS, GLOBAL_SPIM132_S, GLOBAL_SPIS132_S, GLOBAL_TWIM132_S, GLOBAL_TWIS132_S, GLOBAL_UARTE132_S)
438 SERIAL3 (GLOBAL_SPIM133_NS, GLOBAL_SPIS133_NS, GLOBAL_TWIM133_NS, GLOBAL_TWIS133_NS, GLOBAL_UARTE133_NS, GLOBAL_SPIM133_S, GLOBAL_SPIS133_S, GLOBAL_TWIM133_S, GLOBAL_TWIS133_S, GLOBAL_UARTE133_S)

## Further device data
MaxInterrupts=480

## Licence text in the file
Copyright (c) 2010 - 2025, Nordic Semiconductor ASA All rights reserved. Redistribution and use in source and binary forms, with or without modification, are permitted provided that the following conditions are met: 1. Redistributions of source code must retain the above copyright notice, this list of conditions and the following disclaimer. 2. Redistributions in binary form, except as embedded into a Nordic Semiconductor ASA integrated circuit in a product or a software update for such product, must reproduce the above copyright notice, this list of conditions and the following disclaimer in the documentation and/or other materials provided with the distribution. 3. Neither the name of Nordic Semiconductor ASA nor the names of its contributors may be used to endorse or promote products derived from this software without specific prior written permission. 4. This software, with or without modification, must only be used with a Nordic Semiconductor ASA integrated circuit. 5. Any software provided in binary form under this license must not be reverse engineered, decompiled, modified and/or disassembled. THIS SOFTWARE IS PROVIDED BY NORDIC SEMICONDUCTOR ASA "AS IS" AND ANY EXPRESS OR IMPLIED WARRANTIES, INCLUDING, BUT NOT LIMITED TO, THE IMPLIED WARRANTIES OF MERCHANTABILITY, NONINFRINGEMENT, AND FITNESS FOR A PARTICULAR PURPOSE ARE DISCLAIMED. IN NO EVENT SHALL NORDIC SEMICONDUCTOR ASA OR CONTRIBUTORS BE LIABLE FOR ANY DIRECT, INDIRECT, INCIDENTAL, SPECIAL, EXEMPLARY, OR CONSEQUENTIAL DAMAGES (INCLUDING, BUT NOT LIMITED TO, PROCUREMENT OF SUBSTITUTE GOODS OR SERVICES; LOSS OF USE, DATA, OR PROFITS; OR BUSINESS INTERRUPTION) HOWEVER CAUSED AND ON ANY THEORY OF LIABILITY, WHETHER IN CONTRACT, STRICT LIABILITY, OR TORT (INCLUDING NEGLIGENCE OR OTHERWISE) ARISING IN ANY WAY OUT OF THE USE OF THIS SOFTWARE, EVEN IF ADVISED OF THE POSSIBILITY OF SUCH DAMAGE.
