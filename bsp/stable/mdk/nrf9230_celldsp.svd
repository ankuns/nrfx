# nrf9230_celldsp register map
Vendor: Nordic Semiconductor; Series: nRF92; File version: 1
nRF9230 reference description for system-on-chip with many ARM 32-bit Cortex-M33 microcontrollers
Registers are 32-bit, read-write, reset 0x0 unless marked. A register's access mark holds for its fields unless they carry their own. Offsets are from the block's base; lines under a group give offsets from that group; [hi:lo] are bit positions; {n}, {i} and the like mark numbered series; 'fields as' and 'values as' point back to an identical list; <NAME> marks a mode.

## Memory map
0x0FFFE000 GLOBAL_FICR size 0xC00 — Factory Information Configuration Registers
0x2A000000 LSTMDATA size 0x10000000 — System Trace Macrocell data buffer 0
0x2F700000 GLOBAL_USBHSCORE0 size 0x24000 — USBHSCORE
0x2FBE0000 GLOBAL_I3CCORE120 size 0x1000 — I3CCORE 0
0x2FBE1000 GLOBAL_I3CCORE121 size 0x1000 — I3CCORE 1
0x2FBEF800 GLOBAL_DMU120 size 0x1000 — DMU 0
0x2FBEF800 GLOBAL_MCAN120 size 0x1000 — MCAN 0
0x2FBF7800 GLOBAL_DMU121 size 0x1000 — DMU 1
0x2FBF7800 GLOBAL_MCAN121 size 0x1000 — MCAN 1
0x45000000 HSFLL size 0x1000
0x45001000 LRCCONF0 size 0x1000
0x45002000 MPC size 0x1000 — Memory Privilege Controller
0x45003000 MVDMA size 0x1000 — MVDMA performs direct-memory-accesses between memories. Data is transferred according to job descriptor lists. Each transfer has corresponding source and sink descriptor lists with matching data amounts. The lists are in memory and they contain data buffer information, address pointers, buffer sizes and data type attributes.
0x45004000 RAMC00 size 0x1000 — RAM Controller 0
0x45005000 RAMC10 size 0x1000 — RAM Controller 1
0x45006000 RAMC20 size 0x1000 — RAM Controller 2
0x45007000 PPIBUS size 0x1000 — Programmable Peripheral Interconnect Bus
0x45008000 DSPINTMAP size 0x1000 — DSP interrupt mapper
0x45009000 TURBO1 size 0x1000 — Decoding 0
0x4500A000 LTEFE size 0x1000 — LTE Front End
0x4500B000 TURBO0 size 0x1000 — Decoding 1
0x4500C000 HARQ size 0x1000 — LTE HARQ
0x4500D000 VITERBI size 0x1000
0x4500E000 PPIB0 size 0x1000 — PPIB APB registers 0
0x4500F000 DECTSYNC size 0x1000 — GENERIC
0x45010000 LRCCONF1 size 0x1000
0x45011000 CPUCONF size 0x1000 — CPU Configuration
0x45012000 MEMCONF size 0x1000 — Memory configuration
0x45013000 IPCT size 0x1000 — IPCT APB registers
0x45014000 DSPCTRL size 0x1000 — DSP control
0x45015000 PCGCM0 size 0x1000 — PCGC Master 0
0x45016000 PPIB1 size 0x1000 — PPIB APB registers 1
0x45017000 ABB size 0x1000 — ABB peripheral
0x45020000 CTI0 size 0x1000 — Cross-Trigger Interface control 2
0x45021000 DPPIC size 0x1000 — Distributed programmable peripheral interconnect controller
0x45022000 PCGCS0 size 0x1000 — PCGCSlave
0x45023000 PCGCM1 size 0x1000 — PCGC Master 1
0x45024000 LSTM size 0x1000 — System Trace Macrocell 1
0x45025000 ETM size 0x1000 — Embedded Trace Macrocell
0x45026000 CTI1 size 0x1000 — Cross-Trigger Interface control 3
0x45027000 TRACEDELAYREG size 0x1000 — Trace delay register
0x45028000 GNSSFE size 0x1000 — Position Front End 0
0x45029000 WIFIBFE size 0x1000 — Position Front End 1
0x4502A000 WIFIGNFE size 0x1000 — Position Front End 2
0x4F09D000 BELLBOARD size 0x1000 — BELLBOARD APB registers
0x4F8D2000 GLOBAL_MUTEX120 size 0x1000 — MUTEX 0
0x4F8D2000 GLOBAL_PROTOTYPE size 0x1000 — Prototype HW information registers.
0x4F927000 GLOBAL_MUTEX130 size 0x1000 — MUTEX 1
0x5F086000 GLOBAL_USBHS size 0x1000 — USBHS
0x5F092000 GLOBAL_MRAMC110 size 0x1000 — MRAM controller 0
0x5F093000 GLOBAL_MRAMC111 size 0x1000 — MRAM controller 1
0x5F095000 GLOBAL_EXMIF size 0x1000 — External Memory Interface
0x5F8C2000 GLOBAL_CANPLL size 0x1000 — AUXPLL 0
0x5F8C2000 GLOBAL_CANPLLPM size 0x1000 — AUXPM 0
0x5F8C5000 GLOBAL_OTPC size 0x1000 — OTP controller
0x5F8C8000 GLOBAL_VPR120 size 0x1000 — VPR peripheral registers 0
0x5F8CC000 GLOBAL_HSFLL121 size 0x1000 — HSFLL
0x5F8D1000 GLOBAL_IPCT120 size 0x1000 — IPCT APB registers 0
0x5F8D3000 GLOBAL_I3C120 size 0x1000 — I3C 0
0x5F8D4000 GLOBAL_VPR121 size 0x1000 — VPR peripheral registers 1
0x5F8D8000 GLOBAL_CAN120 size 0x1000 — Controller Area Network 0
0x5F8D9000 GLOBAL_MVDMA120 size 0x1000 — MVDMA performs direct-memory-accesses between memories. Data is transferred according to job descriptor lists. Each transfer has corresponding source and sink descriptor lists with matching data amounts. The lists are in memory and they contain data buffer information, address pointers, buffer sizes and data type attributes. 0
0x5F8DA000 GLOBAL_RAMC122 size 0x1000 — RAM Controller 0
0x5F8DB000 GLOBAL_CAN121 size 0x1000 — Controller Area Network 1
0x5F8DC000 GLOBAL_MVDMA121 size 0x1000 — MVDMA performs direct-memory-accesses between memories. Data is transferred according to job descriptor lists. Each transfer has corresponding source and sink descriptor lists with matching data amounts. The lists are in memory and they contain data buffer information, address pointers, buffer sizes and data type attributes. 1
0x5F8DD000 GLOBAL_RAMC123 size 0x1000 — RAM Controller 1
0x5F8DE000 GLOBAL_I3C121 size 0x1000 — I3C 1
0x5F8E1000 GLOBAL_DPPIC120 size 0x1000 — Distributed programmable peripheral interconnect controller 0
0x5F8E2000 GLOBAL_TIMER120 size 0x1000 — Timer/Counter 0
0x5F8E3000 GLOBAL_TIMER121 size 0x1000 — Timer/Counter 1
0x5F8E4000 GLOBAL_PWM120 size 0x1000 — Pulse width modulation unit 0
0x5F8E5000 GLOBAL_SPIS120 size 0x1000 — SPI Slave 0
0x5F8E6000 GLOBAL_SPIM120 size 0x1000 — Serial Peripheral Interface Master with EasyDMA 0
0x5F8E6000 GLOBAL_UARTE120 size 0x1000 — UART with EasyDMA 0
0x5F8E7000 GLOBAL_SPIM121 size 0x1000 — Serial Peripheral Interface Master with EasyDMA 1
0x5F8E8000 GLOBAL_TWIM120 size 0x1000 — I2C compatible Two-Wire Master Interface with EasyDMA 0
0x5F908000 GLOBAL_VPR130 size 0x1000 — VPR peripheral registers 2
0x5F921000 GLOBAL_IPCT130 size 0x1000 — IPCT APB registers 1
0x5F922000 GLOBAL_DPPIC130 size 0x1000 — Distributed programmable peripheral interconnect controller 1
0x5F928000 GLOBAL_RTC130 size 0x1000 — Real-time counter 0
0x5F929000 GLOBAL_RTC131 size 0x1000 — Real-time counter 1
0x5F92B000 GLOBAL_WDT131 size 0x1000 — Watchdog Timer 0
0x5F92C000 GLOBAL_WDT132 size 0x1000 — Watchdog Timer 1
0x5F92D000 GLOBAL_EGU130 size 0x1000 — Event generator unit
0x5F934000 GLOBAL_GPIOTE130 size 0x1000 — GPIO Tasks and Events 0
0x5F935000 GLOBAL_GPIOTE131 size 0x1000 — GPIO Tasks and Events 1
0x5F938000 GLOBAL_P0 size 0x200 — GPIO Port 0
0x5F938200 GLOBAL_P1 size 0x200 — GPIO Port 1
0x5F938400 GLOBAL_P2 size 0x200 — GPIO Port 2
0x5F938C00 GLOBAL_P6 size 0x200 — GPIO Port 3
0x5F939000 GLOBAL_P8 size 0x200 — GPIO Port 4
0x5F939200 GLOBAL_P9 size 0x200 — GPIO Port 5
0x5F939400 GLOBAL_P10 size 0x200 — GPIO Port 6
0x5F939600 GLOBAL_P11 size 0x200 — GPIO Port 7
0x5F939800 GLOBAL_P12 size 0x200 — GPIO Port 8
0x5F939A00 GLOBAL_P13 size 0x200 — GPIO Port 9
0x5F939E00 GLOBAL_GPIOINTERNAL size 0x2000 — GPIO Internal
0x5F949000 GLOBAL_RESETHUB size 0x1000 — Reset hub
0x5F957000 GLOBAL_AUDIOPLL size 0x1000 — AUXPLL 1
0x5F958000 GLOBAL_USBHSPLL size 0x1000 — AUXPLL 2
0x5F967000 GLOBAL_VREGUSB size 0x1000 — VREGUSB peripheral
0x5F968000 GLOBAL_AUDIOPLLPM size 0x1000 — AUXPM 1
0x5F981000 GLOBAL_DPPIC131 size 0x1000 — Distributed programmable peripheral interconnect controller 2
0x5F982000 GLOBAL_SAADC size 0x1000 — Analog to Digital Converter
0x5F983000 GLOBAL_COMP size 0x1000 — Comparator
0x5F983000 GLOBAL_LPCOMP size 0x1000 — Low-power comparator
0x5F984000 GLOBAL_TEMP size 0x1000 — Temperature Sensor
0x5F991000 GLOBAL_DPPIC132 size 0x1000 — Distributed programmable peripheral interconnect controller 3
0x5F992000 GLOBAL_TDM130 size 0x1000 — Time division multiplexed audio interface 0
0x5F993000 GLOBAL_PDM size 0x1000 — Pulse Density Modulation (Digital Microphone) Interface
0x5F994000 GLOBAL_QDEC130 size 0x1000 — Quadrature Decoder 0
0x5F995000 GLOBAL_QDEC131 size 0x1000 — Quadrature Decoder 1
0x5F996000 GLOBAL_SIMIF130 size 0x1000 — SIM card interface 0
0x5F997000 GLOBAL_TDM131 size 0x1000 — Time division multiplexed audio interface 1
0x5F99A000 GLOBAL_SIMIF131 size 0x1000 — SIM card interface 1
0x5F99B000 GLOBAL_MIPIRFFE size 0x1000 — MipiRffe Master
0x5F99C000 GLOBAL_GRTC size 0x1000 — Global Real-time counter
0x5F9A1000 GLOBAL_DPPIC133 size 0x1000 — Distributed programmable peripheral interconnect controller 4
0x5F9A2000 GLOBAL_TIMER130 size 0x1000 — Timer/Counter 2
0x5F9A3000 GLOBAL_TIMER131 size 0x1000 — Timer/Counter 3
0x5F9A4000 GLOBAL_PWM130 size 0x1000 — Pulse width modulation unit 1
0x5F9A5000 GLOBAL_SPIM130 size 0x1000 — Serial Peripheral Interface Master with EasyDMA 2
0x5F9A5000 GLOBAL_SPIS130 size 0x1000 — SPI Slave 1
0x5F9A5000 GLOBAL_TWIM130 size 0x1000 — I2C compatible Two-Wire Master Interface with EasyDMA 1
0x5F9A5000 GLOBAL_TWIS130 size 0x1000 — I2C compatible Two-Wire Slave Interface with EasyDMA 0
0x5F9A5000 GLOBAL_UARTE130 size 0x1000 — UART with EasyDMA 1
0x5F9A6000 GLOBAL_SPIM131 size 0x1000 — Serial Peripheral Interface Master with EasyDMA 3
0x5F9A6000 GLOBAL_SPIS131 size 0x1000 — SPI Slave 2
0x5F9A6000 GLOBAL_TWIM131 size 0x1000 — I2C compatible Two-Wire Master Interface with EasyDMA 2
0x5F9A6000 GLOBAL_TWIS131 size 0x1000 — I2C compatible Two-Wire Slave Interface with EasyDMA 1
0x5F9A6000 GLOBAL_UARTE131 size 0x1000 — UART with EasyDMA 2
0x5F9B1000 GLOBAL_DPPIC134 size 0x1000 — Distributed programmable peripheral interconnect controller 5
0x5F9B2000 GLOBAL_TIMER132 size 0x1000 — Timer/Counter 4
0x5F9B3000 GLOBAL_TIMER133 size 0x1000 — Timer/Counter 5
0x5F9B4000 GLOBAL_PWM131 size 0x1000 — Pulse width modulation unit 2
0x5F9B5000 GLOBAL_SPIM132 size 0x1000 — Serial Peripheral Interface Master with EasyDMA 4
0x5F9B5000 GLOBAL_SPIS132 size 0x1000 — SPI Slave 3
0x5F9B5000 GLOBAL_TWIM132 size 0x1000 — I2C compatible Two-Wire Master Interface with EasyDMA 3
0x5F9B5000 GLOBAL_TWIS132 size 0x1000 — I2C compatible Two-Wire Slave Interface with EasyDMA 2
0x5F9B5000 GLOBAL_UARTE132 size 0x1000 — UART with EasyDMA 3
0x5F9B6000 GLOBAL_SPIM133 size 0x1000 — Serial Peripheral Interface Master with EasyDMA 5
0x5F9B6000 GLOBAL_SPIS133 size 0x1000 — SPI Slave 4
0x5F9B6000 GLOBAL_TWIM133 size 0x1000 — I2C compatible Two-Wire Master Interface with EasyDMA 4
0x5F9B6000 GLOBAL_TWIS133 size 0x1000 — I2C compatible Two-Wire Slave Interface with EasyDMA 3
0x5F9B6000 GLOBAL_UARTE133 size 0x1000 — UART with EasyDMA 4
0x5F9C1000 GLOBAL_DPPIC135 size 0x1000 — Distributed programmable peripheral interconnect controller 6
0x5F9C2000 GLOBAL_TIMER134 size 0x1000 — Timer/Counter 6
0x5F9C3000 GLOBAL_TIMER135 size 0x1000 — Timer/Counter 7
0x5F9C4000 GLOBAL_PWM132 size 0x1000 — Pulse width modulation unit 3
0x5F9C5000 GLOBAL_SPIM134 size 0x1000 — Serial Peripheral Interface Master with EasyDMA 6
0x5F9C5000 GLOBAL_SPIS134 size 0x1000 — SPI Slave 5
0x5F9C5000 GLOBAL_TWIM134 size 0x1000 — I2C compatible Two-Wire Master Interface with EasyDMA 5
0x5F9C5000 GLOBAL_TWIS134 size 0x1000 — I2C compatible Two-Wire Slave Interface with EasyDMA 4
0x5F9C5000 GLOBAL_UARTE134 size 0x1000 — UART with EasyDMA 5
0x5F9C6000 GLOBAL_SPIM135 size 0x1000 — Serial Peripheral Interface Master with EasyDMA 7
0x5F9C6000 GLOBAL_SPIS135 size 0x1000 — SPI Slave 6
0x5F9C6000 GLOBAL_TWIM135 size 0x1000 — I2C compatible Two-Wire Master Interface with EasyDMA 6
0x5F9C6000 GLOBAL_TWIS135 size 0x1000 — I2C compatible Two-Wire Slave Interface with EasyDMA 5
0x5F9C6000 GLOBAL_UARTE135 size 0x1000 — UART with EasyDMA 6
0x5F9D1000 GLOBAL_DPPIC136 size 0x1000 — Distributed programmable peripheral interconnect controller 7
0x5F9D2000 GLOBAL_TIMER136 size 0x1000 — Timer/Counter 8
0x5F9D3000 GLOBAL_TIMER137 size 0x1000 — Timer/Counter 9
0x5F9D4000 GLOBAL_PWM133 size 0x1000 — Pulse width modulation unit 4
0x5F9D5000 GLOBAL_SPIM136 size 0x1000 — Serial Peripheral Interface Master with EasyDMA 8
0x5F9D5000 GLOBAL_SPIS136 size 0x1000 — SPI Slave 7
0x5F9D5000 GLOBAL_TWIM136 size 0x1000 — I2C compatible Two-Wire Master Interface with EasyDMA 7
0x5F9D5000 GLOBAL_TWIS136 size 0x1000 — I2C compatible Two-Wire Slave Interface with EasyDMA 6
0x5F9D5000 GLOBAL_UARTE136 size 0x1000 — UART with EasyDMA 7
0x5F9D6000 GLOBAL_SPIM137 size 0x1000 — Serial Peripheral Interface Master with EasyDMA 9
0x5F9D6000 GLOBAL_SPIS137 size 0x1000 — SPI Slave 8
0x5F9D6000 GLOBAL_TWIM137 size 0x1000 — I2C compatible Two-Wire Master Interface with EasyDMA 8
0x5F9D6000 GLOBAL_TWIS137 size 0x1000 — I2C compatible Two-Wire Slave Interface with EasyDMA 7
0x5F9D6000 GLOBAL_UARTE137 size 0x1000 — UART with EasyDMA 8
0xA0000000 GLOBAL_STMDATA size 0x10000000 — System Trace Macrocell data buffer 1
0xBF001000 GLOBAL_TDDCONF size 0x1000 — TDDCONF
0xBF003000 GLOBAL_TBM size 0x1000 — Trace buffer monitor
0xBF041000 GLOBAL_TSGEN size 0x1000 — Timestamp generator
0xBF042000 GLOBAL_STM size 0x1000 — System Trace Macrocell 0
0xBF043000 GLOBAL_TPIU size 0x1000 — Trace Port Interface Unit
0xBF044000 GLOBAL_ETB size 0x1000 — Embedded Trace Buffer
0xBF045000 GLOBAL_ETR size 0x1000 — Embedded Trace Router
0xBF046000 GLOBAL_CTI210 size 0x1000 — Cross-Trigger Interface control 0
0xBF047000 GLOBAL_CTI211 size 0x1000 — Cross-Trigger Interface control 1
0xBF048000 GLOBAL_ATBREPLICATOR210 size 0x1000 — ATB Replicator module 0
0xBF049000 GLOBAL_ATBREPLICATOR211 size 0x1000 — ATB Replicator module 1
0xBF04A000 GLOBAL_ATBREPLICATOR212 size 0x1000 — ATB Replicator module 2
0xBF04B000 GLOBAL_ATBREPLICATOR213 size 0x1000 — ATB Replicator module 3
0xBF04C000 GLOBAL_ATBFUNNEL210 size 0x1000 — ATB funnel module 0
0xBF04D000 GLOBAL_ATBFUNNEL211 size 0x1000 — ATB funnel module 1
0xBF04E000 GLOBAL_ATBFUNNEL212 size 0x1000 — ATB funnel module 2
0xBF04F000 GLOBAL_ATBFUNNEL213 size 0x1000 — ATB funnel module 3

## Interrupts
2 MPC
3 MVDMA
10 LTEFE_0 (LTEFE)
11 LTEFE_1 (LTEFE)
12 HARQ_0_LTEFE_2 (LTEFE, HARQ)
13 HARQ_1_LTEFE_3_VITERBI_0 (LTEFE, HARQ, VITERBI)
14 HARQ_2_LTEFE_4_VITERBI_1 (LTEFE, HARQ, VITERBI)
15 DECTSYNC_HARQ_3_LTEFE_5_VITERBI_2 (LTEFE, HARQ, VITERBI, DECTSYNC)
16 HARQ_4_LTEFE_6_VITERBI_3 (LTEFE, HARQ, VITERBI)
17 HARQ_5_LTEFE_7 (LTEFE, HARQ)
18 HARQ_6_LTEFE_8 (LTEFE, HARQ)
19 HARQ_7_IPCT_0_LTEFE_9 (LTEFE, HARQ, IPCT)
20 IPCT_1_LTEFE_10 (LTEFE, IPCT)
21 IPCT_2_LTEFE_11 (LTEFE, IPCT)
22 LTEFE_12 (LTEFE)
23 ABB_LTEFE_13 (LTEFE, ABB)
24 LTEFE_14 (LTEFE)
25 LTEFE_15 (LTEFE)
40 GNSSFE_0 (GNSSFE)
41 GNSSFE_1_WIFIBFE_0 (GNSSFE, WIFIBFE)
42 GNSSFE_2_WIFIBFE_1_WIFIGNFE_0 (GNSSFE, WIFIBFE, WIFIGNFE)
43 GNSSFE_3_WIFIBFE_2_WIFIGNFE_1 (GNSSFE, WIFIBFE, WIFIGNFE)
44 GNSSFE_4_WIFIBFE_3_WIFIGNFE_2 (GNSSFE, WIFIBFE, WIFIGNFE)
45 GNSSFE_5_WIFIBFE_4_WIFIGNFE_3 (GNSSFE, WIFIBFE, WIFIGNFE)
46 WIFIBFE_5_WIFIGNFE_4 (WIFIBFE, WIFIGNFE)
47 WIFIGNFE_5 (WIFIGNFE)
96 BELLBOARD_0 (BELLBOARD)
97 BELLBOARD_1 (BELLBOARD)
98 BELLBOARD_2 (BELLBOARD)
99 BELLBOARD_3 (BELLBOARD)
104 GPIOTE130_0 (GLOBAL_GPIOTE130)
105 GPIOTE130_1 (GLOBAL_GPIOTE130)
106 GPIOTE131_0 (GLOBAL_GPIOTE131)
107 GPIOTE131_1 (GLOBAL_GPIOTE131)
108 GRTC_0 (GLOBAL_GRTC)
109 GRTC_1 (GLOBAL_GRTC)
110 GRTC_2 (GLOBAL_GRTC)
127 TBM (GLOBAL_TBM)
134 USBHS (GLOBAL_USBHS)
146 MRAMC110 (GLOBAL_MRAMC110)
147 MRAMC111 (GLOBAL_MRAMC111)
149 EXMIF (GLOBAL_EXMIF)
197 OTPC (GLOBAL_OTPC)
200 VPR120 (GLOBAL_VPR120)
209 IPCT120_0 (GLOBAL_IPCT120)
211 I3C120 (GLOBAL_I3C120)
212 VPR121 (GLOBAL_VPR121)
216 CAN120 (GLOBAL_CAN120)
217 MVDMA120 (GLOBAL_MVDMA120)
219 CAN121 (GLOBAL_CAN121)
220 MVDMA121 (GLOBAL_MVDMA121)
222 I3C121 (GLOBAL_I3C121)
226 TIMER120 (GLOBAL_TIMER120)
227 TIMER121 (GLOBAL_TIMER121)
228 PWM120 (GLOBAL_PWM120)
229 SPIS120 (GLOBAL_SPIS120)
230 SPIM120_UARTE120 (GLOBAL_SPIM120, GLOBAL_UARTE120)
231 SPIM121 (GLOBAL_SPIM121)
232 TWIM120 (GLOBAL_TWIM120)
264 VPR130 (GLOBAL_VPR130)
289 IPCT130_0 (GLOBAL_IPCT130)
296 RTC130 (GLOBAL_RTC130)
297 RTC131 (GLOBAL_RTC131)
299 WDT131 (GLOBAL_WDT131)
300 WDT132 (GLOBAL_WDT132)
301 EGU130 (GLOBAL_EGU130)
329 RESETHUB (GLOBAL_RESETHUB)
343 AUDIOPLL (GLOBAL_AUDIOPLL)
344 USBHSPLL (GLOBAL_USBHSPLL)
359 VREGUSB (GLOBAL_VREGUSB)
360 AUDIOPLLPM (GLOBAL_AUDIOPLLPM)
386 SAADC (GLOBAL_SAADC)
387 COMP_LPCOMP (GLOBAL_COMP, GLOBAL_LPCOMP)
388 TEMP (GLOBAL_TEMP)
402 TDM130 (GLOBAL_TDM130)
403 PDM (GLOBAL_PDM)
404 QDEC130 (GLOBAL_QDEC130)
405 QDEC131 (GLOBAL_QDEC131)
406 SIMIF130 (GLOBAL_SIMIF130)
407 TDM131 (GLOBAL_TDM131)
410 SIMIF131 (GLOBAL_SIMIF131)
411 MIPIRFFE (GLOBAL_MIPIRFFE)
418 TIMER130 (GLOBAL_TIMER130)
419 TIMER131 (GLOBAL_TIMER131)
420 PWM130 (GLOBAL_PWM130)
421 SERIAL0 (GLOBAL_SPIM130, GLOBAL_SPIS130, GLOBAL_TWIM130, GLOBAL_TWIS130, GLOBAL_UARTE130)
422 SERIAL1 (GLOBAL_SPIM131, GLOBAL_SPIS131, GLOBAL_TWIM131, GLOBAL_TWIS131, GLOBAL_UARTE131)
434 TIMER132 (GLOBAL_TIMER132)
435 TIMER133 (GLOBAL_TIMER133)
436 PWM131 (GLOBAL_PWM131)
437 SERIAL2 (GLOBAL_SPIM132, GLOBAL_SPIS132, GLOBAL_TWIM132, GLOBAL_TWIS132, GLOBAL_UARTE132)
438 SERIAL3 (GLOBAL_SPIM133, GLOBAL_SPIS133, GLOBAL_TWIM133, GLOBAL_TWIS133, GLOBAL_UARTE133)
450 TIMER134 (GLOBAL_TIMER134)
451 TIMER135 (GLOBAL_TIMER135)
452 PWM132 (GLOBAL_PWM132)
453 SERIAL4 (GLOBAL_SPIM134, GLOBAL_SPIS134, GLOBAL_TWIM134, GLOBAL_TWIS134, GLOBAL_UARTE134)
454 SERIAL5 (GLOBAL_SPIM135, GLOBAL_SPIS135, GLOBAL_TWIM135, GLOBAL_TWIS135, GLOBAL_UARTE135)
466 TIMER136 (GLOBAL_TIMER136)
467 TIMER137 (GLOBAL_TIMER137)
468 PWM133 (GLOBAL_PWM133)
469 SERIAL6 (GLOBAL_SPIM136, GLOBAL_SPIS136, GLOBAL_TWIM136, GLOBAL_TWIS136, GLOBAL_UARTE136)
470 SERIAL7 (GLOBAL_SPIM137, GLOBAL_SPIS137, GLOBAL_TWIM137, GLOBAL_TWIS137, GLOBAL_UARTE137)

## Further device data
MaxInterrupts=64

## Licence text in the file
Copyright (c) 2010 - 2024, Nordic Semiconductor ASA All rights reserved. Redistribution and use in source and binary forms, with or without modification, are permitted provided that the following conditions are met: 1. Redistributions of source code must retain the above copyright notice, this list of conditions and the following disclaimer. 2. Redistributions in binary form, except as embedded into a Nordic Semiconductor ASA integrated circuit in a product or a software update for such product, must reproduce the above copyright notice, this list of conditions and the following disclaimer in the documentation and/or other materials provided with the distribution. 3. Neither the name of Nordic Semiconductor ASA nor the names of its contributors may be used to endorse or promote products derived from this software without specific prior written permission. 4. This software, with or without modification, must only be used with a Nordic Semiconductor ASA integrated circuit. 5. Any software provided in binary form under this license must not be reverse engineered, decompiled, modified and/or disassembled. THIS SOFTWARE IS PROVIDED BY NORDIC SEMICONDUCTOR ASA "AS IS" AND ANY EXPRESS OR IMPLIED WARRANTIES, INCLUDING, BUT NOT LIMITED TO, THE IMPLIED WARRANTIES OF MERCHANTABILITY, NONINFRINGEMENT, AND FITNESS FOR A PARTICULAR PURPOSE ARE DISCLAIMED. IN NO EVENT SHALL NORDIC SEMICONDUCTOR ASA OR CONTRIBUTORS BE LIABLE FOR ANY DIRECT, INDIRECT, INCIDENTAL, SPECIAL, EXEMPLARY, OR CONSEQUENTIAL DAMAGES (INCLUDING, BUT NOT LIMITED TO, PROCUREMENT OF SUBSTITUTE GOODS OR SERVICES; LOSS OF USE, DATA, OR PROFITS; OR BUSINESS INTERRUPTION) HOWEVER CAUSED AND ON ANY THEORY OF LIABILITY, WHETHER IN CONTRACT, STRICT LIABILITY, OR TORT (INCLUDING NEGLIGENCE OR OTHERWISE) ARISING IN ANY WAY OUT OF THE USE OF THIS SOFTWARE, EVEN IF ADVISED OF THE POSSIBILITY OF SUCH DAMAGE.
