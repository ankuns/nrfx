# nrf7140_secure register map
Vendor: Nordic Semiconductor; Series: nRF71; File version: 1
nRF7140 is an ultra-low power multi-core System on Chip (SoC)
CPU: CM33 r0p4, little endian, MPU, no FPU, 3 interrupt priority bits, 480 interrupts, 8 SAU regions
Registers are 32-bit, read-write, reset 0x0 unless marked. A register's access mark holds for its fields unless they carry their own. Offsets are from the block's base; lines under a group give offsets from that group; [hi:lo] are bit positions; {n}, {i} and the like mark numbered series; 'fields as' and 'values as' point back to an identical list; <NAME> marks a mode.

## Memory map
0x01F00000 ICACHEDATA_S size 0x1000 — CACHEDATA
0x01F10000 ICACHEINFO_S size 0x1000 — CACHEINFO
0x0E000000 SICR_S size 0x1000 — Secure Information Configuration Registers
0x0FFFC000 RICR_S size 0x1000 — ROM Information Configuration Registers
0x0FFFE000 GLOBAL_FICR_NS size 0xC00 — Factory Information Configuration Registers
0x21F00000 DCACHEDATA_S size 0x1000 — CACHEDATA
0x21F10000 DCACHEINFO_S size 0x1000 — CACHEINFO
0x2F700000 GLOBAL_USBHSCORE0_NS size 0x24000 — USBHSCORE 0
0x2F700000 GLOBAL_USBHSCORE0_S size 0x24000 — USBHSCORE 1
0x2FBE0000 GLOBAL_I3CCORE120_NS size 0x1000 — I3CCORE 0
0x2FBE1000 GLOBAL_I3CCORE121_NS size 0x1000 — I3CCORE 1
0x2FBEF800 GLOBAL_DMU120_NS size 0x1000 — DMU 0
0x2FBEF800 GLOBAL_MCAN120_NS size 0x1000 — MCAN 0
0x2FBF7800 GLOBAL_DMU121_NS size 0x1000 — DMU 1
0x2FBF7800 GLOBAL_MCAN121_NS size 0x1000 — MCAN 1
0x41003000 MVDMA_NS size 0x1000 — MVDMA performs direct-memory-accesses between memories. Data is transferred according to job descriptor lists. Each transfer has corresponding source and sink descriptor lists with matching data amounts. The lists are in memory and they contain data buffer information, address pointers, buffer sizes and data type attributes. 0
0x41005000 ROMC_NS size 0x1000 — ROM Controller 0
0x41007000 RAMC001_NS size 0x1000 — RAM Controller 1
0x41011000 CPUCONF_NS size 0x1000 — CPU Configuration 0
0x41012000 MEMCONF_NS size 0x1000 — Memory configuration 1
0x41013000 IPCT_NS size 0x1000 — IPCT APB registers 0
0x41014000 WDT010_NS size 0x1000 — Watchdog Timer 0
0x41015000 WDT011_NS size 0x1000 — Watchdog Timer 2
0x41017000 MUTEX_NS size 0x1000 — MUTEX 0
{0x42058000+0x1000*n} SWI{n}_NS size 0x1000 (n=0..7) — Software interrupt {n}
0x49000000 GLOBAL_GPU_NS size 0x2000 — GPU
0x49004000 GLOBAL_DISPC_NS size 0x2000 — DISPC
0x49008000 GLOBAL_GSI_NS size 0x3000 — GSI
0x4900B000 GLOBAL_GFXPLL_NS size 0x1000 — AUXPLL
0x4900C000 GLOBAL_GFXPLLPM_NS size 0x1000 — AUXPM
0x4900CF00 GLOBAL_PCGCSBUS_NS size 0x1000 — PCGCSlave
0x4900D000 GLOBAL_HSFLL300_NS size 0x1000 — HSFLL 0
0x4900E000 GLOBAL_LRCCONF300_NS size 0x1000 — LRCCONF 0
0x4900F000 GLOBAL_PCGCM300_NS size 0x1000 — PCGC Master 0
0x49011000 GLOBAL_MEMCONF310_NS size 0x1000 — Memory configuration
0x49012000 GLOBAL_VREGGFX_NS size 0x1000 — VREGVS0V8 peripheral
0x4901E000 GLOBAL_LRCCONF310_NS size 0x1000 — LRCCONF 1
0x4901F000 GLOBAL_PCGCM310_NS size 0x1000 — PCGC Master 1
0x4F086000 GLOBAL_USBHS_NS size 0x1000 — USBHS 0
0x4F092000 GLOBAL_MRAMC110_NS size 0x1000 — MRAM controller 0
0x4F093000 GLOBAL_MRAMC111_NS size 0x1000 — MRAM controller 2
0x4F095000 GLOBAL_EXMIF_NS size 0x1000 — External Memory Interface 0
0x4F099000 BELLBOARD_NS size 0x1000 — BELLBOARD APB registers 0
0x4F8C2000 GLOBAL_CANPLL_NS size 0x1000 — AUXPLL 0
0x4F8C8000 GLOBAL_VPR120_NS size 0x1000 — VPR peripheral registers 0
0x4F8C9000 GLOBAL_SDCARD_NS size 0x1000 — SD-Card and eMMC 0
0x4F8CA000 GLOBAL_LRCCONF_SDCARD_NS size 0x1000 — LRCCONF
0x4F8CB000 GLOBAL_HSFLL122_NS size 0x1000 — HSFLL 1
0x4F8CC000 GLOBAL_HSFLL121_NS size 0x1000 — HSFLL 3
0x4F8D1000 GLOBAL_IPCT120_NS size 0x1000 — IPCT APB registers 0
0x4F8D2000 GLOBAL_MUTEX120_NS size 0x1000 — MUTEX 0
0x4F8D2000 GLOBAL_PROTOTYPE_NS size 0x1000 — Prototype HW information registers.
0x4F8D3000 GLOBAL_I3C120_NS size 0x1000 — I3C 0
0x4F8D4000 GLOBAL_VPR121_NS size 0x1000 — VPR peripheral registers 2
0x4F8D7000 GLOBAL_QSPI120_NS size 0x1000 — Quad serial peripheral interface 0
0x4F8D8000 GLOBAL_CAN120_NS size 0x1000 — Controller Area Network 0
0x4F8D9000 GLOBAL_MVDMA120_NS size 0x1000 — MVDMA performs direct-memory-accesses between memories. Data is transferred according to job descriptor lists. Each transfer has corresponding source and sink descriptor lists with matching data amounts. The lists are in memory and they contain data buffer information, address pointers, buffer sizes and data type attributes. 0
0x4F8DA000 GLOBAL_RAMC122_NS size 0x1000 — RAM Controller 0
0x4F8DB000 GLOBAL_CAN121_NS size 0x1000 — Controller Area Network 2
0x4F8DC000 GLOBAL_MVDMA121_NS size 0x1000 — MVDMA performs direct-memory-accesses between memories. Data is transferred according to job descriptor lists. Each transfer has corresponding source and sink descriptor lists with matching data amounts. The lists are in memory and they contain data buffer information, address pointers, buffer sizes and data type attributes. 2
0x4F8DD000 GLOBAL_RAMC123_NS size 0x1000 — RAM Controller 2
0x4F8DE000 GLOBAL_I3C121_NS size 0x1000 — I3C 2
0x4F8DF000 GLOBAL_QSPI121_NS size 0x1000 — Quad serial peripheral interface 2
0x4F8E1000 GLOBAL_DPPIC120_NS size 0x1000 — Distributed programmable peripheral interconnect controller 0
0x4F8E2000 GLOBAL_TIMER120_NS size 0x1000 — Timer/Counter 0
0x4F8E3000 GLOBAL_TIMER121_NS size 0x1000 — Timer/Counter 2
0x4F8E4000 GLOBAL_PWM120_NS size 0x1000 — Pulse width modulation unit 0
0x4F8E5000 GLOBAL_SPIS120_NS size 0x1000 — SPI Slave 0
0x4F8E6000 GLOBAL_SPIM120_NS size 0x1000 — Serial Peripheral Interface Master with EasyDMA 0
0x4F8E6000 GLOBAL_UARTE120_NS size 0x1000 — UART with EasyDMA 0
0x4F8E7000 GLOBAL_SPIM121_NS size 0x1000 — Serial Peripheral Interface Master with EasyDMA 2
0x4F8E8000 GLOBAL_SPIM122_NS size 0x1000 — Serial Peripheral Interface Master with EasyDMA 4
0x4F8E9000 GLOBAL_SPIM123_NS size 0x1000 — Serial Peripheral Interface Master with EasyDMA 6
0x4F908000 GLOBAL_VPR130_NS size 0x1000 — VPR peripheral registers 4
0x4F921000 GLOBAL_IPCT130_NS size 0x1000 — IPCT APB registers 2
0x4F922000 GLOBAL_DPPIC130_NS size 0x1000 — Distributed programmable peripheral interconnect controller 2
0x4F927000 GLOBAL_MUTEX130_NS size 0x1000 — MUTEX 1
0x4F928000 GLOBAL_RTC130_NS size 0x1000 — Real-time counter 0
0x4F929000 GLOBAL_RTC131_NS size 0x1000 — Real-time counter 2
0x4F92B000 GLOBAL_WDT131_NS size 0x1000 — Watchdog Timer 0
0x4F92C000 GLOBAL_WDT132_NS size 0x1000 — Watchdog Timer 2
0x4F92D000 GLOBAL_EGU130_NS size 0x1000 — Event generator unit 0
0x4F92E000 GLOBAL_COEXC_NS size 0x1000 — Coexistence controller 0
0x4F934000 GLOBAL_GPIOTE130_NS size 0x1000 — GPIO Tasks and Events 0
0x4F938000 GLOBAL_P0_NS size 0x200 — GPIO Port 0
0x4F938200 GLOBAL_P1_NS size 0x200 — GPIO Port 1
0x4F938400 GLOBAL_P2_NS size 0x200 — GPIO Port 2
0x4F938600 GLOBAL_P3_NS size 0x200 — GPIO Port 3
0x4F938A00 GLOBAL_P5_NS size 0x200 — GPIO Port 4
0x4F938C00 GLOBAL_P6_NS size 0x200 — GPIO Port 5
0x4F939000 GLOBAL_P8_NS size 0x200 — GPIO Port 12
0x4F939200 GLOBAL_P9_NS size 0x200 — GPIO Port 13
0x4F939E00 GLOBAL_GPIOINTERNAL_NS size 0x2000 — GPIO Internal 0
0x4F957000 GLOBAL_AUDIOPLL_NS size 0x1000 — AUXPLL 2
0x4F958000 GLOBAL_USBHSPLL_NS size 0x1000 — AUXPLL 4
0x4F967000 GLOBAL_VREGUSB_NS size 0x1000 — VREGUSB peripheral 0
0x4F968000 GLOBAL_AUDIOPLLPM_NS size 0x1000 — AUXPM 1
0x4F981000 GLOBAL_DPPIC131_NS size 0x1000 — Distributed programmable peripheral interconnect controller 4
0x4F982000 GLOBAL_SAADC_NS size 0x1000 — Analog to Digital Converter 0
0x4F983000 GLOBAL_COMP_NS size 0x1000 — Comparator 0
0x4F983000 GLOBAL_LPCOMP_NS size 0x1000 — Low-power comparator 0
0x4F984000 GLOBAL_TEMP_NS size 0x1000 — Temperature Sensor 0
0x4F985000 GLOBAL_NFCT_NS size 0x1000 — NFC-A compatible radio NFC-A compatible radio 0
0x4F991000 GLOBAL_DPPIC132_NS size 0x1000 — Distributed programmable peripheral interconnect controller 6
0x4F992000 GLOBAL_TDM130_NS size 0x1000 — Time division multiplexed audio interface 0
0x4F994000 GLOBAL_QDEC130_NS size 0x1000 — Quadrature Decoder 0
0x4F995000 GLOBAL_QDEC131_NS size 0x1000 — Quadrature Decoder 2
0x4F996000 GLOBAL_SIMIF130_NS size 0x1000 — SIM card interface 0
0x4F997000 GLOBAL_TDM131_NS size 0x1000 — Time division multiplexed audio interface 2
0x4F999000 GLOBAL_TDM132_NS size 0x1000 — Time division multiplexed audio interface 4
0x4F99C000 GLOBAL_GRTC_NS size 0x1000 — Global Real-time counter 0
0x4F9A1000 GLOBAL_DPPIC133_NS size 0x1000 — Distributed programmable peripheral interconnect controller 8
0x4F9A2000 GLOBAL_TIMER130_NS size 0x1000 — Timer/Counter 4
0x4F9A3000 GLOBAL_TIMER131_NS size 0x1000 — Timer/Counter 6
0x4F9A4000 GLOBAL_PWM130_NS size 0x1000 — Pulse width modulation unit 2
0x4F9A5000 GLOBAL_SPIM130_NS size 0x1000 — Serial Peripheral Interface Master with EasyDMA 8
0x4F9A5000 GLOBAL_SPIS130_NS size 0x1000 — SPI Slave 2
0x4F9A5000 GLOBAL_TWIM130_NS size 0x1000 — I2C compatible Two-Wire Master Interface with EasyDMA 0
0x4F9A5000 GLOBAL_TWIS130_NS size 0x1000 — I2C compatible Two-Wire Slave Interface with EasyDMA 0
0x4F9A5000 GLOBAL_UARTE130_NS size 0x1000 — UART with EasyDMA 2
0x4F9A6000 GLOBAL_SPIM131_NS size 0x1000 — Serial Peripheral Interface Master with EasyDMA 10
0x4F9A6000 GLOBAL_SPIS131_NS size 0x1000 — SPI Slave 4
0x4F9A6000 GLOBAL_TWIM131_NS size 0x1000 — I2C compatible Two-Wire Master Interface with EasyDMA 2
0x4F9A6000 GLOBAL_TWIS131_NS size 0x1000 — I2C compatible Two-Wire Slave Interface with EasyDMA 2
0x4F9A6000 GLOBAL_UARTE131_NS size 0x1000 — UART with EasyDMA 4
0x4F9A7000 GLOBAL_PDM130_NS size 0x1000 — Pulse Density Modulation (Digital Microphone) Interface 0
0x4F9B1000 GLOBAL_DPPIC134_NS size 0x1000 — Distributed programmable peripheral interconnect controller 10
0x4F9B2000 GLOBAL_TIMER132_NS size 0x1000 — Timer/Counter 8
0x4F9B3000 GLOBAL_TIMER133_NS size 0x1000 — Timer/Counter 10
0x4F9B4000 GLOBAL_PWM131_NS size 0x1000 — Pulse width modulation unit 4
0x4F9B5000 GLOBAL_SPIM132_NS size 0x1000 — Serial Peripheral Interface Master with EasyDMA 12
0x4F9B5000 GLOBAL_SPIS132_NS size 0x1000 — SPI Slave 6
0x4F9B5000 GLOBAL_TWIM132_NS size 0x1000 — I2C compatible Two-Wire Master Interface with EasyDMA 4
0x4F9B5000 GLOBAL_TWIS132_NS size 0x1000 — I2C compatible Two-Wire Slave Interface with EasyDMA 4
0x4F9B5000 GLOBAL_UARTE132_NS size 0x1000 — UART with EasyDMA 6
0x4F9B6000 GLOBAL_SPIM133_NS size 0x1000 — Serial Peripheral Interface Master with EasyDMA 14
0x4F9B6000 GLOBAL_SPIS133_NS size 0x1000 — SPI Slave 8
0x4F9B6000 GLOBAL_TWIM133_NS size 0x1000 — I2C compatible Two-Wire Master Interface with EasyDMA 6
0x4F9B6000 GLOBAL_TWIS133_NS size 0x1000 — I2C compatible Two-Wire Slave Interface with EasyDMA 6
0x4F9B6000 GLOBAL_UARTE133_NS size 0x1000 — UART with EasyDMA 8
0x4F9B7000 GLOBAL_PDM131_NS size 0x1000 — Pulse Density Modulation (Digital Microphone) Interface 2
0x4F9C1000 GLOBAL_DPPIC135_NS size 0x1000 — Distributed programmable peripheral interconnect controller 12
0x4F9C2000 GLOBAL_TIMER134_NS size 0x1000 — Timer/Counter 12
0x4F9C3000 GLOBAL_TIMER135_NS size 0x1000 — Timer/Counter 14
0x4F9C4000 GLOBAL_PWM132_NS size 0x1000 — Pulse width modulation unit 6
0x4F9C5000 GLOBAL_SPIM134_NS size 0x1000 — Serial Peripheral Interface Master with EasyDMA 16
0x4F9C5000 GLOBAL_SPIS134_NS size 0x1000 — SPI Slave 10
0x4F9C5000 GLOBAL_TWIM134_NS size 0x1000 — I2C compatible Two-Wire Master Interface with EasyDMA 8
0x4F9C5000 GLOBAL_TWIS134_NS size 0x1000 — I2C compatible Two-Wire Slave Interface with EasyDMA 8
0x4F9C5000 GLOBAL_UARTE134_NS size 0x1000 — UART with EasyDMA 10
0x4F9C6000 GLOBAL_SPIM135_NS size 0x1000 — Serial Peripheral Interface Master with EasyDMA 18
0x4F9C6000 GLOBAL_SPIS135_NS size 0x1000 — SPI Slave 12
0x4F9C6000 GLOBAL_TWIM135_NS size 0x1000 — I2C compatible Two-Wire Master Interface with EasyDMA 10
0x4F9C6000 GLOBAL_TWIS135_NS size 0x1000 — I2C compatible Two-Wire Slave Interface with EasyDMA 10
0x4F9C6000 GLOBAL_UARTE135_NS size 0x1000 — UART with EasyDMA 12
0x4F9C7000 GLOBAL_PDM132_NS size 0x1000 — Pulse Density Modulation (Digital Microphone) Interface 4
0x4F9D1000 GLOBAL_DPPIC136_NS size 0x1000 — Distributed programmable peripheral interconnect controller 14
0x4F9D2000 GLOBAL_TIMER136_NS size 0x1000 — Timer/Counter 16
0x4F9D3000 GLOBAL_TIMER137_NS size 0x1000 — Timer/Counter 18
0x4F9D4000 GLOBAL_PWM133_NS size 0x1000 — Pulse width modulation unit 8
0x4F9D5000 GLOBAL_SPIM136_NS size 0x1000 — Serial Peripheral Interface Master with EasyDMA 20
0x4F9D5000 GLOBAL_SPIS136_NS size 0x1000 — SPI Slave 14
0x4F9D5000 GLOBAL_TWIM136_NS size 0x1000 — I2C compatible Two-Wire Master Interface with EasyDMA 12
0x4F9D5000 GLOBAL_TWIS136_NS size 0x1000 — I2C compatible Two-Wire Slave Interface with EasyDMA 12
0x4F9D5000 GLOBAL_UARTE136_NS size 0x1000 — UART with EasyDMA 14
0x4F9D6000 GLOBAL_SPIM137_NS size 0x1000 — Serial Peripheral Interface Master with EasyDMA 22
0x4F9D6000 GLOBAL_SPIS137_NS size 0x1000 — SPI Slave 16
0x4F9D6000 GLOBAL_TWIM137_NS size 0x1000 — I2C compatible Two-Wire Master Interface with EasyDMA 14
0x4F9D6000 GLOBAL_TWIS137_NS size 0x1000 — I2C compatible Two-Wire Slave Interface with EasyDMA 14
0x4F9D6000 GLOBAL_UARTE137_NS size 0x1000 — UART with EasyDMA 16
0x4F9D7000 GLOBAL_PDM133_NS size 0x1000 — Pulse Density Modulation (Digital Microphone) Interface 6
0x51000000 SPU000_S size 0x1000 — System protection unit 0
0x51001000 MPC000_S size 0x1000 — Memory Privilege Controller 0
0x51003000 MVDMA_S size 0x1000 — MVDMA performs direct-memory-accesses between memories. Data is transferred according to job descriptor lists. Each transfer has corresponding source and sink descriptor lists with matching data amounts. The lists are in memory and they contain data buffer information, address pointers, buffer sizes and data type attributes. 1
0x51004000 RAMC000_S size 0x1000 — RAM Controller 0
0x51005000 ROMC_S size 0x1000 — ROM Controller 1
0x51006000 CRACEN_S size 0x1000 — CRACEN
0x51007000 RAMC001_S size 0x1000 — RAM Controller 2
0x5100A000 PCGCS000_NS size 0x1000 — PCGCSlave 0
0x5100A000 PCGCS000_S size 0x1000 — PCGCSlave 1
0x5100B000 PCGCM000_S size 0x1000 — PCGC Master 0
0x5100D000 HSFLL_NS size 0x1000 — HSFLL 0
0x5100D000 HSFLL_S size 0x1000 — HSFLL 1
0x5100E000 LRCCONF000_NS size 0x1000 — LRCCONF 0
0x5100E000 LRCCONF000_S size 0x1000 — LRCCONF 1
0x5100F000 PCGCM001_NS size 0x1000 — PCGC Master 1
0x5100F000 PCGCM001_S size 0x1000 — PCGC Master 2
0x51010000 SPU010_S size 0x1000 — System protection unit 1
0x51011000 CPUCONF_S size 0x1000 — CPU Configuration 1
0x51012000 MEMCONF_S size 0x1000 — Memory configuration 2
0x51013000 IPCT_S size 0x1000 — IPCT APB registers 1
0x51014000 WDT010_S size 0x1000 — Watchdog Timer 1
0x51015000 WDT011_S size 0x1000 — Watchdog Timer 3
0x51016000 TAMPC_S size 0x1000 — Tamper controller
0x51017000 MUTEX_S size 0x1000 — MUTEX 1
0x5101A000 PCGCS010_NS size 0x1000 — PCGCSlave 2
0x5101A000 PCGCS010_S size 0x1000 — PCGCSlave 3
0x5101B000 PCGCM010_S size 0x1000 — PCGC Master 3
0x5101C000 ABB_NS size 0x1000 — ABB peripheral 0
0x5101C000 ABB_S size 0x1000 — ABB peripheral 1
0x5101E000 LRCCONF010_NS size 0x1000 — LRCCONF 2
0x5101E000 LRCCONF010_S size 0x1000 — LRCCONF 3
0x5101E000 RESETINFO_S size 0x1000 — RESETINFO
0x5101F000 PCGCM011_NS size 0x1000 — PCGC Master 4
0x5101F000 PCGCM011_S size 0x1000 — PCGC Master 5
0x51800000 CRACENCORE_S size 0x1000 — CRACENCORE
0x59010000 SPU310_S size 0x1000 — System protection unit 2
0x5A010000 SPU410_S size 0x1000 — System protection unit 3
0x5F080000 SPU110_S size 0x1000 — System protection unit 6
0x5F081000 MPC110_S size 0x1000 — Memory Privilege Controller 2
0x5F086000 GLOBAL_USBHS_S size 0x1000 — USBHS 1
0x5F090000 SPU111_S size 0x1000 — System protection unit 7
0x5F091000 MPC111_S size 0x1000 — Memory Privilege Controller 3
0x5F092000 GLOBAL_MRAMC110_S size 0x1000 — MRAM controller 1
0x5F093000 GLOBAL_MRAMC111_S size 0x1000 — MRAM controller 3
0x5F095000 GLOBAL_EXMIF_S size 0x1000 — External Memory Interface 1
0x5F099000 BELLBOARD_S size 0x1000 — BELLBOARD APB registers 1
0x5F8C0000 SPU120_S size 0x1000 — System protection unit 8
0x5F8C1000 MPC120_S size 0x1000 — Memory Privilege Controller 4
0x5F8C2000 GLOBAL_CANPLLPM_S size 0x1000 — AUXPM 0
0x5F8C2000 GLOBAL_CANPLL_S size 0x1000 — AUXPLL 1
0x5F8C5000 GLOBAL_OTPC_S size 0x1000 — OTP controller
0x5F8C8000 GLOBAL_VPR120_S size 0x1000 — VPR peripheral registers 1
0x5F8C9000 GLOBAL_SDCARD_S size 0x1000 — SD-Card and eMMC 1
0x5F8CB000 GLOBAL_HSFLL122_S size 0x1000 — HSFLL 2
0x5F8CC000 GLOBAL_HSFLL121_S size 0x1000 — HSFLL 4
0x5F8D0000 SPU121_S size 0x1000 — System protection unit 9
0x5F8D1000 GLOBAL_IPCT120_S size 0x1000 — IPCT APB registers 1
0x5F8D3000 GLOBAL_I3C120_S size 0x1000 — I3C 1
0x5F8D4000 GLOBAL_VPR121_S size 0x1000 — VPR peripheral registers 3
0x5F8D7000 GLOBAL_QSPI120_S size 0x1000 — Quad serial peripheral interface 1
0x5F8D8000 GLOBAL_CAN120_S size 0x1000 — Controller Area Network 1
0x5F8D9000 GLOBAL_MVDMA120_S size 0x1000 — MVDMA performs direct-memory-accesses between memories. Data is transferred according to job descriptor lists. Each transfer has corresponding source and sink descriptor lists with matching data amounts. The lists are in memory and they contain data buffer information, address pointers, buffer sizes and data type attributes. 1
0x5F8DA000 GLOBAL_RAMC122_S size 0x1000 — RAM Controller 1
0x5F8DB000 GLOBAL_CAN121_S size 0x1000 — Controller Area Network 3
0x5F8DC000 GLOBAL_MVDMA121_S size 0x1000 — MVDMA performs direct-memory-accesses between memories. Data is transferred according to job descriptor lists. Each transfer has corresponding source and sink descriptor lists with matching data amounts. The lists are in memory and they contain data buffer information, address pointers, buffer sizes and data type attributes. 3
0x5F8DD000 GLOBAL_RAMC123_S size 0x1000 — RAM Controller 3
0x5F8DE000 GLOBAL_I3C121_S size 0x1000 — I3C 3
0x5F8DF000 GLOBAL_QSPI121_S size 0x1000 — Quad serial peripheral interface 3
0x5F8E0000 SPU122_S size 0x1000 — System protection unit 10
0x5F8E1000 GLOBAL_DPPIC120_S size 0x1000 — Distributed programmable peripheral interconnect controller 1
0x5F8E2000 GLOBAL_TIMER120_S size 0x1000 — Timer/Counter 1
0x5F8E3000 GLOBAL_TIMER121_S size 0x1000 — Timer/Counter 3
0x5F8E4000 GLOBAL_PWM120_S size 0x1000 — Pulse width modulation unit 1
0x5F8E5000 GLOBAL_SPIS120_S size 0x1000 — SPI Slave 1
0x5F8E6000 GLOBAL_SPIM120_S size 0x1000 — Serial Peripheral Interface Master with EasyDMA 1
0x5F8E6000 GLOBAL_UARTE120_S size 0x1000 — UART with EasyDMA 1
0x5F8E7000 GLOBAL_SPIM121_S size 0x1000 — Serial Peripheral Interface Master with EasyDMA 3
0x5F8E8000 GLOBAL_SPIM122_S size 0x1000 — Serial Peripheral Interface Master with EasyDMA 5
0x5F8E9000 GLOBAL_SPIM123_S size 0x1000 — Serial Peripheral Interface Master with EasyDMA 7
0x5F900000 SPU130_S size 0x1000 — System protection unit 11
0x5F901000 MPC130_S size 0x1000 — Memory Privilege Controller 5
0x5F908000 GLOBAL_VPR130_S size 0x1000 — VPR peripheral registers 5
0x5F920000 SPU131_S size 0x1000 — System protection unit 12
0x5F921000 GLOBAL_IPCT130_S size 0x1000 — IPCT APB registers 3
0x5F922000 GLOBAL_DPPIC130_S size 0x1000 — Distributed programmable peripheral interconnect controller 3
0x5F923000 IPCMAP_S size 0x1000 — IPCMAP APB registers
0x5F924000 IRQMAP_S size 0x1000 — IRQMAP APB registers
0x5F928000 GLOBAL_RTC130_S size 0x1000 — Real-time counter 1
0x5F929000 GLOBAL_RTC131_S size 0x1000 — Real-time counter 3
0x5F92B000 GLOBAL_WDT131_S size 0x1000 — Watchdog Timer 1
0x5F92C000 GLOBAL_WDT132_S size 0x1000 — Watchdog Timer 3
0x5F92D000 GLOBAL_EGU130_S size 0x1000 — Event generator unit 1
0x5F92E000 GLOBAL_COEXC_S size 0x1000 — Coexistence controller 1
0x5F934000 GLOBAL_GPIOTE130_S size 0x1000 — GPIO Tasks and Events 1
0x5F938000 GLOBAL_P0_S size 0x200 — GPIO Port 6
0x5F938200 GLOBAL_P1_S size 0x200 — GPIO Port 7
0x5F938400 GLOBAL_P2_S size 0x200 — GPIO Port 8
0x5F938600 GLOBAL_P3_S size 0x200 — GPIO Port 9
0x5F938A00 GLOBAL_P5_S size 0x200 — GPIO Port 10
0x5F938C00 GLOBAL_P6_S size 0x200 — GPIO Port 11
0x5F939000 GLOBAL_P8_S size 0x200 — GPIO Port 14
0x5F939200 GLOBAL_P9_S size 0x200 — GPIO Port 15
0x5F939E00 GLOBAL_GPIOINTERNAL_S size 0x2000 — GPIO Internal 1
0x5F949000 GLOBAL_RESETHUB_S size 0x1000 — Reset hub
0x5F957000 GLOBAL_AUDIOPLL_S size 0x1000 — AUXPLL 3
0x5F958000 GLOBAL_USBHSPLL_S size 0x1000 — AUXPLL 5
0x5F967000 GLOBAL_VREGUSB_S size 0x1000 — VREGUSB peripheral 1
0x5F968000 GLOBAL_AUDIOPLLPM_S size 0x1000 — AUXPM 2
0x5F980000 SPU132_S size 0x1000 — System protection unit 13
0x5F981000 GLOBAL_DPPIC131_S size 0x1000 — Distributed programmable peripheral interconnect controller 5
0x5F982000 GLOBAL_SAADC_S size 0x1000 — Analog to Digital Converter 1
0x5F983000 GLOBAL_COMP_S size 0x1000 — Comparator 1
0x5F983000 GLOBAL_LPCOMP_S size 0x1000 — Low-power comparator 1
0x5F984000 GLOBAL_TEMP_S size 0x1000 — Temperature Sensor 1
0x5F985000 GLOBAL_NFCT_S size 0x1000 — NFC-A compatible radio NFC-A compatible radio 1
0x5F990000 SPU133_S size 0x1000 — System protection unit 14
0x5F991000 GLOBAL_DPPIC132_S size 0x1000 — Distributed programmable peripheral interconnect controller 7
0x5F992000 GLOBAL_TDM130_S size 0x1000 — Time division multiplexed audio interface 1
0x5F994000 GLOBAL_QDEC130_S size 0x1000 — Quadrature Decoder 1
0x5F995000 GLOBAL_QDEC131_S size 0x1000 — Quadrature Decoder 3
0x5F996000 GLOBAL_SIMIF130_S size 0x1000 — SIM card interface 1
0x5F997000 GLOBAL_TDM131_S size 0x1000 — Time division multiplexed audio interface 3
0x5F999000 GLOBAL_TDM132_S size 0x1000 — Time division multiplexed audio interface 5
0x5F99C000 GLOBAL_GRTC_S size 0x1000 — Global Real-time counter 1
0x5F9A0000 SPU134_S size 0x1000 — System protection unit 15
0x5F9A1000 GLOBAL_DPPIC133_S size 0x1000 — Distributed programmable peripheral interconnect controller 9
0x5F9A2000 GLOBAL_TIMER130_S size 0x1000 — Timer/Counter 5
0x5F9A3000 GLOBAL_TIMER131_S size 0x1000 — Timer/Counter 7
0x5F9A4000 GLOBAL_PWM130_S size 0x1000 — Pulse width modulation unit 3
0x5F9A5000 GLOBAL_SPIM130_S size 0x1000 — Serial Peripheral Interface Master with EasyDMA 9
0x5F9A5000 GLOBAL_SPIS130_S size 0x1000 — SPI Slave 3
0x5F9A5000 GLOBAL_TWIM130_S size 0x1000 — I2C compatible Two-Wire Master Interface with EasyDMA 1
0x5F9A5000 GLOBAL_TWIS130_S size 0x1000 — I2C compatible Two-Wire Slave Interface with EasyDMA 1
0x5F9A5000 GLOBAL_UARTE130_S size 0x1000 — UART with EasyDMA 3
0x5F9A6000 GLOBAL_SPIM131_S size 0x1000 — Serial Peripheral Interface Master with EasyDMA 11
0x5F9A6000 GLOBAL_SPIS131_S size 0x1000 — SPI Slave 5
0x5F9A6000 GLOBAL_TWIM131_S size 0x1000 — I2C compatible Two-Wire Master Interface with EasyDMA 3
0x5F9A6000 GLOBAL_TWIS131_S size 0x1000 — I2C compatible Two-Wire Slave Interface with EasyDMA 3
0x5F9A6000 GLOBAL_UARTE131_S size 0x1000 — UART with EasyDMA 5
0x5F9A7000 GLOBAL_PDM130_S size 0x1000 — Pulse Density Modulation (Digital Microphone) Interface 1
0x5F9B0000 SPU135_S size 0x1000 — System protection unit 16
0x5F9B1000 GLOBAL_DPPIC134_S size 0x1000 — Distributed programmable peripheral interconnect controller 11
0x5F9B2000 GLOBAL_TIMER132_S size 0x1000 — Timer/Counter 9
0x5F9B3000 GLOBAL_TIMER133_S size 0x1000 — Timer/Counter 11
0x5F9B4000 GLOBAL_PWM131_S size 0x1000 — Pulse width modulation unit 5
0x5F9B5000 GLOBAL_SPIM132_S size 0x1000 — Serial Peripheral Interface Master with EasyDMA 13
0x5F9B5000 GLOBAL_SPIS132_S size 0x1000 — SPI Slave 7
0x5F9B5000 GLOBAL_TWIM132_S size 0x1000 — I2C compatible Two-Wire Master Interface with EasyDMA 5
0x5F9B5000 GLOBAL_TWIS132_S size 0x1000 — I2C compatible Two-Wire Slave Interface with EasyDMA 5
0x5F9B5000 GLOBAL_UARTE132_S size 0x1000 — UART with EasyDMA 7
0x5F9B6000 GLOBAL_SPIM133_S size 0x1000 — Serial Peripheral Interface Master with EasyDMA 15
0x5F9B6000 GLOBAL_SPIS133_S size 0x1000 — SPI Slave 9
0x5F9B6000 GLOBAL_TWIM133_S size 0x1000 — I2C compatible Two-Wire Master Interface with EasyDMA 7
0x5F9B6000 GLOBAL_TWIS133_S size 0x1000 — I2C compatible Two-Wire Slave Interface with EasyDMA 7
0x5F9B6000 GLOBAL_UARTE133_S size 0x1000 — UART with EasyDMA 9
0x5F9B7000 GLOBAL_PDM131_S size 0x1000 — Pulse Density Modulation (Digital Microphone) Interface 3
0x5F9C0000 SPU136_S size 0x1000 — System protection unit 17
0x5F9C1000 GLOBAL_DPPIC135_S size 0x1000 — Distributed programmable peripheral interconnect controller 13
0x5F9C2000 GLOBAL_TIMER134_S size 0x1000 — Timer/Counter 13
0x5F9C3000 GLOBAL_TIMER135_S size 0x1000 — Timer/Counter 15
0x5F9C4000 GLOBAL_PWM132_S size 0x1000 — Pulse width modulation unit 7
0x5F9C5000 GLOBAL_SPIM134_S size 0x1000 — Serial Peripheral Interface Master with EasyDMA 17
0x5F9C5000 GLOBAL_SPIS134_S size 0x1000 — SPI Slave 11
0x5F9C5000 GLOBAL_TWIM134_S size 0x1000 — I2C compatible Two-Wire Master Interface with EasyDMA 9
0x5F9C5000 GLOBAL_TWIS134_S size 0x1000 — I2C compatible Two-Wire Slave Interface with EasyDMA 9
0x5F9C5000 GLOBAL_UARTE134_S size 0x1000 — UART with EasyDMA 11
0x5F9C6000 GLOBAL_SPIM135_S size 0x1000 — Serial Peripheral Interface Master with EasyDMA 19
0x5F9C6000 GLOBAL_SPIS135_S size 0x1000 — SPI Slave 13
0x5F9C6000 GLOBAL_TWIM135_S size 0x1000 — I2C compatible Two-Wire Master Interface with EasyDMA 11
0x5F9C6000 GLOBAL_TWIS135_S size 0x1000 — I2C compatible Two-Wire Slave Interface with EasyDMA 11
0x5F9C6000 GLOBAL_UARTE135_S size 0x1000 — UART with EasyDMA 13
0x5F9C7000 GLOBAL_PDM132_S size 0x1000 — Pulse Density Modulation (Digital Microphone) Interface 5
0x5F9D0000 SPU137_S size 0x1000 — System protection unit 18
0x5F9D1000 GLOBAL_DPPIC136_S size 0x1000 — Distributed programmable peripheral interconnect controller 15
0x5F9D2000 GLOBAL_TIMER136_S size 0x1000 — Timer/Counter 17
0x5F9D3000 GLOBAL_TIMER137_S size 0x1000 — Timer/Counter 19
0x5F9D4000 GLOBAL_PWM133_S size 0x1000 — Pulse width modulation unit 9
0x5F9D5000 GLOBAL_SPIM136_S size 0x1000 — Serial Peripheral Interface Master with EasyDMA 21
0x5F9D5000 GLOBAL_SPIS136_S size 0x1000 — SPI Slave 15
0x5F9D5000 GLOBAL_TWIM136_S size 0x1000 — I2C compatible Two-Wire Master Interface with EasyDMA 13
0x5F9D5000 GLOBAL_TWIS136_S size 0x1000 — I2C compatible Two-Wire Slave Interface with EasyDMA 13
0x5F9D5000 GLOBAL_UARTE136_S size 0x1000 — UART with EasyDMA 15
0x5F9D6000 GLOBAL_SPIM137_S size 0x1000 — Serial Peripheral Interface Master with EasyDMA 23
0x5F9D6000 GLOBAL_SPIS137_S size 0x1000 — SPI Slave 17
0x5F9D6000 GLOBAL_TWIM137_S size 0x1000 — I2C compatible Two-Wire Master Interface with EasyDMA 15
0x5F9D6000 GLOBAL_TWIS137_S size 0x1000 — I2C compatible Two-Wire Slave Interface with EasyDMA 15
0x5F9D6000 GLOBAL_UARTE137_S size 0x1000 — UART with EasyDMA 17
0x5F9D7000 GLOBAL_PDM133_S size 0x1000 — Pulse Density Modulation (Digital Microphone) Interface 7
0xA0000000 GLOBAL_STMDATA_NS size 0x10000000 — System Trace Macrocell data buffer 0
0xA0000000 GLOBAL_STMDATA_S size 0x10000000 — System Trace Macrocell data buffer 1
0xBF000000 SPU200_NS size 0x1000 — System protection unit 4
0xBF001000 GLOBAL_TDDCONF_NS size 0x1000 — TDDCONF 0
0xBF001000 GLOBAL_TDDCONF_S size 0x1000 — TDDCONF 1
0xBF003000 GLOBAL_TBM_NS size 0x1000 — Trace buffer monitor 0
0xBF003000 GLOBAL_TBM_S size 0x1000 — Trace buffer monitor 1
0xBF007000 MPC200_NS size 0x1000 — Memory Privilege Controller 1
0xBF010000 SPU210_NS size 0x1000 — System protection unit 5
0xBF014000 MEMCONF200_NS size 0x1000 — Memory configuration 0
0xBF015000 CTRLAP_NS size 0x1000 — Control access port
0xBF041000 GLOBAL_TSGEN_NS size 0x1000 — Timestamp generator
0xBF042000 GLOBAL_STM_NS size 0x1000 — System Trace Macrocell
0xBF043000 GLOBAL_TPIU_NS size 0x1000 — Trace Port Interface Unit
0xBF044000 GLOBAL_ETB_NS size 0x1000 — Embedded Trace Buffer
0xBF045000 GLOBAL_ETR_NS size 0x1000 — Embedded Trace Router
0xBF046000 GLOBAL_CTI210_NS size 0x1000 — Cross-Trigger Interface control 0
0xBF047000 GLOBAL_CTI211_NS size 0x1000 — Cross-Trigger Interface control 1
0xBF048000 GLOBAL_ATBREPLICATOR210_NS size 0x1000 — ATB Replicator module 0
0xBF049000 GLOBAL_ATBREPLICATOR211_NS size 0x1000 — ATB Replicator module 1
0xBF04A000 GLOBAL_ATBREPLICATOR212_NS size 0x1000 — ATB Replicator module 2
0xBF04B000 GLOBAL_ATBREPLICATOR213_NS size 0x1000 — ATB Replicator module 3
0xBF04C000 GLOBAL_ATBFUNNEL210_NS size 0x1000 — ATB funnel module 0
0xBF04D000 GLOBAL_ATBFUNNEL211_NS size 0x1000 — ATB funnel module 1
0xBF04E000 GLOBAL_ATBFUNNEL212_NS size 0x1000 — ATB funnel module 2
0xBF04F000 GLOBAL_ATBFUNNEL213_NS size 0x1000 — ATB funnel module 3
0xE0041000 ETM_NS size 0x1000 — Embedded Trace Macrocell
0xE0042000 CTI_S size 0x1000 — Cross-Trigger Interface control 2
0xE0080000 CPUC_S size 0x1000 — CM33 SubSystem
0xE0082000 ICACHE_S size 0x1000 — Cache 0
0xE0083000 DCACHE_S size 0x1000 — Cache 1

## Interrupts
0 SPU000 (SPU000_S)
1 MPC000 (MPC000_S)
3 MVDMA (MVDMA_NS, MVDMA_S)
6 CRACEN (CRACEN_S)
16 SPU010 (SPU010_S)
20 WDT010 (WDT010_NS, WDT010_S)
21 WDT011 (WDT011_NS, WDT011_S)
22 TAMPC (TAMPC_S)
64 IPCT_0 (IPCT_NS, IPCT_S)
65 IPCT_1 (IPCT_NS, IPCT_S)
{n+88} SWI{n} (SWI{n}_NS) (n=0..7)
96 BELLBOARD_0 (BELLBOARD_NS, BELLBOARD_S)
97 BELLBOARD_1 (BELLBOARD_NS, BELLBOARD_S)
98 BELLBOARD_2 (BELLBOARD_NS, BELLBOARD_S)
99 BELLBOARD_3 (BELLBOARD_NS, BELLBOARD_S)
104 GPIOTE130_0 (GLOBAL_GPIOTE130_NS, GLOBAL_GPIOTE130_S)
105 GPIOTE130_1 (GLOBAL_GPIOTE130_NS, GLOBAL_GPIOTE130_S)
108 GRTC_0 (GLOBAL_GRTC_NS, GLOBAL_GRTC_S)
109 GRTC_1 (GLOBAL_GRTC_NS, GLOBAL_GRTC_S)
110 GRTC_2 (GLOBAL_GRTC_NS, GLOBAL_GRTC_S)
111 SPU310 (GLOBAL_GSI_NS, SPU310_S)
112 SPU410 (GLOBAL_DISPC_NS, SPU410_S)
113 DISPC_1 (GLOBAL_DISPC_NS)
114 DISPC_2 (GLOBAL_DISPC_NS)
115 GPU (GLOBAL_GPU_NS)
124 MPC200 (MPC200_NS)
125 SPU200_SPU210 (SPU200_NS, SPU210_NS)
126 CTRLAP (CTRLAP_NS)
127 TBM (GLOBAL_TBM_NS, GLOBAL_TBM_S)
128 SPU110 (SPU110_S)
129 MPC110 (MPC110_S)
134 USBHS (GLOBAL_USBHS_NS, GLOBAL_USBHS_S)
144 SPU111 (SPU111_S)
145 MPC111 (MPC111_S)
146 MRAMC110 (GLOBAL_MRAMC110_NS, GLOBAL_MRAMC110_S)
147 MRAMC111 (GLOBAL_MRAMC111_NS, GLOBAL_MRAMC111_S)
149 EXMIF (GLOBAL_EXMIF_NS, GLOBAL_EXMIF_S)
192 SPU120 (SPU120_S)
193 MPC120 (MPC120_S)
197 OTPC (GLOBAL_OTPC_S)
200 VPR120 (GLOBAL_VPR120_NS, GLOBAL_VPR120_S)
208 SPU121 (SPU121_S)
209 IPCT120_0 (GLOBAL_IPCT120_NS, GLOBAL_IPCT120_S)
211 I3C120 (GLOBAL_I3C120_NS, GLOBAL_I3C120_S)
212 VPR121 (GLOBAL_VPR121_NS, GLOBAL_VPR121_S)
215 QSPI120 (GLOBAL_QSPI120_NS, GLOBAL_QSPI120_S)
216 CAN120 (GLOBAL_CAN120_NS, GLOBAL_CAN120_S)
217 MVDMA120 (GLOBAL_MVDMA120_NS, GLOBAL_MVDMA120_S)
219 CAN121 (GLOBAL_CAN121_NS, GLOBAL_CAN121_S)
220 MVDMA121 (GLOBAL_MVDMA121_NS, GLOBAL_MVDMA121_S)
222 I3C121 (GLOBAL_I3C121_NS, GLOBAL_I3C121_S)
223 QSPI121 (GLOBAL_QSPI121_NS, GLOBAL_QSPI121_S)
224 SPU122 (SPU122_S)
226 TIMER120 (GLOBAL_TIMER120_NS, GLOBAL_TIMER120_S)
227 TIMER121 (GLOBAL_TIMER121_NS, GLOBAL_TIMER121_S)
228 PWM120 (GLOBAL_PWM120_NS, GLOBAL_PWM120_S)
229 SPIS120 (GLOBAL_SPIS120_NS, GLOBAL_SPIS120_S)
230 SPIM120_UARTE120 (GLOBAL_SPIM120_NS, GLOBAL_UARTE120_NS, GLOBAL_SPIM120_S, GLOBAL_UARTE120_S)
231 SPIM121 (GLOBAL_SPIM121_NS, GLOBAL_SPIM121_S)
232 SPIM122 (GLOBAL_SPIM122_NS, GLOBAL_SPIM122_S)
233 SPIM123 (GLOBAL_SPIM123_NS, GLOBAL_SPIM123_S)
256 SPU130 (SPU130_S)
257 MPC130 (MPC130_S)
264 VPR130 (GLOBAL_VPR130_NS, GLOBAL_VPR130_S)
288 SPU131 (SPU131_S)
289 IPCT130_0 (GLOBAL_IPCT130_NS, GLOBAL_IPCT130_S)
296 RTC130 (GLOBAL_RTC130_NS, GLOBAL_RTC130_S)
297 RTC131 (GLOBAL_RTC131_NS, GLOBAL_RTC131_S)
299 WDT131 (GLOBAL_WDT131_NS, GLOBAL_WDT131_S)
300 WDT132 (GLOBAL_WDT132_NS, GLOBAL_WDT132_S)
301 EGU130 (GLOBAL_EGU130_NS, GLOBAL_EGU130_S)
329 RESETHUB (GLOBAL_RESETHUB_S)
343 AUDIOPLL (GLOBAL_AUDIOPLL_NS, GLOBAL_AUDIOPLL_S)
344 USBHSPLL (GLOBAL_USBHSPLL_NS, GLOBAL_USBHSPLL_S)
359 VREGUSB (GLOBAL_VREGUSB_NS, GLOBAL_VREGUSB_S)
360 AUDIOPLLPM (GLOBAL_AUDIOPLLPM_NS, GLOBAL_AUDIOPLLPM_S)
384 SPU132 (SPU132_S)
386 SAADC (GLOBAL_SAADC_NS, GLOBAL_SAADC_S)
387 COMP_LPCOMP (GLOBAL_COMP_NS, GLOBAL_LPCOMP_NS, GLOBAL_COMP_S, GLOBAL_LPCOMP_S)
388 TEMP (GLOBAL_TEMP_NS, GLOBAL_TEMP_S)
389 NFCT (GLOBAL_NFCT_NS, GLOBAL_NFCT_S)
400 SPU133 (SPU133_S)
402 TDM130 (GLOBAL_TDM130_NS, GLOBAL_TDM130_S)
404 QDEC130 (GLOBAL_QDEC130_NS, GLOBAL_QDEC130_S)
405 QDEC131 (GLOBAL_QDEC131_NS, GLOBAL_QDEC131_S)
406 SIMIF130 (GLOBAL_SIMIF130_NS, GLOBAL_SIMIF130_S)
407 TDM131 (GLOBAL_TDM131_NS, GLOBAL_TDM131_S)
409 TDM132 (GLOBAL_TDM132_NS, GLOBAL_TDM132_S)
416 SPU134 (SPU134_S)
418 TIMER130 (GLOBAL_TIMER130_NS, GLOBAL_TIMER130_S)
419 TIMER131 (GLOBAL_TIMER131_NS, GLOBAL_TIMER131_S)
420 PWM130 (GLOBAL_PWM130_NS, GLOBAL_PWM130_S)
421 SERIAL0 (GLOBAL_SPIM130_NS, GLOBAL_SPIS130_NS, GLOBAL_TWIM130_NS, GLOBAL_TWIS130_NS, GLOBAL_UARTE130_NS, GLOBAL_SPIM130_S, GLOBAL_SPIS130_S, GLOBAL_TWIM130_S, GLOBAL_TWIS130_S, GLOBAL_UARTE130_S)
422 SERIAL1 (GLOBAL_SPIM131_NS, GLOBAL_SPIS131_NS, GLOBAL_TWIM131_NS, GLOBAL_TWIS131_NS, GLOBAL_UARTE131_NS, GLOBAL_SPIM131_S, GLOBAL_SPIS131_S, GLOBAL_TWIM131_S, GLOBAL_TWIS131_S, GLOBAL_UARTE131_S)
423 PDM130 (GLOBAL_PDM130_NS, GLOBAL_PDM130_S)
432 SPU135 (SPU135_S)
434 TIMER132 (GLOBAL_TIMER132_NS, GLOBAL_TIMER132_S)
435 TIMER133 (GLOBAL_TIMER133_NS, GLOBAL_TIMER133_S)
436 PWM131 (GLOBAL_PWM131_NS, GLOBAL_PWM131_S)
437 SERIAL2 (GLOBAL_SPIM132_NS, GLOBAL_SPIS132_NS, GLOBAL_TWIM132_NS, GLOBAL_TWIS132_NS, GLOBAL_UARTE132_NS, GLOBAL_SPIM132_S, GLOBAL_SPIS132_S, GLOBAL_TWIM132_S, GLOBAL_TWIS132_S, GLOBAL_UARTE132_S)
438 SERIAL3 (GLOBAL_SPIM133_NS, GLOBAL_SPIS133_NS, GLOBAL_TWIM133_NS, GLOBAL_TWIS133_NS, GLOBAL_UARTE133_NS, GLOBAL_SPIM133_S, GLOBAL_SPIS133_S, GLOBAL_TWIM133_S, GLOBAL_TWIS133_S, GLOBAL_UARTE133_S)
439 PDM131 (GLOBAL_PDM131_NS, GLOBAL_PDM131_S)
448 SPU136 (SPU136_S)
450 TIMER134 (GLOBAL_TIMER134_NS, GLOBAL_TIMER134_S)
451 TIMER135 (GLOBAL_TIMER135_NS, GLOBAL_TIMER135_S)
452 PWM132 (GLOBAL_PWM132_NS, GLOBAL_PWM132_S)
453 SERIAL4 (GLOBAL_SPIM134_NS, GLOBAL_SPIS134_NS, GLOBAL_TWIM134_NS, GLOBAL_TWIS134_NS, GLOBAL_UARTE134_NS, GLOBAL_SPIM134_S, GLOBAL_SPIS134_S, GLOBAL_TWIM134_S, GLOBAL_TWIS134_S, GLOBAL_UARTE134_S)
454 SERIAL5 (GLOBAL_SPIM135_NS, GLOBAL_SPIS135_NS, GLOBAL_TWIM135_NS, GLOBAL_TWIS135_NS, GLOBAL_UARTE135_NS, GLOBAL_SPIM135_S, GLOBAL_SPIS135_S, GLOBAL_TWIM135_S, GLOBAL_TWIS135_S, GLOBAL_UARTE135_S)
455 PDM132 (GLOBAL_PDM132_NS, GLOBAL_PDM132_S)
464 SPU137 (SPU137_S)
466 TIMER136 (GLOBAL_TIMER136_NS, GLOBAL_TIMER136_S)
467 TIMER137 (GLOBAL_TIMER137_NS, GLOBAL_TIMER137_S)
468 PWM133 (GLOBAL_PWM133_NS, GLOBAL_PWM133_S)
469 SERIAL6 (GLOBAL_SPIM136_NS, GLOBAL_SPIS136_NS, GLOBAL_TWIM136_NS, GLOBAL_TWIS136_NS, GLOBAL_UARTE136_NS, GLOBAL_SPIM136_S, GLOBAL_SPIS136_S, GLOBAL_TWIM136_S, GLOBAL_TWIS136_S, GLOBAL_UARTE136_S)
470 SERIAL7 (GLOBAL_SPIM137_NS, GLOBAL_SPIS137_NS, GLOBAL_TWIM137_NS, GLOBAL_TWIS137_NS, GLOBAL_UARTE137_NS, GLOBAL_SPIM137_S, GLOBAL_SPIS137_S, GLOBAL_TWIM137_S, GLOBAL_TWIS137_S, GLOBAL_UARTE137_S)
471 PDM133 (GLOBAL_PDM133_NS, GLOBAL_PDM133_S)

## Further device data
MaxInterrupts=480

## Licence text in the file
Copyright (c) 2010 - 2024, Nordic Semiconductor ASA All rights reserved. Redistribution and use in source and binary forms, with or without modification, are permitted provided that the following conditions are met: 1. Redistributions of source code must retain the above copyright notice, this list of conditions and the following disclaimer. 2. Redistributions in binary form, except as embedded into a Nordic Semiconductor ASA integrated circuit in a product or a software update for such product, must reproduce the above copyright notice, this list of conditions and the following disclaimer in the documentation and/or other materials provided with the distribution. 3. Neither the name of Nordic Semiconductor ASA nor the names of its contributors may be used to endorse or promote products derived from this software without specific prior written permission. 4. This software, with or without modification, must only be used with a Nordic Semiconductor ASA integrated circuit. 5. Any software provided in binary form under this license must not be reverse engineered, decompiled, modified and/or disassembled. THIS SOFTWARE IS PROVIDED BY NORDIC SEMICONDUCTOR ASA "AS IS" AND ANY EXPRESS OR IMPLIED WARRANTIES, INCLUDING, BUT NOT LIMITED TO, THE IMPLIED WARRANTIES OF MERCHANTABILITY, NONINFRINGEMENT, AND FITNESS FOR A PARTICULAR PURPOSE ARE DISCLAIMED. IN NO EVENT SHALL NORDIC SEMICONDUCTOR ASA OR CONTRIBUTORS BE LIABLE FOR ANY DIRECT, INDIRECT, INCIDENTAL, SPECIAL, EXEMPLARY, OR CONSEQUENTIAL DAMAGES (INCLUDING, BUT NOT LIMITED TO, PROCUREMENT OF SUBSTITUTE GOODS OR SERVICES; LOSS OF USE, DATA, OR PROFITS; OR BUSINESS INTERRUPTION) HOWEVER CAUSED AND ON ANY THEORY OF LIABILITY, WHETHER IN CONTRACT, STRICT LIABILITY, OR TORT (INCLUDING NEGLIGENCE OR OTHERWISE) ARISING IN ANY WAY OUT OF THE USE OF THIS SOFTWARE, EVEN IF ADVISED OF THE POSSIBILITY OF SUCH DAMAGE.
