# nrf9220_flpr register map
Vendor: Nordic Semiconductor; Series: nRF92; File version: 1
nRF9220 reference description for system-on-chip with many ARM 32-bit Cortex-M33 microcontrollers
Registers are 32-bit, read-write, reset 0x0 unless marked. A register's access mark holds for its fields unless they carry their own. Offsets are from the block's base; lines under a group give offsets from that group; [hi:lo] are bit positions; {n}, {i} and the like mark numbered series; 'fields as' and 'values as' point back to an identical list; <NAME> marks a mode.

## Memory map
0x00000000 VPRTIM size 0x1000 — VTIM CSR registers
0x0FFF6000 GLOBAL_MICR size 0x1000 — MICR
0x0FFFE000 GLOBAL_FICR size 0xC00 — Factory Information Configuration Registers
0x4F8D2000 GLOBAL_MUTEX120 size 0x1000 — MUTEX 0
0x4F8D2000 GLOBAL_PROTOTYPE size 0x1000 — Prototype HW information registers.
0x4F927000 GLOBAL_MUTEX130 size 0x1000 — MUTEX 1
0x5F092000 GLOBAL_MRAMC110 size 0x1000 — MRAM controller 0
0x5F093000 GLOBAL_MRAMC111 size 0x1000 — MRAM controller 1
0x5F8C5000 GLOBAL_OTPC size 0x1000 — OTP controller
0x5F8C8000 GLOBAL_VPR120 size 0x1000 — VPR peripheral registers 0
0x5F8D1000 GLOBAL_IPCT120 size 0x1000 — IPCT APB registers 0
0x5F8D4000 GLOBAL_VPR121 size 0x1000 — VPR peripheral registers 1
0x5F8E1000 GLOBAL_DPPIC120 size 0x1000 — Distributed programmable peripheral interconnect controller 0
0x5F8E2000 GLOBAL_TIMER120 size 0x1000 — Timer/Counter 0
0x5F8E6000 GLOBAL_SPIM120 size 0x1000 — Serial Peripheral Interface Master with EasyDMA 0
0x5F8E6000 GLOBAL_SPIS120 size 0x1000 — SPI Slave 0
0x5F8E6000 GLOBAL_UARTE120 size 0x1000 — UART with EasyDMA 0
0x5F908000 GLOBAL_VPR130 size 0x1000 — VPR peripheral registers 2
0x5F90A000 GLOBAL_AHBBUFFER_APP size 0x1000 — AHB Buffer 0
0x5F90C000 GLOBAL_AHBBUFFER_CELL size 0x1000 — AHB Buffer 1
0x5F921000 GLOBAL_IPCT130 size 0x1000 — IPCT APB registers 1
0x5F922000 GLOBAL_DPPIC130 size 0x1000 — Distributed programmable peripheral interconnect controller 1
0x5F928000 GLOBAL_RTC130 size 0x1000 — Real-time counter
0x5F92B000 GLOBAL_WDT131 size 0x1000 — Watchdog Timer 0
0x5F92C000 GLOBAL_WDT132 size 0x1000 — Watchdog Timer 1
0x5F92D000 GLOBAL_EGU130 size 0x1000 — Event generator unit
0x5F934000 GLOBAL_GPIOTE130 size 0x1000 — GPIO Tasks and Events
0x5F938000 GLOBAL_P0 size 0x200 — GPIO Port 0
0x5F938200 GLOBAL_P1 size 0x200 — GPIO Port 1
0x5F938400 GLOBAL_P2 size 0x200 — GPIO Port 2
0x5F938A00 GLOBAL_P5 size 0x200 — GPIO Port 3
0x5F939400 GLOBAL_P10 size 0x200 — GPIO Port 4
0x5F939800 GLOBAL_P12 size 0x200 — GPIO Port 5
0x5F939E00 GLOBAL_GPIOINTERNAL size 0x2000 — GPIO Internal
0x5F949000 GLOBAL_RESETHUB size 0x1000 — Reset hub
0x5F957000 GLOBAL_AUDIOPLL size 0x1000 — AUXPLL
0x5F968000 GLOBAL_AUDIOPLLPM size 0x1000 — AUXPM
0x5F981000 GLOBAL_DPPIC131 size 0x1000 — Distributed programmable peripheral interconnect controller 2
0x5F982000 GLOBAL_SAADC size 0x1000 — Analog to Digital Converter
0x5F984000 GLOBAL_TEMP size 0x1000 — Temperature Sensor
0x5F985000 GLOBAL_NFCT size 0x1000 — NFC-A compatible radio NFC-A compatible radio
0x5F991000 GLOBAL_DPPIC132 size 0x1000 — Distributed programmable peripheral interconnect controller 3
0x5F993000 GLOBAL_PDM size 0x1000 — Pulse Density Modulation (Digital Microphone) Interface
0x5F996000 GLOBAL_SIMIF130 size 0x1000 — SIM card interface
0x5F99B000 GLOBAL_MIPIRFFE size 0x1000 — MipiRffe Master
0x5F99C000 GLOBAL_GRTC size 0x1000 — Global Real-time counter
0x5F9A1000 GLOBAL_DPPIC133 size 0x1000 — Distributed programmable peripheral interconnect controller 4
0x5F9A2000 GLOBAL_TIMER130 size 0x1000 — Timer/Counter 1
0x5F9A3000 GLOBAL_TIMER131 size 0x1000 — Timer/Counter 2
0x5F9A4000 GLOBAL_PWM130 size 0x1000 — Pulse width modulation unit 0
0x5F9A5000 GLOBAL_SPIM130 size 0x1000 — Serial Peripheral Interface Master with EasyDMA 1
0x5F9A5000 GLOBAL_SPIS130 size 0x1000 — SPI Slave 1
0x5F9A5000 GLOBAL_TWIM130 size 0x1000 — I2C compatible Two-Wire Master Interface with EasyDMA 0
0x5F9A5000 GLOBAL_TWIS130 size 0x1000 — I2C compatible Two-Wire Slave Interface with EasyDMA 0
0x5F9A5000 GLOBAL_UARTE130 size 0x1000 — UART with EasyDMA 1
0x5F9A6000 GLOBAL_SPIM131 size 0x1000 — Serial Peripheral Interface Master with EasyDMA 2
0x5F9A6000 GLOBAL_SPIS131 size 0x1000 — SPI Slave 2
0x5F9A6000 GLOBAL_TWIM131 size 0x1000 — I2C compatible Two-Wire Master Interface with EasyDMA 1
0x5F9A6000 GLOBAL_TWIS131 size 0x1000 — I2C compatible Two-Wire Slave Interface with EasyDMA 1
0x5F9A6000 GLOBAL_UARTE131 size 0x1000 — UART with EasyDMA 2
0x5F9B1000 GLOBAL_DPPIC134 size 0x1000 — Distributed programmable peripheral interconnect controller 5
0x5F9B2000 GLOBAL_TIMER132 size 0x1000 — Timer/Counter 3
0x5F9B3000 GLOBAL_TIMER133 size 0x1000 — Timer/Counter 4
0x5F9B4000 GLOBAL_PWM131 size 0x1000 — Pulse width modulation unit 1
0x5F9B5000 GLOBAL_SPIM132 size 0x1000 — Serial Peripheral Interface Master with EasyDMA 3
0x5F9B5000 GLOBAL_SPIS132 size 0x1000 — SPI Slave 3
0x5F9B5000 GLOBAL_TWIM132 size 0x1000 — I2C compatible Two-Wire Master Interface with EasyDMA 2
0x5F9B5000 GLOBAL_TWIS132 size 0x1000 — I2C compatible Two-Wire Slave Interface with EasyDMA 2
0x5F9B5000 GLOBAL_UARTE132 size 0x1000 — UART with EasyDMA 3
0x5F9B6000 GLOBAL_SPIM133 size 0x1000 — Serial Peripheral Interface Master with EasyDMA 4
0x5F9B6000 GLOBAL_SPIS133 size 0x1000 — SPI Slave 4
0x5F9B6000 GLOBAL_TWIM133 size 0x1000 — I2C compatible Two-Wire Master Interface with EasyDMA 3
0x5F9B6000 GLOBAL_TWIS133 size 0x1000 — I2C compatible Two-Wire Slave Interface with EasyDMA 3
0x5F9B6000 GLOBAL_UARTE133 size 0x1000 — UART with EasyDMA 4
0xA0000000 GLOBAL_STMDATA size 0x10000000 — System Trace Macrocell data buffer
0xBF001000 GLOBAL_TDDCONF size 0x1000 — TDDCONF
0xBF041000 GLOBAL_TSGEN size 0x1000 — Timestamp generator
0xBF042000 GLOBAL_STM size 0x1000 — System Trace Macrocell
0xBF043000 GLOBAL_TPIU size 0x1000 — Trace Port Interface Unit
0xBF044000 GLOBAL_ETB size 0x1000 — Embedded Trace Buffer
0xBF045000 GLOBAL_ETR size 0x1000 — Embedded Trace Router
0xBF046000 GLOBAL_CTI210 size 0x1000 — Cross-Trigger Interface control. NOTE: this is not a separate peripheral, but describes CM33 functionality. 0
0xBF047000 GLOBAL_CTI211 size 0x1000 — Cross-Trigger Interface control. NOTE: this is not a separate peripheral, but describes CM33 functionality. 1
0xBF048000 GLOBAL_ATBREPLICATOR210 size 0x1000 — ATB Replicator module 0
0xBF049000 GLOBAL_ATBREPLICATOR211 size 0x1000 — ATB Replicator module 1
0xBF04A000 GLOBAL_ATBREPLICATOR212 size 0x1000 — ATB Replicator module 2
0xBF04B000 GLOBAL_ATBREPLICATOR213 size 0x1000 — ATB Replicator module 3
0xBF04C000 GLOBAL_ATBFUNNEL210 size 0x1000 — ATB funnel module 0
0xBF04D000 GLOBAL_ATBFUNNEL211 size 0x1000 — ATB funnel module 1
0xBF04E000 GLOBAL_ATBFUNNEL212 size 0x1000 — ATB funnel module 2
0xBF04F000 GLOBAL_ATBFUNNEL213 size 0x1000 — ATB funnel module 3
0xBF050000 GLOBAL_GPR size 0x1000 — Granular Power Requester
0xF0000000 VPRCLIC size 0x3000 — VPR CLIC registers

## Interrupts
{n} VPRCLIC_{n} (VPRCLIC) (n=0..31)
32 VPRTIM
104 GPIOTE130_0 (GLOBAL_GPIOTE130)
105 GPIOTE130_1 (GLOBAL_GPIOTE130)
108 GRTC_0 (GLOBAL_GRTC)
109 GRTC_1 (GLOBAL_GRTC)
146 MRAMC110 (GLOBAL_MRAMC110)
147 MRAMC111 (GLOBAL_MRAMC111)
197 OTPC (GLOBAL_OTPC)
200 VPR120 (GLOBAL_VPR120)
209 IPCT120_0 (GLOBAL_IPCT120)
212 VPR121 (GLOBAL_VPR121)
226 TIMER120 (GLOBAL_TIMER120)
230 SPIM120_SPIS120_UARTE120 (GLOBAL_SPIM120, GLOBAL_SPIS120, GLOBAL_UARTE120)
264 VPR130 (GLOBAL_VPR130)
266 AHBBUFFER_APP (GLOBAL_AHBBUFFER_APP)
268 AHBBUFFER_CELL (GLOBAL_AHBBUFFER_CELL)
289 IPCT130_0 (GLOBAL_IPCT130)
296 RTC130 (GLOBAL_RTC130)
299 WDT131 (GLOBAL_WDT131)
300 WDT132 (GLOBAL_WDT132)
301 EGU130 (GLOBAL_EGU130)
329 RESETHUB (GLOBAL_RESETHUB)
343 AUDIOPLL (GLOBAL_AUDIOPLL)
360 AUDIOPLLPM (GLOBAL_AUDIOPLLPM)
386 SAADC (GLOBAL_SAADC)
388 TEMP (GLOBAL_TEMP)
389 NFCT (GLOBAL_NFCT)
403 PDM (GLOBAL_PDM)
406 SIMIF130 (GLOBAL_SIMIF130)
411 MIPIRFFE (GLOBAL_MIPIRFFE)
418 TIMER130 (GLOBAL_TIMER130)
419 TIMER131 (GLOBAL_TIMER131)
420 PWM130 (GLOBAL_PWM130)
421 SERIAL0 (GLOBAL_SPIM130, GLOBAL_SPIS130, GLOBAL_TWIM130, GLOBAL_TWIS130, GLOBAL_UARTE130)
422 SERIAL1 (GLOBAL_SPIM131, GLOBAL_SPIS131, GLOBAL_TWIM131, GLOBAL_TWIS131, GLOBAL_UARTE131)
434 TIMER132 (GLOBAL_TIMER132)
435 TIMER133 (GLOBAL_TIMER133)
436 PWM131 (GLOBAL_PWM131)
437 SERIAL2 (GLOBAL_SPIM132, GLOBAL_SPIS132, GLOBAL_TWIM132, GLOBAL_TWIS132, GLOBAL_UARTE132)
438 SERIAL3 (GLOBAL_SPIM133, GLOBAL_SPIS133, GLOBAL_TWIM133, GLOBAL_TWIS133, GLOBAL_UARTE133)

## Further device data
MaxInterrupts=480

## Licence text in the file
Copyright (c) 2010 - 2025, Nordic Semiconductor ASA All rights reserved. Redistribution and use in source and binary forms, with or without modification, are permitted provided that the following conditions are met: 1. Redistributions of source code must retain the above copyright notice, this list of conditions and the following disclaimer. 2. Redistributions in binary form, except as embedded into a Nordic Semiconductor ASA integrated circuit in a product or a software update for such product, must reproduce the above copyright notice, this list of conditions and the following disclaimer in the documentation and/or other materials provided with the distribution. 3. Neither the name of Nordic Semiconductor ASA nor the names of its contributors may be used to endorse or promote products derived from this software without specific prior written permission. 4. This software, with or without modification, must only be used with a Nordic Semiconductor ASA integrated circuit. 5. Any software provided in binary form under this license must not be reverse engineered, decompiled, modified and/or disassembled. THIS SOFTWARE IS PROVIDED BY NORDIC SEMICONDUCTOR ASA "AS IS" AND ANY EXPRESS OR IMPLIED WARRANTIES, INCLUDING, BUT NOT LIMITED TO, THE IMPLIED WARRANTIES OF MERCHANTABILITY, NONINFRINGEMENT, AND FITNESS FOR A PARTICULAR PURPOSE ARE DISCLAIMED. IN NO EVENT SHALL NORDIC SEMICONDUCTOR ASA OR CONTRIBUTORS BE LIABLE FOR ANY DIRECT, INDIRECT, INCIDENTAL, SPECIAL, EXEMPLARY, OR CONSEQUENTIAL DAMAGES (INCLUDING, BUT NOT LIMITED TO, PROCUREMENT OF SUBSTITUTE GOODS OR SERVICES; LOSS OF USE, DATA, OR PROFITS; OR BUSINESS INTERRUPTION) HOWEVER CAUSED AND ON ANY THEORY OF LIABILITY, WHETHER IN CONTRACT, STRICT LIABILITY, OR TORT (INCLUDING NEGLIGENCE OR OTHERWISE) ARISING IN ANY WAY OUT OF THE USE OF THIS SOFTWARE, EVEN IF ADVISED OF THE POSSIBILITY OF SUCH DAMAGE.
