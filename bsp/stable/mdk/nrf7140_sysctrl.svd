# nrf7140_sysctrl register map
Vendor: Nordic Semiconductor; Series: nRF71; File version: 1
nRF7140 is an ultra-low power multi-core System on Chip (SoC)
Registers are 32-bit, read-write, reset 0x0 unless marked. A register's access mark holds for its fields unless they carry their own. Offsets are from the block's base; lines under a group give offsets from that group; [hi:lo] are bit positions; {n}, {i} and the like mark numbered series; 'fields as' and 'values as' point back to an identical list; <NAME> marks a mode.

## Memory map
0x00000000 VPRTIM size 0x1000 — VTIM CSR registers
0x0FFFE000 GLOBAL_FICR size 0xC00 — Factory Information Configuration Registers
0x2F700000 GLOBAL_USBHSCORE0 size 0x24000 — USBHSCORE
0x2F840000 OICR size 0x4000 — One time programmable Information Configuration Registers
0x2FBE0000 GLOBAL_I3CCORE120 size 0x1000 — I3CCORE 0
0x2FBE1000 GLOBAL_I3CCORE121 size 0x1000 — I3CCORE 1
0x2FBEF800 GLOBAL_DMU120 size 0x1000 — DMU 0
0x2FBEF800 GLOBAL_MCAN120 size 0x1000 — MCAN 0
0x2FBF7800 GLOBAL_DMU121 size 0x1000 — DMU 1
0x2FBF7800 GLOBAL_MCAN121 size 0x1000 — MCAN 1
0x3F640000 L2CACHEDATA size 0x1000 — CACHEDATA
0x3F680000 L2CACHEINFO size 0x1000 — CACHEINFO
0x49000000 GLOBAL_GPU size 0x2000 — GPU
0x49004000 GLOBAL_DISPC size 0x2000 — DISPC
0x49008000 GLOBAL_GSI size 0x3000 — GSI
0x4900B000 GLOBAL_GFXPLL size 0x1000 — AUXPLL
0x4900C000 GLOBAL_GFXPLLPM size 0x1000 — AUXPM
0x4900CF00 GLOBAL_PCGCSBUS size 0x1000 — PCGCSlave
0x4900D000 GLOBAL_HSFLL300 size 0x1000 — HSFLL 0
0x4900E000 GLOBAL_LRCCONF300 size 0x1000 — LRCCONF 0
0x4900F000 GLOBAL_PCGCM300 size 0x1000 — PCGC Master 0
0x49011000 GLOBAL_MEMCONF310 size 0x1000 — Memory configuration
0x49012000 GLOBAL_VREGGFX size 0x1000 — VREGVS0V8 peripheral
0x4901E000 GLOBAL_LRCCONF310 size 0x1000 — LRCCONF 1
0x4901F000 GLOBAL_PCGCM310 size 0x1000 — PCGC Master 1
0x4F8CA000 GLOBAL_LRCCONF_SDCARD size 0x1000 — LRCCONF
0x4F8D2000 GLOBAL_MUTEX120 size 0x1000 — MUTEX 0
0x4F8D2000 GLOBAL_PROTOTYPE size 0x1000 — Prototype HW information registers.
0x4F927000 GLOBAL_MUTEX130 size 0x1000 — MUTEX 1
0x5F082000 L2CACHE size 0x1000 — Cache
0x5F083000 RAMC110 size 0x1000 — RAM Controller 0
0x5F084000 RAMC111 size 0x1000 — RAM Controller 1
0x5F085000 RAMC112 size 0x1000 — RAM Controller 2
0x5F086000 GLOBAL_USBHS size 0x1000 — USBHS
0x5F088000 SHA3 size 0x1000 — CRACEN
0x5F089000 SHA3CORE size 0x1000 — CRACENCORE
0x5F08E000 PCGCS110 size 0x1000 — PCGCSlave 1
0x5F08F000 PCGCM110 size 0x1000 — PCGC Master 2
0x5F092000 GLOBAL_MRAMC110 size 0x1000 — MRAM controller 0
0x5F093000 GLOBAL_MRAMC111 size 0x1000 — MRAM controller 1
0x5F094000 EXMEE size 0x1000 — EXternal Memory Encryption Engine
0x5F095000 GLOBAL_EXMIF size 0x1000 — External Memory Interface
0x5F097000 MVDMA110 size 0x1000 — MVDMA performs direct-memory-accesses between memories. Data is transferred according to job descriptor lists. Each transfer has corresponding source and sink descriptor lists with matching data amounts. The lists are in memory and they contain data buffer information, address pointers, buffer sizes and data type attributes.
0x5F098000 PPIB110 size 0x1000 — PPIB APB registers 0
0x5F8C2000 GLOBAL_CANPLL size 0x1000 — AUXPLL 0
0x5F8C2000 GLOBAL_CANPLLPM size 0x1000 — AUXPM 0
0x5F8C3000 RAMC120 size 0x1000 — RAM Controller 3
0x5F8C4000 RAMC121 size 0x1000 — RAM Controller 4
0x5F8C5000 GLOBAL_OTPC size 0x1000 — OTP controller
0x5F8C6000 ROMC size 0x1000 — ROM Controller
0x5F8C7000 MEMCONF120 size 0x1000 — Memory configuration 0
0x5F8C8000 GLOBAL_VPR120 size 0x1000 — VPR peripheral registers 0
0x5F8C9000 GLOBAL_SDCARD size 0x1000 — SD-Card and eMMC
0x5F8CB000 GLOBAL_HSFLL122 size 0x1000 — HSFLL 1
0x5F8CC000 GLOBAL_HSFLL121 size 0x1000 — HSFLL 2
0x5F8CD000 HSFLL120 size 0x1000 — HSFLL 1
0x5F8CE000 LRCCONF120 size 0x1000 — LRCCONF 2
0x5F8CE000 RESETINFO120 size 0x1000 — RESETINFO 0
0x5F8CF000 PCGCM120 size 0x1000 — PCGC Master 3
0x5F8D1000 GLOBAL_IPCT120 size 0x1000 — IPCT APB registers 0
0x5F8D3000 GLOBAL_I3C120 size 0x1000 — I3C 0
0x5F8D4000 GLOBAL_VPR121 size 0x1000 — VPR peripheral registers 1
0x5F8D7000 GLOBAL_QSPI120 size 0x1000 — Quad serial peripheral interface 0
0x5F8D8000 GLOBAL_CAN120 size 0x1000 — Controller Area Network 0
0x5F8D9000 GLOBAL_MVDMA120 size 0x1000 — MVDMA performs direct-memory-accesses between memories. Data is transferred according to job descriptor lists. Each transfer has corresponding source and sink descriptor lists with matching data amounts. The lists are in memory and they contain data buffer information, address pointers, buffer sizes and data type attributes. 0
0x5F8DA000 GLOBAL_RAMC122 size 0x1000 — RAM Controller 0
0x5F8DB000 GLOBAL_CAN121 size 0x1000 — Controller Area Network 1
0x5F8DC000 GLOBAL_MVDMA121 size 0x1000 — MVDMA performs direct-memory-accesses between memories. Data is transferred according to job descriptor lists. Each transfer has corresponding source and sink descriptor lists with matching data amounts. The lists are in memory and they contain data buffer information, address pointers, buffer sizes and data type attributes. 1
0x5F8DD000 GLOBAL_RAMC123 size 0x1000 — RAM Controller 1
0x5F8DE000 GLOBAL_I3C121 size 0x1000 — I3C 1
0x5F8DF000 GLOBAL_QSPI121 size 0x1000 — Quad serial peripheral interface 1
0x5F8E1000 GLOBAL_DPPIC120 size 0x1000 — Distributed programmable peripheral interconnect controller 0
0x5F8E2000 GLOBAL_TIMER120 size 0x1000 — Timer/Counter 0
0x5F8E3000 GLOBAL_TIMER121 size 0x1000 — Timer/Counter 1
0x5F8E4000 GLOBAL_PWM120 size 0x1000 — Pulse width modulation unit 0
0x5F8E5000 GLOBAL_SPIS120 size 0x1000 — SPI Slave 0
0x5F8E6000 GLOBAL_SPIM120 size 0x1000 — Serial Peripheral Interface Master with EasyDMA 0
0x5F8E6000 GLOBAL_UARTE120 size 0x1000 — UART with EasyDMA 0
0x5F8E7000 GLOBAL_SPIM121 size 0x1000 — Serial Peripheral Interface Master with EasyDMA 1
0x5F8E8000 GLOBAL_SPIM122 size 0x1000 — Serial Peripheral Interface Master with EasyDMA 2
0x5F8E9000 GLOBAL_SPIM123 size 0x1000 — Serial Peripheral Interface Master with EasyDMA 3
0x5F8EA000 PCGCS120 size 0x1000 — PCGCSlave 2
0x5F8EB000 PCGCS121 size 0x1000 — PCGCSlave 3
0x5F8EC000 PCGCS122 size 0x1000 — PCGCSlave 4
0x5F8ED000 PCGCM121 size 0x1000 — PCGC Master 4
0x5F8EE000 PPIB120 size 0x1000 — PPIB APB registers 1
0x5F8EF000 PPIB121 size 0x1000 — PPIB APB registers 2
0x5F903000 RAMC130 size 0x1000 — RAM Controller 5
0x5F904000 RAMC131 size 0x1000 — RAM Controller 6
0x5F905000 MEMCONF130 size 0x1000 — Memory configuration 1
0x5F908000 GLOBAL_VPR130 size 0x1000 — VPR peripheral registers 2
0x5F90E000 PCGCS130 size 0x1000 — PCGCSlave 5
0x5F921000 GLOBAL_IPCT130 size 0x1000 — IPCT APB registers 1
0x5F922000 GLOBAL_DPPIC130 size 0x1000 — Distributed programmable peripheral interconnect controller 1
0x5F925000 PPIB130 size 0x1000 — PPIB APB registers 3
0x5F926000 PPIB131 size 0x1000 — PPIB APB registers 4
0x5F928000 GLOBAL_RTC130 size 0x1000 — Real-time counter 0
0x5F929000 GLOBAL_RTC131 size 0x1000 — Real-time counter 1
0x5F92A000 WDT130 size 0x1000 — Watchdog Timer
0x5F92B000 GLOBAL_WDT131 size 0x1000 — Watchdog Timer 0
0x5F92C000 GLOBAL_WDT132 size 0x1000 — Watchdog Timer 1
0x5F92D000 GLOBAL_EGU130 size 0x1000 — Event generator unit
0x5F92E000 GLOBAL_COEXC size 0x1000 — Coexistence controller
0x5F934000 GLOBAL_GPIOTE130 size 0x1000 — GPIO Tasks and Events
0x5F938000 GLOBAL_P0 size 0x200 — GPIO Port 0
0x5F938200 GLOBAL_P1 size 0x200 — GPIO Port 1
0x5F938400 GLOBAL_P2 size 0x200 — GPIO Port 2
0x5F938600 GLOBAL_P3 size 0x200 — GPIO Port 3
0x5F938A00 GLOBAL_P5 size 0x200 — GPIO Port 4
0x5F938C00 GLOBAL_P6 size 0x200 — GPIO Port 5
0x5F939000 GLOBAL_P8 size 0x200 — GPIO Port 6
0x5F939200 GLOBAL_P9 size 0x200 — GPIO Port 7
0x5F939E00 GLOBAL_GPIOINTERNAL size 0x2000 — GPIO Internal
0x5F93C000 PCGCS131 size 0x1000 — PCGCSlave 6
0x5F93D000 PCGCM130 size 0x1000 — PCGC Master 5
0x5F93E000 LRCCONF130 size 0x1000 — LRCCONF 3
0x5F93E000 RESETINFO130 size 0x1000 — RESETINFO 1
0x5F93F000 PCGCM131 size 0x1000 — PCGC Master 6
0x5F940000 GRCCONF size 0x1000
0x5F943000 PCRM size 0x1000
0x5F949000 GLOBAL_RESETHUB size 0x1000 — Reset hub
0x5F94E000 PCGCS132 size 0x1000 — PCGCSlave 7
0x5F94F000 PCGCM132 size 0x1000 — PCGC Master 7
0x5F950000 CLOCK size 0x1000
0x5F951000 LFRC size 0x1000 — LFRC peripheral
0x5F952000 LFLPRC size 0x1000 — LFLPRC peripheral
0x5F953000 LFXO size 0x1000 — LFXO peripheral
0x5F954000 FLL16M size 0x1000
0x5F955000 HFXO64M size 0x1000 — HFXO64M peripheral
0x5F956000 CLKMON size 0x1000 — CLKMON peripheral
0x5F957000 GLOBAL_AUDIOPLL size 0x1000 — AUXPLL 1
0x5F958000 GLOBAL_USBHSPLL size 0x1000 — AUXPLL 2
0x5F960000 POWER size 0x1000
0x5F961000 VREGMAIN size 0x1000 — VREGMAIN peripheral
0x5F962000 VREGAO1V8 size 0x1000 — VREGAO1V8 peripheral
0x5F963000 VREG1V0 size 0x1000
0x5F964000 VREGAO0V8 size 0x1000 — VREGAO0V8 peripheral
0x5F965000 VREGVS0V8 size 0x1000 — VREGVS0V8 peripheral
0x5F966000 VREGSU size 0x1000 — VREGSU peripheral
0x5F967000 GLOBAL_VREGUSB size 0x1000 — VREGUSB peripheral
0x5F968000 GLOBAL_AUDIOPLLPM size 0x1000 — AUXPM 1
0x5F969000 VREGMRAM130 size 0x1000 — VREGMRAM peripheral 0
0x5F96A000 VREGMRAM131 size 0x1000 — VREGMRAM peripheral 1
0x5F96B000 OSCRFR size 0x1000 — OSCRFR peripheral
0x5F96C000 SWEXT size 0x1000 — SWEXT peripheral
0x5F96D000 MBIAS size 0x1000 — MBIAS peripheral
0x5F96E000 VREG1V80V8 size 0x1000 — VREGVS0V8 peripheral
0x5F970000 VDETAO1V8 size 0x1000 — VDETAO1V8 peripheral
0x5F971000 VDETAO0V8 size 0x1000 — VDETAO0V8 peripheral
0x5F972000 VDETVS0V8 size 0x1000 — VDETVS0V8 peripheral
0x5F974000 VDETIO size 0x1000 — VDETIO peripheral
0x5F975000 VDETAO5V0 size 0x1000 — VDETAO5V0 peripheral
0x5F976000 VDET1V0 size 0x1000 — VDET1V0 peripheral
0x5F978000 PMICC size 0x1000 — PMIC Controller
0x5F979000 VDETPOF5V0 size 0x1000 — VDETPOF5V0 peripheral 0
0x5F97A000 VDETPOFVBAT size 0x1000 — VDETPOF5V0 peripheral 1
0x5F981000 GLOBAL_DPPIC131 size 0x1000 — Distributed programmable peripheral interconnect controller 2
0x5F982000 GLOBAL_SAADC size 0x1000 — Analog to Digital Converter
0x5F983000 GLOBAL_COMP size 0x1000 — Comparator
0x5F983000 GLOBAL_LPCOMP size 0x1000 — Low-power comparator
0x5F984000 GLOBAL_TEMP size 0x1000 — Temperature Sensor
0x5F985000 GLOBAL_NFCT size 0x1000 — NFC-A compatible radio NFC-A compatible radio
0x5F98D000 PPIB132 size 0x1000 — PPIB APB registers 5
0x5F98E000 PCGCS133 size 0x1000 — PCGCSlave 8
0x5F98F000 PCGCM133 size 0x1000 — PCGC Master 8
0x5F991000 GLOBAL_DPPIC132 size 0x1000 — Distributed programmable peripheral interconnect controller 3
0x5F992000 GLOBAL_TDM130 size 0x1000 — Time division multiplexed audio interface 0
0x5F994000 GLOBAL_QDEC130 size 0x1000 — Quadrature Decoder 0
0x5F995000 GLOBAL_QDEC131 size 0x1000 — Quadrature Decoder 1
0x5F996000 GLOBAL_SIMIF130 size 0x1000 — SIM card interface
0x5F997000 GLOBAL_TDM131 size 0x1000 — Time division multiplexed audio interface 1
0x5F999000 GLOBAL_TDM132 size 0x1000 — Time division multiplexed audio interface 2
0x5F99C000 GLOBAL_GRTC size 0x1000 — Global Real-time counter
0x5F99D000 PPIB133 size 0x1000 — PPIB APB registers 6
0x5F99E000 PCGCS134 size 0x1000 — PCGCSlave 9
0x5F99F000 PCGCM134 size 0x1000 — PCGC Master 9
0x5F9A1000 GLOBAL_DPPIC133 size 0x1000 — Distributed programmable peripheral interconnect controller 4
0x5F9A2000 GLOBAL_TIMER130 size 0x1000 — Timer/Counter 2
0x5F9A3000 GLOBAL_TIMER131 size 0x1000 — Timer/Counter 3
0x5F9A4000 GLOBAL_PWM130 size 0x1000 — Pulse width modulation unit 1
0x5F9A5000 GLOBAL_SPIM130 size 0x1000 — Serial Peripheral Interface Master with EasyDMA 4
0x5F9A5000 GLOBAL_SPIS130 size 0x1000 — SPI Slave 1
0x5F9A5000 GLOBAL_TWIM130 size 0x1000 — I2C compatible Two-Wire Master Interface with EasyDMA 0
0x5F9A5000 GLOBAL_TWIS130 size 0x1000 — I2C compatible Two-Wire Slave Interface with EasyDMA 0
0x5F9A5000 GLOBAL_UARTE130 size 0x1000 — UART with EasyDMA 1
0x5F9A6000 GLOBAL_SPIM131 size 0x1000 — Serial Peripheral Interface Master with EasyDMA 5
0x5F9A6000 GLOBAL_SPIS131 size 0x1000 — SPI Slave 2
0x5F9A6000 GLOBAL_TWIM131 size 0x1000 — I2C compatible Two-Wire Master Interface with EasyDMA 1
0x5F9A6000 GLOBAL_TWIS131 size 0x1000 — I2C compatible Two-Wire Slave Interface with EasyDMA 1
0x5F9A6000 GLOBAL_UARTE131 size 0x1000 — UART with EasyDMA 2
0x5F9A7000 GLOBAL_PDM130 size 0x1000 — Pulse Density Modulation (Digital Microphone) Interface 0
0x5F9AD000 PPIB134 size 0x1000 — PPIB APB registers 7
0x5F9AE000 PCGCS135 size 0x1000 — PCGCSlave 10
0x5F9AF000 PCGCM135 size 0x1000 — PCGC Master 10
0x5F9B1000 GLOBAL_DPPIC134 size 0x1000 — Distributed programmable peripheral interconnect controller 5
0x5F9B2000 GLOBAL_TIMER132 size 0x1000 — Timer/Counter 4
0x5F9B3000 GLOBAL_TIMER133 size 0x1000 — Timer/Counter 5
0x5F9B4000 GLOBAL_PWM131 size 0x1000 — Pulse width modulation unit 2
0x5F9B5000 GLOBAL_SPIM132 size 0x1000 — Serial Peripheral Interface Master with EasyDMA 6
0x5F9B5000 GLOBAL_SPIS132 size 0x1000 — SPI Slave 3
0x5F9B5000 GLOBAL_TWIM132 size 0x1000 — I2C compatible Two-Wire Master Interface with EasyDMA 2
0x5F9B5000 GLOBAL_TWIS132 size 0x1000 — I2C compatible Two-Wire Slave Interface with EasyDMA 2
0x5F9B5000 GLOBAL_UARTE132 size 0x1000 — UART with EasyDMA 3
0x5F9B6000 GLOBAL_SPIM133 size 0x1000 — Serial Peripheral Interface Master with EasyDMA 7
0x5F9B6000 GLOBAL_SPIS133 size 0x1000 — SPI Slave 4
0x5F9B6000 GLOBAL_TWIM133 size 0x1000 — I2C compatible Two-Wire Master Interface with EasyDMA 3
0x5F9B6000 GLOBAL_TWIS133 size 0x1000 — I2C compatible Two-Wire Slave Interface with EasyDMA 3
0x5F9B6000 GLOBAL_UARTE133 size 0x1000 — UART with EasyDMA 4
0x5F9B7000 GLOBAL_PDM131 size 0x1000 — Pulse Density Modulation (Digital Microphone) Interface 1
0x5F9BD000 PPIB135 size 0x1000 — PPIB APB registers 8
0x5F9BE000 PCGCS136 size 0x1000 — PCGCSlave 11
0x5F9BF000 PCGCM136 size 0x1000 — PCGC Master 11
0x5F9C1000 GLOBAL_DPPIC135 size 0x1000 — Distributed programmable peripheral interconnect controller 6
0x5F9C2000 GLOBAL_TIMER134 size 0x1000 — Timer/Counter 6
0x5F9C3000 GLOBAL_TIMER135 size 0x1000 — Timer/Counter 7
0x5F9C4000 GLOBAL_PWM132 size 0x1000 — Pulse width modulation unit 3
0x5F9C5000 GLOBAL_SPIM134 size 0x1000 — Serial Peripheral Interface Master with EasyDMA 8
0x5F9C5000 GLOBAL_SPIS134 size 0x1000 — SPI Slave 5
0x5F9C5000 GLOBAL_TWIM134 size 0x1000 — I2C compatible Two-Wire Master Interface with EasyDMA 4
0x5F9C5000 GLOBAL_TWIS134 size 0x1000 — I2C compatible Two-Wire Slave Interface with EasyDMA 4
0x5F9C5000 GLOBAL_UARTE134 size 0x1000 — UART with EasyDMA 5
0x5F9C6000 GLOBAL_SPIM135 size 0x1000 — Serial Peripheral Interface Master with EasyDMA 9
0x5F9C6000 GLOBAL_SPIS135 size 0x1000 — SPI Slave 6
0x5F9C6000 GLOBAL_TWIM135 size 0x1000 — I2C compatible Two-Wire Master Interface with EasyDMA 5
0x5F9C6000 GLOBAL_TWIS135 size 0x1000 — I2C compatible Two-Wire Slave Interface with EasyDMA 5
0x5F9C6000 GLOBAL_UARTE135 size 0x1000 — UART with EasyDMA 6
0x5F9C7000 GLOBAL_PDM132 size 0x1000 — Pulse Density Modulation (Digital Microphone) Interface 2
0x5F9CD000 PPIB136 size 0x1000 — PPIB APB registers 9
0x5F9CE000 PCGCS137 size 0x1000 — PCGCSlave 12
0x5F9CF000 PCGCM137 size 0x1000 — PCGC Master 12
0x5F9D1000 GLOBAL_DPPIC136 size 0x1000 — Distributed programmable peripheral interconnect controller 7
0x5F9D2000 GLOBAL_TIMER136 size 0x1000 — Timer/Counter 8
0x5F9D3000 GLOBAL_TIMER137 size 0x1000 — Timer/Counter 9
0x5F9D4000 GLOBAL_PWM133 size 0x1000 — Pulse width modulation unit 4
0x5F9D5000 GLOBAL_SPIM136 size 0x1000 — Serial Peripheral Interface Master with EasyDMA 10
0x5F9D5000 GLOBAL_SPIS136 size 0x1000 — SPI Slave 7
0x5F9D5000 GLOBAL_TWIM136 size 0x1000 — I2C compatible Two-Wire Master Interface with EasyDMA 6
0x5F9D5000 GLOBAL_TWIS136 size 0x1000 — I2C compatible Two-Wire Slave Interface with EasyDMA 6
0x5F9D5000 GLOBAL_UARTE136 size 0x1000 — UART with EasyDMA 7
0x5F9D6000 GLOBAL_SPIM137 size 0x1000 — Serial Peripheral Interface Master with EasyDMA 11
0x5F9D6000 GLOBAL_SPIS137 size 0x1000 — SPI Slave 8
0x5F9D6000 GLOBAL_TWIM137 size 0x1000 — I2C compatible Two-Wire Master Interface with EasyDMA 7
0x5F9D6000 GLOBAL_TWIS137 size 0x1000 — I2C compatible Two-Wire Slave Interface with EasyDMA 7
0x5F9D6000 GLOBAL_UARTE137 size 0x1000 — UART with EasyDMA 8
0x5F9D7000 GLOBAL_PDM133 size 0x1000 — Pulse Density Modulation (Digital Microphone) Interface 3
0x5F9DD000 PPIB137 size 0x1000 — PPIB APB registers 10
0x5F9DE000 PCGCS138 size 0x1000 — PCGCSlave 13
0x5F9DF000 PCGCM138 size 0x1000 — PCGC Master 13
0xA0000000 GLOBAL_STMDATA size 0x10000000 — System Trace Macrocell data buffer
0xBF001000 GLOBAL_TDDCONF size 0x1000 — TDDCONF
0xBF003000 GLOBAL_TBM size 0x1000 — Trace buffer monitor
0xBF004000 HSFLL200 size 0x1000 — HSFLL 0
0xBF005000 LRCCONF200 size 0x1000 — LRCCONF 0
0xBF006000 PCGCM200 size 0x1000 — PCGC Master 0
0xBF011000 PCGCS200 size 0x1000 — PCGCSlave 0
0xBF012000 LRCCONF210 size 0x1000 — LRCCONF 1
0xBF013000 PCGCM210 size 0x1000 — PCGC Master 1
0xBF041000 GLOBAL_TSGEN size 0x1000 — Timestamp generator
0xBF042000 GLOBAL_STM size 0x1000 — System Trace Macrocell
0xBF043000 GLOBAL_TPIU size 0x1000 — Trace Port Interface Unit
0xBF044000 GLOBAL_ETB size 0x1000 — Embedded Trace Buffer
0xBF045000 GLOBAL_ETR size 0x1000 — Embedded Trace Router
0xBF046000 GLOBAL_CTI210 size 0x1000 — Cross-Trigger Interface control 0
0xBF047000 GLOBAL_CTI211 size 0x1000 — Cross-Trigger Interface control 1
0xBF048000 GLOBAL_ATBREPLICATOR210 size 0x1000 — ATB Replicator module 0
0xBF049000 GLOBAL_ATBREPLICATOR211 size 0x1000 — ATB Replicator module 1
0xBF04A000 GLOBAL_ATBREPLICATOR212 size 0x1000 — ATB Replicator module 2
0xBF04B000 GLOBAL_ATBREPLICATOR213 size 0x1000 — ATB Replicator module 3
0xBF04C000 GLOBAL_ATBFUNNEL210 size 0x1000 — ATB funnel module 0
0xBF04D000 GLOBAL_ATBFUNNEL211 size 0x1000 — ATB funnel module 1
0xBF04E000 GLOBAL_ATBFUNNEL212 size 0x1000 — ATB funnel module 2
0xBF04F000 GLOBAL_ATBFUNNEL213 size 0x1000 — ATB funnel module 3
0xF0000000 VPRCLIC size 0x3000 — VPR CLIC registers

## Interrupts
{n} VPRCLIC_{n} (VPRCLIC) (n=0..31)
32 VPRTIM
104 GPIOTE130_0 (GLOBAL_GPIOTE130)
105 GPIOTE130_1 (GLOBAL_GPIOTE130)
108 GRTC_0 (GLOBAL_GRTC)
109 GRTC_1 (GLOBAL_GRTC)
110 GRTC_2 (GLOBAL_GRTC)
111 GSI (GLOBAL_GSI)
112 DISPC_0 (GLOBAL_DISPC)
113 DISPC_1 (GLOBAL_DISPC)
114 DISPC_2 (GLOBAL_DISPC)
115 GPU (GLOBAL_GPU)
127 TBM (GLOBAL_TBM)
130 L2CACHE
134 USBHS (GLOBAL_USBHS)
136 SHA3
146 MRAMC110 (GLOBAL_MRAMC110)
147 MRAMC111 (GLOBAL_MRAMC111)
148 EXMEE
149 EXMIF (GLOBAL_EXMIF)
151 MVDMA110
197 OTPC (GLOBAL_OTPC)
200 VPR120 (GLOBAL_VPR120)
209 IPCT120_0 (GLOBAL_IPCT120)
211 I3C120 (GLOBAL_I3C120)
212 VPR121 (GLOBAL_VPR121)
215 QSPI120 (GLOBAL_QSPI120)
216 CAN120 (GLOBAL_CAN120)
217 MVDMA120 (GLOBAL_MVDMA120)
219 CAN121 (GLOBAL_CAN121)
220 MVDMA121 (GLOBAL_MVDMA121)
222 I3C121 (GLOBAL_I3C121)
223 QSPI121 (GLOBAL_QSPI121)
226 TIMER120 (GLOBAL_TIMER120)
227 TIMER121 (GLOBAL_TIMER121)
228 PWM120 (GLOBAL_PWM120)
229 SPIS120 (GLOBAL_SPIS120)
230 SPIM120_UARTE120 (GLOBAL_SPIM120, GLOBAL_UARTE120)
231 SPIM121 (GLOBAL_SPIM121)
232 SPIM122 (GLOBAL_SPIM122)
233 SPIM123 (GLOBAL_SPIM123)
264 VPR130 (GLOBAL_VPR130)
289 IPCT130_0 (GLOBAL_IPCT130)
296 RTC130 (GLOBAL_RTC130)
297 RTC131 (GLOBAL_RTC131)
298 WDT130
299 WDT131 (GLOBAL_WDT131)
300 WDT132 (GLOBAL_WDT132)
301 EGU130 (GLOBAL_EGU130)
320 GRCCONF_0 (GRCCONF)
321 GRCCONF_1 (GRCCONF)
322 GRCCONF_2 (GRCCONF)
323 PCRM
329 RESETHUB (GLOBAL_RESETHUB)
343 AUDIOPLL (GLOBAL_AUDIOPLL)
344 USBHSPLL (GLOBAL_USBHSPLL)
359 VREGUSB (GLOBAL_VREGUSB)
360 AUDIOPLLPM (GLOBAL_AUDIOPLLPM)
376 PMICC
386 SAADC (GLOBAL_SAADC)
387 COMP_LPCOMP (GLOBAL_COMP, GLOBAL_LPCOMP)
388 TEMP (GLOBAL_TEMP)
389 NFCT (GLOBAL_NFCT)
402 TDM130 (GLOBAL_TDM130)
404 QDEC130 (GLOBAL_QDEC130)
405 QDEC131 (GLOBAL_QDEC131)
406 SIMIF130 (GLOBAL_SIMIF130)
407 TDM131 (GLOBAL_TDM131)
409 TDM132 (GLOBAL_TDM132)
418 TIMER130 (GLOBAL_TIMER130)
419 TIMER131 (GLOBAL_TIMER131)
420 PWM130 (GLOBAL_PWM130)
421 SERIAL0 (GLOBAL_SPIM130, GLOBAL_SPIS130, GLOBAL_TWIM130, GLOBAL_TWIS130, GLOBAL_UARTE130)
422 SERIAL1 (GLOBAL_SPIM131, GLOBAL_SPIS131, GLOBAL_TWIM131, GLOBAL_TWIS131, GLOBAL_UARTE131)
423 PDM130 (GLOBAL_PDM130)
434 TIMER132 (GLOBAL_TIMER132)
435 TIMER133 (GLOBAL_TIMER133)
436 PWM131 (GLOBAL_PWM131)
437 SERIAL2 (GLOBAL_SPIM132, GLOBAL_SPIS132, GLOBAL_TWIM132, GLOBAL_TWIS132, GLOBAL_UARTE132)
438 SERIAL3 (GLOBAL_SPIM133, GLOBAL_SPIS133, GLOBAL_TWIM133, GLOBAL_TWIS133, GLOBAL_UARTE133)
439 PDM131 (GLOBAL_PDM131)
450 TIMER134 (GLOBAL_TIMER134)
451 TIMER135 (GLOBAL_TIMER135)
452 PWM132 (GLOBAL_PWM132)
453 SERIAL4 (GLOBAL_SPIM134, GLOBAL_SPIS134, GLOBAL_TWIM134, GLOBAL_TWIS134, GLOBAL_UARTE134)
454 SERIAL5 (GLOBAL_SPIM135, GLOBAL_SPIS135, GLOBAL_TWIM135, GLOBAL_TWIS135, GLOBAL_UARTE135)
455 PDM132 (GLOBAL_PDM132)
466 TIMER136 (GLOBAL_TIMER136)
467 TIMER137 (GLOBAL_TIMER137)
468 PWM133 (GLOBAL_PWM133)
469 SERIAL6 (GLOBAL_SPIM136, GLOBAL_SPIS136, GLOBAL_TWIM136, GLOBAL_TWIS136, GLOBAL_UARTE136)
470 SERIAL7 (GLOBAL_SPIM137, GLOBAL_SPIS137, GLOBAL_TWIM137, GLOBAL_TWIS137, GLOBAL_UARTE137)
471 PDM133 (GLOBAL_PDM133)

## Further device data
MaxInterrupts=480

## Licence text in the file
Copyright (c) 2010 - 2024, Nordic Semiconductor ASA All rights reserved. Redistribution and use in source and binary forms, with or without modification, are permitted provided that the following conditions are met: 1. Redistributions of source code must retain the above copyright notice, this list of conditions and the following disclaimer. 2. Redistributions in binary form, except as embedded into a Nordic Semiconductor ASA integrated circuit in a product or a software update for such product, must reproduce the above copyright notice, this list of conditions and the following disclaimer in the documentation and/or other materials provided with the distribution. 3. Neither the name of Nordic Semiconductor ASA nor the names of its contributors may be used to endorse or promote products derived from this software without specific prior written permission. 4. This software, with or without modification, must only be used with a Nordic Semiconductor ASA integrated circuit. 5. Any software provided in binary form under this license must not be reverse engineered, decompiled, modified and/or disassembled. THIS SOFTWARE IS PROVIDED BY NORDIC SEMICONDUCTOR ASA "AS IS" AND ANY EXPRESS OR IMPLIED WARRANTIES, INCLUDING, BUT NOT LIMITED TO, THE IMPLIED WARRANTIES OF MERCHANTABILITY, NONINFRINGEMENT, AND FITNESS FOR A PARTICULAR PURPOSE ARE DISCLAIMED. IN NO EVENT SHALL NORDIC SEMICONDUCTOR ASA OR CONTRIBUTORS BE LIABLE FOR ANY DIRECT, INDIRECT, INCIDENTAL, SPECIAL, EXEMPLARY, OR CONSEQUENTIAL DAMAGES (INCLUDING, BUT NOT LIMITED TO, PROCUREMENT OF SUBSTITUTE GOODS OR SERVICES; LOSS OF USE, DATA, OR PROFITS; OR BUSINESS INTERRUPTION) HOWEVER CAUSED AND ON ANY THEORY OF LIABILITY, WHETHER IN CONTRACT, STRICT LIABILITY, OR TORT (INCLUDING NEGLIGENCE OR OTHERWISE) ARISING IN ANY WAY OUT OF THE USE OF THIS SOFTWARE, EVEN IF ADVISED OF THE POSSIBILITY OF SUCH DAMAGE.
