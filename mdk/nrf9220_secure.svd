# nrf9220_secure register map
Vendor: Nordic Semiconductor; Series: nRF92; File version: 1
CPU: CM33 r0p4, little endian, MPU, no FPU, 3 interrupt priority bits, 480 interrupts, 8 SAU regions
Registers are 32-bit, read-write, reset 0x0 unless marked. A register's access mark holds for its fields unless they carry their own. Offsets are from the block's base; [hi:lo] are bit positions; lines under a group give offsets from that group; {n}, {i} and the like mark numbered series; 'fields as' and 'values as' point back to an identical list.

## RICR_S — ROM Information Configuration Registers
Base 0x0FFFA000
0x00 LCS group — Unspecified
  {0x0+4j} SIGNATURE[{j}] (j=0..3) reset 0xFFFFFFFF — Description collection: Signature to determine the re-entrant device life-cycle state (LCS).
    [31:0] VALUE — Uninitialized when freshly out of factory, esle PUF-derived LCS signature.
      0xFFFFFFFF=UNINITIALIZED (Value of LCS registers when the device is freshly manufactured (LCS state FFF), and the MRAM and the info pages including RICR are uninitialized.)
0x10 UROT group — Unspecified
  0x00 SMWD group — Signed Manifest verified by the secure domain ROM Code to establish the primary RoT with digest.
    0x00 SM group — Signed Manifest verified by the Secure Domain ROM Code to establish the primary RoT.
      0x00 TBS group — Manifest describing the secure domain firmware. The secure domain ROM code verifies the signature on the digest of this register.
        0x00 PUBKEY group — Raw public key used to verify the signed manifest.
          0x00 SIZE — The size of the raw public key (in bytes).
            [31:0] SIZE — Key size
              0xFFFFFFFF=Unprogrammed (The key is not programmed.); 32=SizeEd25519 (The size of the raw Ed25519 public key.); 176=SizeHybridKey (The size of the hybrid (combined) public key containing Ed25519, SLH-DSA-SHA2-128s, SLH-DSA-SHA2-192s and SLH-DSA-SHA2-256s public keys.)
          0x04 ADDR — Address of the raw public key.
            [31:0] ADDR — Public key address.
              0xFFFFFFFF=Unprogrammed (The key is not programmed.)
        0x08 LAYOUT group — The MRAM layout of UROT firmware and the recovery image.
          0x00 USLOT group — Start address and max size of UROT slot (USLOT), Shall remain the same for firmware updates once programmed or unless transitioned back to LCS Empty.
            0x00 START — Start address of the UROT firmware. Shall not overlap with the recovery slot (RSLOT).
              [31:0] ADDR
                0xFFFFFFFF=Undefined (The slot is not defined.)
            0x04 MAX — Maximum size of the UROT firmware in bytes.
              [31:0] SIZE
                0xFFFFFFFF=Undefined (The slot is not defined.)
          0x08 RSLOT group — Start address and max size of recovery slot (RSLOT), Shall remain the same for firmware updates once programmed or unless transitioned back to LCS Empty.
            0x00 START — Start address of the recovery firmware. Shall not overlap with the UROT slot(USLOT).
              [31:0] ADDR
                0xFFFFFFFF=Undefined (The slot is not defined.)
            0x04 MAX — Maximum size of the recovery image in bytes.
              [31:0] SIZE
                0xFFFFFFFF=Undefined (The slot is not defined.)
        0x18 FW group — FW verified by the secure domain ROM code.
          0x00 SIZE — The firmware size (in bytes). Shall not exceed the max defined limits for USLOT in case of UROT firmware.Shall not exceed the max defined limits for USLOT in case of UROT firmware.
            [31:0] SIZE — Firmware size
              0xFFFFFFFF=Unprogrammed (The FW is not programmed.)
          0x04 ADDR — Address of the firmware verified by the secure domain ROM code.
            [31:0] ADDR — Firmware address
              0xFFFFFFFF=Unprogrammed (The FW is not programmed.)
          {0x8+4p} DIGEST[{p}] (p=0..15) — Description collection: SHA2-512 digest of the firmware.
            [31:0] VALUE — SHA2-512 Digest value
              0xFFFFFFFF=Unprogrammed (The FW digest, and hence the FW is not programmed.)
          {0x48+4p} VERSION[{p}] (p=0..3) — Description collection: 128-bit revision of the firmware; can be left Unprogrammed.
            [31:0] VALUE — The revision of the firmware.
              0xFFFFFFFF=Unprogrammed (The revision of the FW is not programmed.)
          0x58 TIMESTAMP — Unsigned 32-bit integer timestamp of the firmware in Unix time used to prevent downgrade of firmware on firmware update.
            [31:0] VALUE — Unsigned unix-time timestamp of the firmware
              0xFFFFFFFF=Unprogrammed (The FW timestamp is not programmed.)
          0x5C PARTNO — Part-number for which the firmware is built. Must match the part number in OICR region.
            [31:0] VALUE — Part number of the device for which the firmware is built.
              0xFFFFFFFF=Unprogrammed (The part number is not programmed.)
        0x78 POLICY group — Set various policies on related to the firmware verification and update.
          0x00 UPDATE — Enable or Disable firmware update.
            [31:0] ENABLE — Possible values for this register.
              0xFFFFFFFF=Unprogrammed (The policy is not programmed, hence any existing policy on update is left unchanged.); 0xC3965A5A=Enabled (Enable firmware update.); 0x47D13CA5=Disabled (Disable firmware update.)
          0x04 REVOKE — Configure key revocation policy.
            [31:0] ENABLE — Possible values for this register
              0xFFFFFFFF=Unprogrammed (The policy is not programmed, hence any existing policy on auto-revocation is left unchanged.); 0xC3965A5A=Enabled (Enable auto-revocation of keys.); 0x47D13CA5=Disabled (Disable auto-revocation of keys used to verify firmware.)
          0x08 DGPREV — Configure the downgrade prevention policy.
            [31:0] ENABLE — Possible values for this register
              0xFFFFFFFF=Unprogrammed (The policy is not programmed, hence any existing policy on downgrade prevention is unaltered.); 0xC3965A5A=Enable downgrade protection on firmware update. If Enabled, the SM.TBS.FW.TIMESTAMP register cannot be left Unprogrammed.; 0x47D13CA5=Disable downgrade protection on firmware updates. If Disabled, the SM.TBS.FW.TIMESTAMP register shall be left Unprogrammed.
          0x0C ED25519_DISABLE — Optionally disable signature algorithm Ed25519.
            [31:0] CONFIG — Possible values for this register
              0xFFFFFFFF=Unprogrammed (The policy is not programmed, hence any existing status of signature algorithm Ed25519 is unaltered.); 0x74C72B7E=Disable signature algorithm Ed25519 on next cold boot
          0x10 SLH_DSA_SHA2_128S_DISABLE — Optionally disable signature algorithm SLH-DSA parameter set SLH-DSA-SHA2-128s.
            [31:0] CONFIG — Possible values for this register
              0xFFFFFFFF=Unprogrammed (The policy is not programmed, hence any existing status of signature algorithm SLH-DSA parameter set SLH-DSA-SHA2-128s is unaltered.); 0x74C72B7E=Disable signature algorithm SLH-DSA parameter set SLH-DSA-SHA2-128s on next cold boot
          0x14 SLH_DSA_SHA2_192S_DISABLE — Optionally disable signature algorithm SLH-DSA parameter set SLH-DSA-SHA2-192s.
            [31:0] CONFIG — Possible values for this register
              0xFFFFFFFF=Unprogrammed (The policy is not programmed, hence any existing status of signature algorithm SLH-DSA parameter set SLH-DSA-SHA2-192s is unaltered.); 0x74C72B7E=Disable signature algorithm SLH-DSA parameter set SLH-DSA-SHA2-192s on next cold boot
          0x18 SLH_DSA_SHA2_256S_DISABLE — Optionally disable signature algorithm SLH-DSA parameter set SLH-DSA-SHA2-256s.
            [31:0] CONFIG — Possible values for this register
              0xFFFFFFFF=Unprogrammed (The policy is not programmed, hence any existing status of signature algorithm SLH-DSA parameter set SLH-DSA-SHA2-256s is unaltered.); 0x74C72B7E=Disable signature algorithm SLH-DSA parameter set SLH-DSA-SHA2-256s on next cold boot
          0x1C RFU — This register is included when generating signature of the TBS content of SM.
        {0x98+4m} CIPHERDIGEST[{m}] (m=0..15) — Description collection: SHA2-512 digest of the AES-GCM AAD, IV and encrypted firmware. For the recovery firmware, this is Unprogrammed because only plain-text update is supported for the Recovery FW.
          [31:0] VALUE — SHA2-512 Digest value
            0xFFFFFFFF=Unprogrammed (Encrypted firmware digest, unprogrammed if the FW is not programmed.)
        {0xD8+4m} RFU[{m}] (m=0..3) — Description collection: This register is included when generating signature of the TBS content of SM.
      0xF4 SIGNATURE group — Signature on the manifest defined in TBS
        0x00 ALG — The signature algorithm identifier.
          [31:0] ID — Algorithm identifier
            0xFFFFFFFF=Unprogrammed (The signature algorithm identifier is not programmed.); 5=AlgIdEd25519 (ARM ADAC-defined identifier for Ed25519. The use of ARM ADAC-defined identifier ensures consistent user interface on CTRL-AP and SICR.); 133=AlgIdHybridEd25519 (Nordic vendor defined identifier for Ed25519 with PQC compatible hybrid public key material.); 134=AlgIdHybridSLH_DSA_SHA2_128s (Nordic vendor defined identifier for FIPS 205 SLH-DSA-SHA2-128s with PQC compatible hybrid public key material.); 135=AlgIdHybridSLH_DSA_SHA2_192s (Nordic vendor defined identifier for FIPS 205 SLH-DSA-SHA2-192s with PQC compatible hybrid public key material.); 136=AlgIdHybridSLH_DSA_SHA2_256s (Nordic vendor defined identifier for FIPS 205 SLH-DSA-SHA2-256s with PQC compatible hybrid public key material.)
        0x04 SIZE — Size of the raw signature in bytes.
          [31:0] SIZE — Signature size
            0xFFFFFFFF=Unprogrammed (The size of the signature is not programmed.); 64=SizeEd25519 (Size of Ed25519 signature bytestring.); 0x1EB0=SizeSLH_DSA_SHA2_128S (Size of SLH-DSA-SHA2-128s signature bytestring.); 0x3F60=SizeSLH_DSA_SHA2_192S (Size of SLH-DSA-SHA2-192s signature bytestring.); 0x7460=SizeSLH_DSA_SHA2_256S (Size of SLH-DSA-SHA2-256s signature bytestring.); 0x7460=MaxSize is the size of the largest signature scheme supported (SLH-DSA-SHA2-256s)
        0x08 ADDR — Address of the signature on the firmware manifest.
          [31:0] ADDR — Signature address.
            0xFFFFFFFF=Unprogrammed (The address of the signature is not programmed.)
    {0x100+4k} DIGEST[{k}] (k=0..15) — Description collection: SHA-512 Digest of the signed manifest used for intregrity check of the signed-manifest. Utilized in scenarios involving warm-boot and firmware update.
  0x1F8 OWNER group — Unspecified
    0x00 UROT — Indicates the owner of UROT firmware.
      [31:0] OWNER — Indicates whether UROT owner is uninitialized, Nordic or User.
        0xFFFFFFFF=Uninitialized (Owner is not initialized yet.); 0xFD3D8E75=Nordic (Owner is Nordic.); 0x67CA0593=User (Owner is customer(User).)
    0x04 RECOVERY — Indicates the owner of Recovery firmware.
      [31:0] OWNER — Indicates whether Recovery owner is uninitialized, Nordic or User.
        values as UROT.OWNER.UROT.OWNER
  0x200 RECOVERY group — Unspecified
    0x00 SMWD group — Signed Manifest verified by the secure domain ROM Code to establish the primary RoT with digest.
      0x00 SM group — Signed Manifest verified by the Secure Domain ROM Code to establish the primary RoT.
        0x00 TBS group — Manifest describing the secure domain firmware. The secure domain ROM code verifies the signature on the digest of this register.
          0x00 PUBKEY group — Raw public key used to verify the signed manifest.
            0x00 SIZE — The size of the raw public key (in bytes).
              fields as UROT.SMWD.SM.TBS.PUBKEY.SIZE
            0x04 ADDR — Address of the raw public key.
              fields as UROT.SMWD.SM.TBS.PUBKEY.ADDR
          0x08 LAYOUT group — The MRAM layout of UROT firmware and the recovery image.
            0x00 USLOT group — Start address and max size of UROT slot (USLOT), Shall remain the same for firmware updates once programmed or unless transitioned back to LCS Empty.
              0x00 START — Start address of the UROT firmware. Shall not overlap with the recovery slot (RSLOT).
                [31:0] ADDR
                  0xFFFFFFFF=Undefined (The slot is not defined.)
              0x04 MAX — Maximum size of the UROT firmware in bytes.
                [31:0] SIZE
                  0xFFFFFFFF=Undefined (The slot is not defined.)
            0x08 RSLOT group — Start address and max size of recovery slot (RSLOT), Shall remain the same for firmware updates once programmed or unless transitioned back to LCS Empty.
              0x00 START — Start address of the recovery firmware. Shall not overlap with the UROT slot(USLOT).
                [31:0] ADDR
                  0xFFFFFFFF=Undefined (The slot is not defined.)
              0x04 MAX — Maximum size of the recovery image in bytes.
                [31:0] SIZE
                  0xFFFFFFFF=Undefined (The slot is not defined.)
          0x18 FW group — FW verified by the secure domain ROM code.
            0x00 SIZE — The firmware size (in bytes). Shall not exceed the max defined limits for USLOT in case of UROT firmware.Shall not exceed the max defined limits for USLOT in case of UROT firmware.
              fields as UROT.SMWD.SM.TBS.FW.SIZE
            0x04 ADDR — Address of the firmware verified by the secure domain ROM code.
              fields as UROT.SMWD.SM.TBS.FW.ADDR
            {0x8+4q} DIGEST[{q}] (q=0..15) — Description collection: SHA2-512 digest of the firmware.
              fields as UROT.SMWD.SM.TBS.FW.DIGEST[0]
            {0x48+4q} VERSION[{q}] (q=0..3) — Description collection: 128-bit revision of the firmware; can be left Unprogrammed.
              fields as UROT.SMWD.SM.TBS.FW.VERSION[0]
            0x58 TIMESTAMP — Unsigned 32-bit integer timestamp of the firmware in Unix time used to prevent downgrade of firmware on firmware update.
              fields as UROT.SMWD.SM.TBS.FW.TIMESTAMP
            0x5C PARTNO — Part-number for which the firmware is built. Must match the part number in OICR region.
              fields as UROT.SMWD.SM.TBS.FW.PARTNO
          0x78 POLICY group — Set various policies on related to the firmware verification and update.
            0x00 UPDATE — Enable or Disable firmware update.
              fields as UROT.SMWD.SM.TBS.POLICY.UPDATE
            0x04 REVOKE — Configure key revocation policy.
              fields as UROT.SMWD.SM.TBS.POLICY.REVOKE
            0x08 DGPREV — Configure the downgrade prevention policy.
              fields as UROT.SMWD.SM.TBS.POLICY.DGPREV
            0x0C ED25519_DISABLE — Optionally disable signature algorithm Ed25519.
              fields as UROT.SMWD.SM.TBS.POLICY.ED25519_DISABLE
            0x10 SLH_DSA_SHA2_128S_DISABLE — Optionally disable signature algorithm SLH-DSA parameter set SLH-DSA-SHA2-128s.
              fields as UROT.SMWD.SM.TBS.POLICY.SLH_DSA_SHA2_128S_DISABLE
            0x14 SLH_DSA_SHA2_192S_DISABLE — Optionally disable signature algorithm SLH-DSA parameter set SLH-DSA-SHA2-192s.
              fields as UROT.SMWD.SM.TBS.POLICY.SLH_DSA_SHA2_192S_DISABLE
            0x18 SLH_DSA_SHA2_256S_DISABLE — Optionally disable signature algorithm SLH-DSA parameter set SLH-DSA-SHA2-256s.
              fields as UROT.SMWD.SM.TBS.POLICY.SLH_DSA_SHA2_256S_DISABLE
            0x1C RFU — This register is included when generating signature of the TBS content of SM.
          {0x98+4p} CIPHERDIGEST[{p}] (p=0..15) — Description collection: SHA2-512 digest of the AES-GCM AAD, IV and encrypted firmware. For the recovery firmware, this is Unprogrammed because only plain-text update is supported for the Recovery FW.
            fields as UROT.SMWD.SM.TBS.CIPHERDIGEST[0]
          {0xD8+4p} RFU[{p}] (p=0..3) — Description collection: This register is included when generating signature of the TBS content of SM.
        0xF4 SIGNATURE group — Signature on the manifest defined in TBS
          0x00 ALG — The signature algorithm identifier.
            fields as UROT.SMWD.SM.SIGNATURE.ALG
          0x04 SIZE — Size of the raw signature in bytes.
            fields as UROT.SMWD.SM.SIGNATURE.SIZE
          0x08 ADDR — Address of the signature on the firmware manifest.
            fields as UROT.SMWD.SM.SIGNATURE.ADDR
      {0x100+4l} DIGEST[{l}] (l=0..15) — Description collection: SHA-512 Digest of the signed manifest used for intregrity check of the signed-manifest. Utilized in scenarios involving warm-boot and firmware update.
  0x340 UPWD group — Update with digest. Digest is used to ensure SICR contents where not tampered when resuming any paused processing of the update.
    0x00 UPDATE group — Description of FW Updates, if any. In case, SICR.UROT.TBS.POLICY.UPDATE is set to Disabled, these registers are ignored by the secure domain ROM code.
      0x00 OPERATION — Command from the secure domain firmware to the secure domain ROM code.
        [31:0] OPCODE — Opcode to identify the command.
          0xFFFFFFFF=Nop (No operation pending.); 0x80000001=UROTVerify (Command to only verify UROT (plain-text or encrypted) firmware update without applying it.); 0x80000002=UROTActivate (Command to verify and update encrypted UROT firmware.); 0x80000003=RecoveryVerify (Command to verify the recovery (plain-text only) firmware update without applying it.); 0x80000004=RecoveryActivate (Command to verify and update plain-text Recovery firmware.); 0x80000005=UROTPlainTextActivate (Command to verify and update plain-text UROT firmware.)
      0x04 STATUS — ROM code indicates the status of update to the secure domain firmware via this register.
        [31:0] CODE — Status code.
          0xFFFFFFFF=None (No operation pending to indicate any status.); 0xF0000001=UnknownOperation (Unknown OPCODE in SICR.UROT.UPDATE.OPERATION.); 0xF0000002=InvalidManifest (The information in the manifest is invalid.); 0xF0000003=StaleFW (The timestamp on the firmware is older than the current one.); 0xF0000005=VerifyFailure (The signature did not verify.); 0xF0000006=VerifyOK (Signature verification is successful.); 0xF0000007=UROTUpdateDisabled (UROT firmware update is disabled via policy.); 0xF0000008=UROTActivated (UROT firmware update verification and installation succeeded.); 0xF0000009=RecoveryActivated (Recovery firmware update verification and installation succeeded.); 0xF000000A=RecoveryUpdateDisabled (Recovery update is disabled via policy.)
      0x08 DOWNLOAD group — Information about downloaded firmware update. The addresses described here are the location of the update and not the location they must be installed. The installation information is described in the signed manifest.
        0x00 FW — Location for the firmware update to be installed.
          [31:0] ADDR — The MRAM Location of the firmware to be installed. This is not the same as the address in the signed manifest. The signed manifest contains the target location where the firmware must be installed, not the current location where it is downloaded.
            0xFFFFFFFF=Unprogrammed (The location of the FW update is not programmed.)
        0x04 PUBKEY — Location of the public key to verify the signature on the firmware update.
          [31:0] ADDR — MRAM Location for the signature on the firmware update. This is not the same as the address in the signed manifest. The signed manifest contains the target location where the public key must be kept once the update is installed, not the current location where it is downloaded.
            0xFFFFFFFF=Unprogrammed (The location of the public key is not programmed.)
        0x08 SIGNATURE — Location for the signature on the firmware update to be verified before the update is installed.
          [31:0] ADDR — MRAM Location for the signature on the firmware update. This is not the same as the address in the signed manifest. The signed manifest contains the target location where the signature must be kept once the update is installed, not the current location where it is downloaded.
            0xFFFFFFFF=Unprogrammed (The location of the signature is not programmed.)
        0x0C MAX — Max Size of the download.
          [31:0] SIZE — Max size of the downloaded firmware update. This define is ignored during update of UROT or the recovery image since the signed manifest contains the needed sizes. This field is used to define the writable MRAM region when the recovery image is started in the safe mode.
            0xFFFFFFFF=Unprogrammed (The max size of the download is not programmed.)
      0x20 SM group — Signed Manifest verified by the Secure Domain ROM Code to establish the primary RoT.
        0x00 TBS group — Manifest describing the secure domain firmware. The secure domain ROM code verifies the signature on the digest of this register.
          0x00 PUBKEY group — Raw public key used to verify the signed manifest.
            0x00 SIZE — The size of the raw public key (in bytes).
              fields as UROT.SMWD.SM.TBS.PUBKEY.SIZE
            0x04 ADDR — Address of the raw public key.
              fields as UROT.SMWD.SM.TBS.PUBKEY.ADDR
          0x08 LAYOUT group — The MRAM layout of UROT firmware and the recovery image.
            0x00 USLOT group — Start address and max size of UROT slot (USLOT), Shall remain the same for firmware updates once programmed or unless transitioned back to LCS Empty.
              0x00 START — Start address of the UROT firmware. Shall not overlap with the recovery slot (RSLOT).
                [31:0] ADDR
                  0xFFFFFFFF=Undefined (The slot is not defined.)
              0x04 MAX — Maximum size of the UROT firmware in bytes.
                [31:0] SIZE
                  0xFFFFFFFF=Undefined (The slot is not defined.)
            0x08 RSLOT group — Start address and max size of recovery slot (RSLOT), Shall remain the same for firmware updates once programmed or unless transitioned back to LCS Empty.
              0x00 START — Start address of the recovery firmware. Shall not overlap with the UROT slot(USLOT).
                [31:0] ADDR
                  0xFFFFFFFF=Undefined (The slot is not defined.)
              0x04 MAX — Maximum size of the recovery image in bytes.
                [31:0] SIZE
                  0xFFFFFFFF=Undefined (The slot is not defined.)
          0x18 FW group — FW verified by the secure domain ROM code.
            0x00 SIZE — The firmware size (in bytes). Shall not exceed the max defined limits for USLOT in case of UROT firmware.Shall not exceed the max defined limits for USLOT in case of UROT firmware.
              fields as UROT.SMWD.SM.TBS.FW.SIZE
            0x04 ADDR — Address of the firmware verified by the secure domain ROM code.
              fields as UROT.SMWD.SM.TBS.FW.ADDR
            {0x8+4q} DIGEST[{q}] (q=0..15) — Description collection: SHA2-512 digest of the firmware.
              fields as UROT.SMWD.SM.TBS.FW.DIGEST[0]
            {0x48+4q} VERSION[{q}] (q=0..3) — Description collection: 128-bit revision of the firmware; can be left Unprogrammed.
              fields as UROT.SMWD.SM.TBS.FW.VERSION[0]
            0x58 TIMESTAMP — Unsigned 32-bit integer timestamp of the firmware in Unix time used to prevent downgrade of firmware on firmware update.
              fields as UROT.SMWD.SM.TBS.FW.TIMESTAMP
            0x5C PARTNO — Part-number for which the firmware is built. Must match the part number in OICR region.
              fields as UROT.SMWD.SM.TBS.FW.PARTNO
          0x78 POLICY group — Set various policies on related to the firmware verification and update.
            0x00 UPDATE — Enable or Disable firmware update.
              fields as UROT.SMWD.SM.TBS.POLICY.UPDATE
            0x04 REVOKE — Configure key revocation policy.
              fields as UROT.SMWD.SM.TBS.POLICY.REVOKE
            0x08 DGPREV — Configure the downgrade prevention policy.
              fields as UROT.SMWD.SM.TBS.POLICY.DGPREV
            0x0C ED25519_DISABLE — Optionally disable signature algorithm Ed25519.
              fields as UROT.SMWD.SM.TBS.POLICY.ED25519_DISABLE
            0x10 SLH_DSA_SHA2_128S_DISABLE — Optionally disable signature algorithm SLH-DSA parameter set SLH-DSA-SHA2-128s.
              fields as UROT.SMWD.SM.TBS.POLICY.SLH_DSA_SHA2_128S_DISABLE
            0x14 SLH_DSA_SHA2_192S_DISABLE — Optionally disable signature algorithm SLH-DSA parameter set SLH-DSA-SHA2-192s.
              fields as UROT.SMWD.SM.TBS.POLICY.SLH_DSA_SHA2_192S_DISABLE
            0x18 SLH_DSA_SHA2_256S_DISABLE — Optionally disable signature algorithm SLH-DSA parameter set SLH-DSA-SHA2-256s.
              fields as UROT.SMWD.SM.TBS.POLICY.SLH_DSA_SHA2_256S_DISABLE
            0x1C RFU — This register is included when generating signature of the TBS content of SM.
          {0x98+4p} CIPHERDIGEST[{p}] (p=0..15) — Description collection: SHA2-512 digest of the AES-GCM AAD, IV and encrypted firmware. For the recovery firmware, this is Unprogrammed because only plain-text update is supported for the Recovery FW.
            fields as UROT.SMWD.SM.TBS.CIPHERDIGEST[0]
          {0xD8+4p} RFU[{p}] (p=0..3) — Description collection: This register is included when generating signature of the TBS content of SM.
        0xF4 SIGNATURE group — Signature on the manifest defined in TBS
          0x00 ALG — The signature algorithm identifier.
            fields as UROT.SMWD.SM.SIGNATURE.ALG
          0x04 SIZE — Size of the raw signature in bytes.
            fields as UROT.SMWD.SM.SIGNATURE.SIZE
          0x08 ADDR — Address of the signature on the firmware manifest.
            fields as UROT.SMWD.SM.SIGNATURE.ADDR
    {0x120+4k} DIGEST[{k}] (k=0..15) — Description collection: SHA-512 Digest of the signed manifest used for integrity check of the signed-manifest.
    0x160 STATE — Internal state of any update.
  0x4A4 STATE group — Describes the currently booted firmware (UROT or recovery) and if the update of the two firmwares is currently enabled or disabled.
    0x00 CURRENTFW — Indicate which of the firmware, UROT or recovery, is started.
      [31:0] ADDR — MRAM location of either UROT or recovery firmware based on which firmware is started at cold boot. This address is updated by the ROM code and cold boot and used at warm boot to start the right firmware.
        0xFFFFFFFF=Unprogrammed (The address is not programmed.)
    0x04 UROTFWUPDATE — Indicates if UROT firmware update is enabled or disabled.
      [31:0] STATUS — ROM writes this field based on whether a valid recovery firmware exists and reads this field to process any request to update the UROT firmware.
        0xFFFFFFFF=Disabled (The update of UROT is disabled since no valid recovery firmware exists.); 0x83A91C27=Enabled (The update of UROT is enabled since valid recovery firmware exists.)
    0x08 RECOVERYFWUPDATE — Indicates if recovery firmware update is enabled or disabled.
      [31:0] STATUS — ROM writes this field based on whether a valid UROT firmware exists and reads this field to process any request to update the recovery firmware.
        0xFFFFFFFF=Disabled (The update of recovery firmware is disabled since no valid UROT firmmware exists.); 0x83A91C27=Enabled (The update of recovery firmware is enabled since valid UROT firmmware exists.)
