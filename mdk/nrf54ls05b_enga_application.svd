# nrf54ls05b_enga_application register map
Vendor: Nordic Semiconductor; Series: nrf54l; File version: 1
System-on-chip with a 32-bit Arm Cortex-M33 microcontroller
CPU: CM33 r0p4, little endian, no MPU, no FPU, 3 interrupt priority bits, 270 interrupts
Registers are 32-bit, read-write, reset 0x0 unless marked. A register's access mark holds for its fields unless they carry their own. Offsets are from the block's base; lines under a group give offsets from that group; [hi:lo] are bit positions; {n}, {i} and the like mark numbered series; 'fields as' and 'values as' point back to an identical list; <NAME> marks a mode.

## Memory map
0x00FFC000 GLOBAL_FICR size 0x1000 — Factory Information Configuration Registers
0x00FFD000 GLOBAL_UICR size 0x1000 — User Information Configuration Registers
0x4001C000 SWI00 size 0x1000 — Software interrupt 0
0x4001D000 SWI01 size 0x1000 — Software interrupt 1
0x4001E000 SWI02 size 0x1000 — Software interrupt 2
0x4001F000 SWI03 size 0x1000 — Software interrupt 3
0x40040000 GLOBAL_SPU00 size 0x1000 — System protection unit 0
0x40041000 GLOBAL_MPC00 size 0x1000 — Memory Privilege Controller
0x40042000 GLOBAL_DPPIC00 size 0x1000 — Distributed programmable peripheral interconnect controller 0
0x40044000 GLOBAL_PPIB00 size 0x1000 — PPIB APB registers 0
0x40045000 GLOBAL_PPIB01 size 0x1000 — PPIB APB registers 1
0x4004A000 GLOBAL_AAR00 size 0x1000 — Accelerated Address Resolver
0x4004A000 GLOBAL_CCM00 size 0x1000 — AES CCM Mode Encryption
0x4004B000 GLOBAL_ECB00 size 0x1000 — AES ECB Mode Encryption
0x4004E000 GLOBAL_RRAMC size 0x1000 — RRAM controller GLITCH detector
0x40052000 GLOBAL_CTRLAP size 0x1000 — Control access port
0x40053000 GLOBAL_TAD size 0x1000 — Trace and debug control
0x40055000 GLOBAL_TIMER00 size 0x1000 — Timer/Counter 0
0x40058000 GLOBAL_EGU00 size 0x1000 — Event generator unit 0
0x40059000 GLOBAL_CRACENCORE size 0x1000 — CRACENCORE TRNG registers
0x40059000 GLOBAL_TRNG size 0x1000 — CRACEN TRNG
0x4007A000 GLOBAL_PULSEDET00 size 0x1000 — PULSEDET peripheral 0
0x4007D000 GLOBAL_ECCRAMC size 0x1000 — ECCRAMC peripheral
0x4007E000 GLOBAL_SREGS00 size 0x1000 — Spare registers
0x4007F000 GLOBAL_SUPPORT00 size 0x1000 — PCGCSlave 0
0x40080000 GLOBAL_SPU10 size 0x1000 — System protection unit 1
0x40082000 GLOBAL_DPPIC10 size 0x1000 — Distributed programmable peripheral interconnect controller 1
0x40083000 GLOBAL_PPIB10 size 0x1000 — PPIB APB registers 2
0x40084000 GLOBAL_PPIB11 size 0x1000 — PPIB APB registers 3
0x40085000 GLOBAL_TIMER10 size 0x1000 — Timer/Counter 1
0x40087000 GLOBAL_EGU10 size 0x1000 — Event generator unit 1
0x4008A000 GLOBAL_RADIO size 0x2000 — 2.4 GHz radio
0x4008C000 GLOBAL_SREGS10 size 0x1000 — Spare registers
0x4009E000 GLOBAL_SUPPORT10 size 0x1000 — PCGCSlave 1
0x400A0000 GLOBAL_PULSEDET10 size 0x1000 — PULSEDET peripheral 1
0x400C0000 GLOBAL_SPU20 size 0x1000 — System protection unit 2
0x400C2000 GLOBAL_DPPIC20 size 0x1000 — Distributed programmable peripheral interconnect controller 2
0x400C3000 GLOBAL_PPIB20 size 0x1000 — PPIB APB registers 4
0x400C4000 GLOBAL_PPIB21 size 0x1000 — PPIB APB registers 5
0x400C5000 GLOBAL_PPIB22 size 0x1000 — PPIB APB registers 6
0x400C6000 GLOBAL_SPIM20 size 0x1000 — Serial Peripheral Interface Master with EasyDMA 0
0x400C6000 GLOBAL_SPIS20 size 0x1000 — SPI Slave 0
0x400C6000 GLOBAL_TWIM20 size 0x1000 — I2C compatible Two-Wire Master Interface with EasyDMA 0
0x400C6000 GLOBAL_TWIS20 size 0x1000 — I2C compatible Two-Wire Slave Interface with EasyDMA 0
0x400C6000 GLOBAL_UARTE20 size 0x1000 — UART with EasyDMA 0
0x400C7000 GLOBAL_SPIM21 size 0x1000 — Serial Peripheral Interface Master with EasyDMA 1
0x400C7000 GLOBAL_SPIS21 size 0x1000 — SPI Slave 1
0x400C7000 GLOBAL_TWIM21 size 0x1000 — I2C compatible Two-Wire Master Interface with EasyDMA 1
0x400C7000 GLOBAL_TWIS21 size 0x1000 — I2C compatible Two-Wire Slave Interface with EasyDMA 1
0x400C7000 GLOBAL_UARTE21 size 0x1000 — UART with EasyDMA 1
0x400C8000 GLOBAL_SPIM22 size 0x1000 — Serial Peripheral Interface Master with EasyDMA 2
0x400C8000 GLOBAL_SPIS22 size 0x1000 — SPI Slave 2
0x400C8000 GLOBAL_TWIM22 size 0x1000 — I2C compatible Two-Wire Master Interface with EasyDMA 2
0x400C8000 GLOBAL_TWIS22 size 0x1000 — I2C compatible Two-Wire Slave Interface with EasyDMA 2
0x400C8000 GLOBAL_UARTE22 size 0x1000 — UART with EasyDMA 2
0x400C9000 GLOBAL_EGU20 size 0x1000 — Event generator unit 2
0x400CA000 GLOBAL_TIMER20 size 0x1000 — Timer/Counter 2
0x400CF000 GLOBAL_MEMCONF size 0x1000 — Memory configuration
0x400D2000 GLOBAL_PWM20 size 0x1000 — Pulse width modulation unit
0x400D5000 GLOBAL_SAADC size 0x1000 — Analog to Digital Converter
0x400D7000 GLOBAL_TEMP size 0x1000 — Temperature Sensor
0x400D8200 GLOBAL_P1 size 0x200 — GPIO Port 0
0x400D9E00 GLOBAL_GPIOINTERNALP1 size 0x2000 — GPIO Internal
0x400DA000 GLOBAL_GPIOTE20 size 0x1000 — GPIO Tasks and Events 0
0x400E0000 GLOBAL_QDEC20 size 0x1000 — Quadrature Decoder
0x400E2000 GLOBAL_GRTC size 0x1000 — Global Real-time counter
0x400E6000 GLOBAL_SREGS20 size 0x1000 — Spare registers
0x400E7000 GLOBAL_PCGCM20 size 0x1000 — PCGC Master 0
0x400EC000 GLOBAL_PULSEDET20 size 0x1000 — PULSEDET peripheral 2
0x400EF000 GLOBAL_TAMPC size 0x1000 — Tamper controller
0x400FF000 GLOBAL_SUPPORT20 size 0x1000 — PCGCSlave 2
0x40100000 GLOBAL_SPU30 size 0x1000 — System protection unit 3
0x40102000 GLOBAL_DPPIC30 size 0x1000 — Distributed programmable peripheral interconnect controller 3
0x40103000 GLOBAL_PPIB30 size 0x1000 — PPIB APB registers 7
0x40108000 GLOBAL_WDT30 size 0x1000 — Watchdog Timer
0x4010A000 GLOBAL_P0 size 0x200 — GPIO Port 1
0x4010BE00 GLOBAL_GPIOINTERNALP0 size 0x2000 — GPIO Internal
0x4010C000 GLOBAL_GPIOTE30 size 0x1000 — GPIO Tasks and Events 1
0x4010E000 GLOBAL_CLOCK size 0x1000 — Clock management
0x4010E000 GLOBAL_POWER size 0x1000 — Power control
0x4010E000 GLOBAL_RESET size 0x1000 — Reset control
0x4010F000 GLOBAL_SREGS30 size 0x1000 — Spare registers
0x40110000 GLOBAL_PULSEDET30 size 0x1000 — PULSEDET peripheral 3
0x4011E000 GLOBAL_PCGCS30 size 0x1000 — PCGCSlave 3
0x4011F000 GLOBAL_SUPPORT30 size 0x1000 — PCGCSlave 4
0x40120000 GLOBAL_OSCILLATORS size 0x1000 — Oscillator control
0x40120000 GLOBAL_REGULATORS size 0x1000 — Voltage regulators
0x4013F000 GLOBAL_PCGCM30 size 0x1000 — PCGC Master 1
0xE0080000 CPUC size 0x1000 — CPU control
0xE0082000 ICACHE size 0x1000 — Cache

## Interrupts
28 SWI00
29 SWI01
30 SWI02
31 SWI03
64 SPU00 (GLOBAL_SPU00)
65 MPC00 (GLOBAL_MPC00)
74 AAR00_CCM00 (GLOBAL_AAR00, GLOBAL_CCM00)
75 ECB00 (GLOBAL_ECB00)
78 RRAMC (GLOBAL_RRAMC)
82 CTRLAP (GLOBAL_CTRLAP)
85 TIMER00 (GLOBAL_TIMER00)
88 EGU00 (GLOBAL_EGU00)
89 TRNG (GLOBAL_TRNG)
125 ECCRAMC (GLOBAL_ECCRAMC)
128 SPU10 (GLOBAL_SPU10)
133 TIMER10 (GLOBAL_TIMER10)
135 EGU10 (GLOBAL_EGU10)
138 RADIO_0 (GLOBAL_RADIO)
139 RADIO_1 (GLOBAL_RADIO)
192 SPU20 (GLOBAL_SPU20)
198 SERIAL20 (GLOBAL_SPIM20, GLOBAL_SPIS20, GLOBAL_TWIM20, GLOBAL_TWIS20, GLOBAL_UARTE20)
199 SERIAL21 (GLOBAL_SPIM21, GLOBAL_SPIS21, GLOBAL_TWIM21, GLOBAL_TWIS21, GLOBAL_UARTE21)
200 SERIAL22 (GLOBAL_SPIM22, GLOBAL_SPIS22, GLOBAL_TWIM22, GLOBAL_TWIS22, GLOBAL_UARTE22)
201 EGU20 (GLOBAL_EGU20)
202 TIMER20 (GLOBAL_TIMER20)
210 PWM20 (GLOBAL_PWM20)
213 SAADC (GLOBAL_SAADC)
215 TEMP (GLOBAL_TEMP)
218 GPIOTE20_0 (GLOBAL_GPIOTE20)
224 QDEC20 (GLOBAL_QDEC20)
226 GRTC_0 (GLOBAL_GRTC)
227 GRTC_1 (GLOBAL_GRTC)
228 GRTC_2 (GLOBAL_GRTC)
229 GRTC_3 (GLOBAL_GRTC)
239 TAMPC (GLOBAL_TAMPC)
256 SPU30 (GLOBAL_SPU30)
264 WDT30 (GLOBAL_WDT30)
268 GPIOTE30_0 (GLOBAL_GPIOTE30)
270 CLOCK_POWER (GLOBAL_CLOCK, GLOBAL_POWER)

## Further device data
MaxInterrupts=480

## Licence text in the file
Copyright (c) 2010 - 2025, Nordic Semiconductor ASA All rights reserved. Redistribution and use in source and binary forms, with or without modification, are permitted provided that the following conditions are met: 1. Redistributions of source code must retain the above copyright notice, this list of conditions and the following disclaimer. 2. Redistributions in binary form, except as embedded into a Nordic Semiconductor ASA integrated circuit in a product or a software update for such product, must reproduce the above copyright notice, this list of conditions and the following disclaimer in the documentation and/or other materials provided with the distribution. 3. Neither the name of Nordic Semiconductor ASA nor the names of its contributors may be used to endorse or promote products derived from this software without specific prior written permission. 4. This software, with or without modification, must only be used with a Nordic Semiconductor ASA integrated circuit. 5. Any software provided in binary form under this license must not be reverse engineered, decompiled, modified and/or disassembled. THIS SOFTWARE IS PROVIDED BY NORDIC SEMICONDUCTOR ASA "AS IS" AND ANY EXPRESS OR IMPLIED WARRANTIES, INCLUDING, BUT NOT LIMITED TO, THE IMPLIED WARRANTIES OF MERCHANTABILITY, NONINFRINGEMENT, AND FITNESS FOR A PARTICULAR PURPOSE ARE DISCLAIMED. IN NO EVENT SHALL NORDIC SEMICONDUCTOR ASA OR CONTRIBUTORS BE LIABLE FOR ANY DIRECT, INDIRECT, INCIDENTAL, SPECIAL, EXEMPLARY, OR CONSEQUENTIAL DAMAGES (INCLUDING, BUT NOT LIMITED TO, PROCUREMENT OF SUBSTITUTE GOODS OR SERVICES; LOSS OF USE, DATA, OR PROFITS; OR BUSINESS INTERRUPTION) HOWEVER CAUSED AND ON ANY THEORY OF LIABILITY, WHETHER IN CONTRACT, STRICT LIABILITY, OR TORT (INCLUDING NEGLIGENCE OR OTHERWISE) ARISING IN ANY WAY OUT OF THE USE OF THIS SOFTWARE, EVEN IF ADVISED OF THE POSSIBILITY OF SUCH DAMAGE.
