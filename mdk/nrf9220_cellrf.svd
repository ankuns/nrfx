# nrf9220_cellrf register map
Vendor: Nordic Semiconductor; Series: nRF92; File version: 1
nRF9220 reference description for system-on-chip with many ARM 32-bit Cortex-M33 microcontrollers
CPU: CM0 r0p0, little endian, no MPU, no FPU, 2 interrupt priority bits, 33 interrupts
Registers are 32-bit, read-write, reset 0x0 unless marked. A register's access mark holds for its fields unless they carry their own. Offsets are from the block's base; lines under a group give offsets from that group; [hi:lo] are bit positions; {n}, {i} and the like mark numbered series; 'fields as' and 'values as' point back to an identical list; <NAME> marks a mode.

## Memory map
0x0FFF6000 GLOBAL_MICR size 0x1000 — MICR
0x0FFFE000 GLOBAL_FICR size 0xC00 — Factory Information Configuration Registers
0x46000000 PCGCS0 size 0x1000 — PCGCSlave 0
0x46001000 RAMCM0 size 0x1000 — RAM Controller 0
0x46003000 RAMCIPC size 0x1000 — RAM Controller 1
0x46004000 PCGCS1 size 0x1000 — PCGCSlave 1
0x46005000 MUTEX size 0x1000
0x46006000 PCGCM0 size 0x1000 — PCGC Master 0
0x46007000 LRCCONF0 size 0x1000
0x46008000 HSFLL size 0x1000
0x46009000 RFCORESERVICES size 0x1000 — AhmaRfSubsystem general control register map AhmaRfSubsystem general control register map
0x4600A000 MPC size 0x1000 — Memory Privilege Controller
0x46010000 PCGCM1 size 0x1000 — PCGC Master 1
0x46011000 LRCCONF1 size 0x1000
0x46013000 CPUCONF size 0x1000 — CPU Configuration
0x46014000 MEMCONF size 0x1000 — Memory configuration
0x46015000 IPCT size 0x1000 — IPCT APB registers
0x46120000 TXDFE size 0x1000 — HALTI_TX_register_map AhmaTxDigDigitalReg register map KarhuTxDigAnalogReg register map
0x46121000 RFTIMERTX size 0x1000 — RfTimer 0
0x46122000 EGUTX size 0x1000 — Event generator unit 0
0x46130000 RXDFE size 0x1000 — HALTI_RX_register_map AhmaRx Digital control register map Karhu Rx Analog control register map AhmaRx Digital control register map
0x46132000 RFTIMERRX size 0x1000 — RfTimer 1
0x46133000 EGURX size 0x1000 — Event generator unit 1
0x46140000 DSA2TX size 0x1000 — Direct Sequence Access controller, version 2 0
0x46142000 DSA2RX size 0x1000 — Direct Sequence Access controller, version 2 1
0x46144000 GPIOTE size 0x1000 — GPIO Tasks and Events
0x46145000 RFSERVICES size 0x1000 — AhmaRfSubsystem general control register map AhmaRfSubsystem general control register map
0x46146000 SENSORADC size 0x1000 — Sensor Analog to Digital Converter
0x46147000 SX size 0x1000 — Ahma SX register map SX register map
0x46148000 RFTIMERSTC size 0x1000 — RfTimer 2
0x46149000 MIPIRFFE0 size 0x1000 — MipiRffe Master
0x46150000 DPPIC size 0x1000 — Distributed programmable peripheral interconnect controller
0x46151000 RAMCTX size 0x1000 — RAM Controller 2
0x46152000 RAMCRX size 0x1000 — RAM Controller 3
0x46153000 PCGCM2 size 0x1000 — PCGC Master 2
0x46154000 LRCCONF2 size 0x1000
0x46156000 RAMCGNSS size 0x1000 — RAM Controller 4
0x46157000 PCGCS2 size 0x1000 — PCGCSlave 2
0x4F09E000 BELLBOARD size 0x1000 — BELLBOARD APB registers
0x4F8D2000 GLOBAL_MUTEX120 size 0x1000 — MUTEX 0
0x4F8D2000 GLOBAL_PROTOTYPE size 0x1000 — Prototype HW information registers.
0x4F927000 GLOBAL_MUTEX130 size 0x1000 — MUTEX 1
0x5F092000 GLOBAL_MRAMC110 size 0x1000 — MRAM controller 0
0x5F093000 GLOBAL_MRAMC111 size 0x1000 — MRAM controller 1
0x5F8C5000 GLOBAL_OTPC size 0x1000 — OTP controller
0x5F8C8000 GLOBAL_VPR120 size 0x1000 — VPR peripheral registers 0
0x5F8D1000 GLOBAL_IPCT120 size 0x1000 — IPCT APB registers 0
0x5F8D4000 GLOBAL_VPR121 size 0x1000 — VPR peripheral registers 1
0x5F8E1000 GLOBAL_DPPIC120 size 0x1000 — Distributed programmable peripheral interconnect controller 0
0x5F8E2000 GLOBAL_TIMER120 size 0x1000 — Timer/Counter 0
0x5F8E6000 GLOBAL_SPIM120 size 0x1000 — Serial Peripheral Interface Master with EasyDMA 0
0x5F8E6000 GLOBAL_SPIS120 size 0x1000 — SPI Slave 0
0x5F8E6000 GLOBAL_UARTE120 size 0x1000 — UART with EasyDMA 0
0x5F908000 GLOBAL_VPR130 size 0x1000 — VPR peripheral registers 2
0x5F90A000 GLOBAL_AHBBUFFER_APP size 0x1000 — AHB Buffer 0
0x5F90C000 GLOBAL_AHBBUFFER_CELL size 0x1000 — AHB Buffer 1
0x5F921000 GLOBAL_IPCT130 size 0x1000 — IPCT APB registers 1
0x5F922000 GLOBAL_DPPIC130 size 0x1000 — Distributed programmable peripheral interconnect controller 1
0x5F928000 GLOBAL_RTC130 size 0x1000 — Real-time counter
0x5F92B000 GLOBAL_WDT131 size 0x1000 — Watchdog Timer 0
0x5F92C000 GLOBAL_WDT132 size 0x1000 — Watchdog Timer 1
0x5F92D000 GLOBAL_EGU130 size 0x1000 — Event generator unit
0x5F934000 GLOBAL_GPIOTE130 size 0x1000 — GPIO Tasks and Events
0x5F938000 GLOBAL_P0 size 0x200 — GPIO Port 0
0x5F938200 GLOBAL_P1 size 0x200 — GPIO Port 1
0x5F938400 GLOBAL_P2 size 0x200 — GPIO Port 2
0x5F938A00 GLOBAL_P5 size 0x200 — GPIO Port 3
0x5F939400 GLOBAL_P10 size 0x200 — GPIO Port 4
0x5F939800 GLOBAL_P12 size 0x200 — GPIO Port 5
0x5F939E00 GLOBAL_GPIOINTERNAL size 0x2000 — GPIO Internal
0x5F949000 GLOBAL_RESETHUB size 0x1000 — Reset hub
0x5F957000 GLOBAL_AUDIOPLL size 0x1000 — AUXPLL
0x5F968000 GLOBAL_AUDIOPLLPM size 0x1000 — AUXPM
0x5F981000 GLOBAL_DPPIC131 size 0x1000 — Distributed programmable peripheral interconnect controller 2
0x5F982000 GLOBAL_SAADC size 0x1000 — Analog to Digital Converter
0x5F984000 GLOBAL_TEMP size 0x1000 — Temperature Sensor
0x5F985000 GLOBAL_NFCT size 0x1000 — NFC-A compatible radio NFC-A compatible radio
0x5F991000 GLOBAL_DPPIC132 size 0x1000 — Distributed programmable peripheral interconnect controller 3
0x5F993000 GLOBAL_PDM size 0x1000 — Pulse Density Modulation (Digital Microphone) Interface
0x5F996000 GLOBAL_SIMIF130 size 0x1000 — SIM card interface
0x5F99B000 GLOBAL_MIPIRFFE size 0x1000 — MipiRffe Master
0x5F99C000 GLOBAL_GRTC size 0x1000 — Global Real-time counter
0x5F9A1000 GLOBAL_DPPIC133 size 0x1000 — Distributed programmable peripheral interconnect controller 4
0x5F9A2000 GLOBAL_TIMER130 size 0x1000 — Timer/Counter 1
0x5F9A3000 GLOBAL_TIMER131 size 0x1000 — Timer/Counter 2
0x5F9A4000 GLOBAL_PWM130 size 0x1000 — Pulse width modulation unit 0
0x5F9A5000 GLOBAL_SPIM130 size 0x1000 — Serial Peripheral Interface Master with EasyDMA 1
0x5F9A5000 GLOBAL_SPIS130 size 0x1000 — SPI Slave 1
0x5F9A5000 GLOBAL_TWIM130 size 0x1000 — I2C compatible Two-Wire Master Interface with EasyDMA 0
0x5F9A5000 GLOBAL_TWIS130 size 0x1000 — I2C compatible Two-Wire Slave Interface with EasyDMA 0
0x5F9A5000 GLOBAL_UARTE130 size 0x1000 — UART with EasyDMA 1
0x5F9A6000 GLOBAL_SPIM131 size 0x1000 — Serial Peripheral Interface Master with EasyDMA 2
0x5F9A6000 GLOBAL_SPIS131 size 0x1000 — SPI Slave 2
0x5F9A6000 GLOBAL_TWIM131 size 0x1000 — I2C compatible Two-Wire Master Interface with EasyDMA 1
0x5F9A6000 GLOBAL_TWIS131 size 0x1000 — I2C compatible Two-Wire Slave Interface with EasyDMA 1
0x5F9A6000 GLOBAL_UARTE131 size 0x1000 — UART with EasyDMA 2
0x5F9B1000 GLOBAL_DPPIC134 size 0x1000 — Distributed programmable peripheral interconnect controller 5
0x5F9B2000 GLOBAL_TIMER132 size 0x1000 — Timer/Counter 3
0x5F9B3000 GLOBAL_TIMER133 size 0x1000 — Timer/Counter 4
0x5F9B4000 GLOBAL_PWM131 size 0x1000 — Pulse width modulation unit 1
0x5F9B5000 GLOBAL_SPIM132 size 0x1000 — Serial Peripheral Interface Master with EasyDMA 3
0x5F9B5000 GLOBAL_SPIS132 size 0x1000 — SPI Slave 3
0x5F9B5000 GLOBAL_TWIM132 size 0x1000 — I2C compatible Two-Wire Master Interface with EasyDMA 2
0x5F9B5000 GLOBAL_TWIS132 size 0x1000 — I2C compatible Two-Wire Slave Interface with EasyDMA 2
0x5F9B5000 GLOBAL_UARTE132 size 0x1000 — UART with EasyDMA 3
0x5F9B6000 GLOBAL_SPIM133 size 0x1000 — Serial Peripheral Interface Master with EasyDMA 4
0x5F9B6000 GLOBAL_SPIS133 size 0x1000 — SPI Slave 4
0x5F9B6000 GLOBAL_TWIM133 size 0x1000 — I2C compatible Two-Wire Master Interface with EasyDMA 3
0x5F9B6000 GLOBAL_TWIS133 size 0x1000 — I2C compatible Two-Wire Slave Interface with EasyDMA 3
0x5F9B6000 GLOBAL_UARTE133 size 0x1000 — UART with EasyDMA 4
0xA0000000 GLOBAL_STMDATA size 0x10000000 — System Trace Macrocell data buffer
0xBF001000 GLOBAL_TDDCONF size 0x1000 — TDDCONF
0xBF041000 GLOBAL_TSGEN size 0x1000 — Timestamp generator
0xBF042000 GLOBAL_STM size 0x1000 — System Trace Macrocell
0xBF043000 GLOBAL_TPIU size 0x1000 — Trace Port Interface Unit
0xBF044000 GLOBAL_ETB size 0x1000 — Embedded Trace Buffer
0xBF045000 GLOBAL_ETR size 0x1000 — Embedded Trace Router
0xBF046000 GLOBAL_CTI210 size 0x1000 — Cross-Trigger Interface control. NOTE: this is not a separate peripheral, but describes CM33 functionality. 0
0xBF047000 GLOBAL_CTI211 size 0x1000 — Cross-Trigger Interface control. NOTE: this is not a separate peripheral, but describes CM33 functionality. 1
0xBF048000 GLOBAL_ATBREPLICATOR210 size 0x1000 — ATB Replicator module 0
0xBF049000 GLOBAL_ATBREPLICATOR211 size 0x1000 — ATB Replicator module 1
0xBF04A000 GLOBAL_ATBREPLICATOR212 size 0x1000 — ATB Replicator module 2
0xBF04B000 GLOBAL_ATBREPLICATOR213 size 0x1000 — ATB Replicator module 3
0xBF04C000 GLOBAL_ATBFUNNEL210 size 0x1000 — ATB funnel module 0
0xBF04D000 GLOBAL_ATBFUNNEL211 size 0x1000 — ATB funnel module 1
0xBF04E000 GLOBAL_ATBFUNNEL212 size 0x1000 — ATB funnel module 2
0xBF04F000 GLOBAL_ATBFUNNEL213 size 0x1000 — ATB funnel module 3
0xBF050000 GLOBAL_GPR size 0x1000 — Granular Power Requester
0xF0001000 CTI size 0x1000 — Cross-Trigger Interface control. NOTE: this is not a separate peripheral, but describes CM33 functionality.

## Interrupts
0 TXDFE
1 EGUTX
2 RXDFE_0 (RXDFE)
3 RXDFE_1 (RXDFE)
4 EGURX
7 DSA2TX_0 (DSA2TX)
8 DSA2TX_1 (DSA2TX)
9 DSA2RX_0 (DSA2RX)
10 DSA2RX_1 (DSA2RX)
11 GPIOTE_0 (GPIOTE)
12 SENSORADC
13 RFTIMERSTC
14 MIPIRFFE0
15 SX
16 RFSERVICES
19 RFCORESERVICES
23 BELLBOARD_0 (BELLBOARD)
24 BELLBOARD_1 (BELLBOARD)
25 BELLBOARD_2 (BELLBOARD)
26 BELLBOARD_3 (BELLBOARD)
27 IPCT_0 (IPCT)
28 IPCT_1 (IPCT)
29 IPCT_2 (IPCT)
30 IPCT_3 (IPCT)
31 IPCT_4 (IPCT)
32 IPCT_5 (IPCT)

## Further device data
MaxInterrupts=33

## Licence text in the file
Copyright (c) 2010 - 2025, Nordic Semiconductor ASA All rights reserved. Redistribution and use in source and binary forms, with or without modification, are permitted provided that the following conditions are met: 1. Redistributions of source code must retain the above copyright notice, this list of conditions and the following disclaimer. 2. Redistributions in binary form, except as embedded into a Nordic Semiconductor ASA integrated circuit in a product or a software update for such product, must reproduce the above copyright notice, this list of conditions and the following disclaimer in the documentation and/or other materials provided with the distribution. 3. Neither the name of Nordic Semiconductor ASA nor the names of its contributors may be used to endorse or promote products derived from this software without specific prior written permission. 4. This software, with or without modification, must only be used with a Nordic Semiconductor ASA integrated circuit. 5. Any software provided in binary form under this license must not be reverse engineered, decompiled, modified and/or disassembled. THIS SOFTWARE IS PROVIDED BY NORDIC SEMICONDUCTOR ASA "AS IS" AND ANY EXPRESS OR IMPLIED WARRANTIES, INCLUDING, BUT NOT LIMITED TO, THE IMPLIED WARRANTIES OF MERCHANTABILITY, NONINFRINGEMENT, AND FITNESS FOR A PARTICULAR PURPOSE ARE DISCLAIMED. IN NO EVENT SHALL NORDIC SEMICONDUCTOR ASA OR CONTRIBUTORS BE LIABLE FOR ANY DIRECT, INDIRECT, INCIDENTAL, SPECIAL, EXEMPLARY, OR CONSEQUENTIAL DAMAGES (INCLUDING, BUT NOT LIMITED TO, PROCUREMENT OF SUBSTITUTE GOODS OR SERVICES; LOSS OF USE, DATA, OR PROFITS; OR BUSINESS INTERRUPTION) HOWEVER CAUSED AND ON ANY THEORY OF LIABILITY, WHETHER IN CONTRACT, STRICT LIABILITY, OR TORT (INCLUDING NEGLIGENCE OR OTHERWISE) ARISING IN ANY WAY OUT OF THE USE OF THIS SOFTWARE, EVEN IF ADVISED OF THE POSSIBILITY OF SUCH DAMAGE.
